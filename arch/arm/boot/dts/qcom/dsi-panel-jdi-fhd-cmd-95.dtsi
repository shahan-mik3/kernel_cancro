/* Copyright (c) 2012-2013, The Linux Foundation. All rights reserved.
 *
 * This program is free software; you can redistribute it and/or modify
 * it under the terms of the GNU General Public License version 2 and
 * only version 2 as published by the Free Software Foundation.
 *
 * This program is distributed in the hope that it will be useful,
 * but WITHOUT ANY WARRANTY; without even the implied warranty of
 * MERCHANTABILITY or FITNESS FOR A PARTICULAR PURPOSE.  See the
 * GNU General Public License for more details.
 */

/*---------------------------------------------------------------------------
 * This file is autogenerated file using gcdb parser. Please do not edit it.
 * Update input XML file to add a new entry or update variable in this file
 * VERSION = "1.0"
 *---------------------------------------------------------------------------*/
&soc {
	dsi_jdi_fhd_cmd_95: qcom,mdss_dsi_jdi_fhd_cmd_95 {
		compatible = "qcom,mdss-dsi-panel";
		status = "okay";
		qcom,mdss-dsi-panel-name = "jdi fhd cmd mode dsi panel";
		qcom,mdss-dsi-panel-id = <5>;
		qcom,mdss-dsi-panel-controller = <&mdss_dsi0>;
		qcom,mdss-dsi-panel-type = "dsi_cmd_mode";
		qcom,mdss-dsi-panel-destination = "display_1";
		qcom,mdss-dsi-panel-framerate = <60>;
		qcom,mdss-dsi-virtual-channel-id = <0>;
		qcom,mdss-dsi-stream = <0>;
		qcom,mdss-dsi-panel-width = <1080>;
		qcom,mdss-dsi-panel-height = <1920>;
		qcom,mdss-dsi-h-front-porch = <80>;
		qcom,mdss-dsi-h-back-porch = <40>;
		qcom,mdss-dsi-h-pulse-width = <10>;
		qcom,mdss-dsi-h-sync-skew = <0>;
		qcom,mdss-dsi-v-back-porch = <4>;
		qcom,mdss-dsi-v-front-porch = <4>;
		qcom,mdss-dsi-v-pulse-width = <2>;
		qcom,mdss-dsi-h-left-border = <0>;
		qcom,mdss-dsi-h-right-border = <0>;
		qcom,mdss-dsi-v-top-border = <0>;
		qcom,mdss-dsi-v-bottom-border = <0>;
		qcom,mdss-dsi-bpp = <24>;
		qcom,mdss-dsi-color-order = <0>;
		qcom,mdss-dsi-underflow-color = <0xff>;
		qcom,mdss-dsi-border-color = <0>;
		qcom,mdss-dsi-on-command = [
				15 01 00 00 01 00 02 FF 10
				15 01 00 00 01 00 02 BB 10
				15 01 00 00 01 00 02 50 00

				15 00 00 00 01 00 02 FF 24
				15 00 00 00 01 00 02 E3 02
				15 00 00 00 01 00 02 C4 69
				15 00 00 00 01 00 02 C9 00
				15 01 00 00 01 00 02 FB 01

				15 00 00 00 01 00 02 FF 22
				15 00 00 00 01 00 02 FB 01
				15 00 00 00 01 00 02 00 28
				15 00 00 00 01 00 02 01 2C
				15 00 00 00 01 00 02 02 30
				15 00 00 00 01 00 02 03 34
				15 00 00 00 01 00 02 04 38
				15 00 00 00 01 00 02 05 3C
				15 00 00 00 01 00 02 06 40
				15 00 00 00 01 00 02 07 48
				15 00 00 00 01 00 02 08 4C
				15 00 00 00 01 00 02 09 50
				15 00 00 00 01 00 02 0A 58
				15 00 00 00 01 00 02 0B 60
				15 00 00 00 01 00 02 0C 60
				15 00 00 00 01 00 02 0D 58
				15 00 00 00 01 00 02 0E 50
				15 00 00 00 01 00 02 0F 48
				15 00 00 00 01 00 02 10 38
				15 00 00 00 01 00 02 11 28
				15 00 00 00 01 00 02 12 28
				15 00 00 00 01 00 02 13 28
				15 00 00 00 01 00 02 1B 00
				15 00 00 00 01 00 02 1C 00
				15 00 00 00 01 00 02 1D 00
				15 00 00 00 01 00 02 1E 00
				15 00 00 00 01 00 02 1F 00
				15 00 00 00 01 00 02 20 00
				15 00 00 00 01 00 02 21 00
				15 00 00 00 01 00 02 22 00
				15 00 00 00 01 00 02 23 00
				15 00 00 00 01 00 02 24 00
				15 00 00 00 01 00 02 25 00
				15 00 00 00 01 00 02 26 00
				15 00 00 00 01 00 02 27 00
				15 00 00 00 01 00 02 28 00
				15 00 00 00 01 00 02 29 00
				15 00 00 00 01 00 02 2A 00
				15 00 00 00 01 00 02 2B 00
				15 00 00 00 01 00 02 2F 00
				15 00 00 00 01 00 02 30 00
				15 00 00 00 01 00 02 31 00
				15 00 00 00 01 00 02 32 80
				15 00 00 00 01 00 02 33 80
				15 00 00 00 01 00 02 34 80
				15 00 00 00 01 00 02 35 82
				15 00 00 00 01 00 02 36 84
				15 00 00 00 01 00 02 37 86
				15 00 00 00 01 00 02 38 88
				15 00 00 00 01 00 02 39 8A
				15 00 00 00 01 00 02 3A 8C
				15 00 00 00 01 00 02 3B 8E
				15 00 00 00 01 00 02 3F 90
				15 00 00 00 01 00 02 40 92
				15 00 00 00 01 00 02 41 94
				15 00 00 00 01 00 02 42 94
				15 00 00 00 01 00 02 43 92
				15 00 00 00 01 00 02 44 90
				15 00 00 00 01 00 02 45 8E
				15 00 00 00 01 00 02 46 8C
				15 00 00 00 01 00 02 47 8A
				15 00 00 00 01 00 02 48 88
				15 00 00 00 01 00 02 49 86
				15 00 00 00 01 00 02 4A 84
				15 00 00 00 01 00 02 4B 82
				15 00 00 00 01 00 02 4C 80
				15 00 00 00 01 00 02 4D 08
				15 00 00 00 01 00 02 1A 00
				15 00 00 00 01 00 02 53 01
				15 00 00 00 01 00 02 54 01
				15 00 00 00 01 00 02 56 00
				15 00 00 00 01 00 02 64 2F
				15 01 00 00 01 00 02 68 00

				15 01 00 00 01 00 02 FF 10
				15 01 00 00 01 00 02 35 00
				39 01 00 00 01 00 05 2A 00 00 04 37
				39 01 00 00 01 00 05 2B 00 00 07 7F
				15 01 00 00 01 00 02 51 de
				15 01 00 00 01 00 02 53 2c
				15 01 00 00 01 00 02 55 80
				05 01 00 00 78 00 02 11 00
				15 01 00 00 01 00 02 FF 10
				05 01 00 00 64 00 02 29 00];
		qcom,mdss-dsi-off-command = [
			15 01 00 00 00 00 02 FF 10
			05 01 00 00 32 00 02 28 00
			05 01 00 00 78 00 02 10 00];
		qcom,mdss-dsi-on-command-state = "dsi_lp_mode";
		qcom,mdss-dsi-off-command-state = "dsi_hs_mode";
		qcom,mdss-dsi-h-sync-pulse = <0>;
		qcom,mdss-dsi-traffic-mode = <1>;
		qcom,mdss-dsi-lane-map = <0>;
		qcom,mdss-dsi-bllp-eof-power-mode;
		qcom,mdss-dsi-bllp-power-mode;
		qcom,mdss-dsi-lane-0-state;
		qcom,mdss-dsi-lane-1-state;
		qcom,mdss-dsi-lane-2-state;
		qcom,mdss-dsi-lane-3-state;
		qcom,mdss-dsi-te-pin-select = <1>;
		qcom,mdss-dsi-te-v-sync-rd-ptr-irq-line = <0x2c>;
		qcom,mdss-dsi-te-v-sync-continues-lines = <0x3c>;
		qcom,mdss-dsi-te-dcs-command = <1>;
		qcom,mdss-dsi-te-check-enable;
		qcom,mdss-dsi-te-using-te-pin;
		qcom,mdss-dsi-panel-timings = [e3 50 36 00 a9 a3 3a 50 3d 03 04 00];
		qcom,mdss-dsi-t-clk-post = <0x20>;
		qcom,mdss-dsi-t-clk-pre = <0x36>;
		qcom,mdss-dsi-bl-min-level = <8>;
		qcom,mdss-dsi-bl-max-level = <4095>;
		qcom,mdss-dsi-dma-trigger = <0x04>;
		qcom,mdss-dsi-mdp-trigger = <0x0>;
		qcom,mdss-dsi-bl-pmic-control-type = "bl_ctrl_wled";
		qcom,mdss-dsi-reset-sequence = <1 20>, <0 20>, <1 20>;
		qcom,mdss-pan-physical-width-dimension = <61>;
        qcom,mdss-pan-physical-height-dimension = <109>;
        qcom,dispparam-enabled;
        qcom,mdss-dsi-dispparam-cabcon-command = [15 00 00 00 01 00 02 ff 10 15 01 00 00 01 00 02 55 82];
        qcom,mdss-dsi-dispparam-cabcguion-command = [15 00 00 00 01 00 02 ff 10 15 01 00 00 01 00 02 55 81];
        qcom,mdss-dsi-dispparam-cabcstillon-command = [15 00 00 00 01 00 02 ff 10 15 01 00 00 01 00 02 55 82];
        qcom,mdss-dsi-dispparam-cabcmovieon-command = [15 00 00 00 01 00 02 ff 10 15 01 00 00 01 00 02 55 83];
        qcom,mdss-dsi-dispparam-cabcon-command-state = "dsi_hs_mode";
        qcom,mdss-dsi-dispparam-cabcoff-command = [15 00 00 00 01 00 02 ff 10 15 01 00 00 01 00 02 55 80];
        qcom,mdss-dsi-dispparam-cabcoff-command-state = "dsi_hs_mode";
        qcom,mdss-dsi-dispparam-warm-command = [15 00 00 00 01 00 02 ff 20 15 00 00 00 01 00 02 75 00 15 00 00 00 01 00 02 76 00 15 00 00 00 01 00 02 77 00 15 00 00 00 01 00 02 78 0b 15 00 00 00 01 00 02 79 00 15 00 00 00 01 00 02 7a 23 15 00 00 00 01 00 02 7b 00 15 00 00 00 01 00 02 7c 36 15 00 00 00 01 00 02 7d 00 15 00 00 00 01 00 02 7e 4a 15 00 00 00 01 00 02 7f 00 15 00 00 00 01 00 02 80 5b 15 00 00 00 01 00 02 81 00 15 00 00 00 01 00 02 82 6c 15 00 00 00 01 00 02 83 00 15 00 00 00 01 00 02 84 7a 15 00 00 00 01 00 02 85 00 15 00 00 00 01 00 02 86 88 15 00 00 00 01 00 02 87 00 15 00 00 00 01 00 02 88 ba 15 00 00 00 01 00 02 89 00 15 00 00 00 01 00 02 8a e4 15 00 00 00 01 00 02 8b 01 15 00 00 00 01 00 02 8c 2a 15 00 00 00 01 00 02 8d 01 15 00 00 00 01 00 02 8e 5f 15 00 00 00 01 00 02 8f 01 15 00 00 00 01 00 02 90 a9 15 00 00 00 01 00 02 91 01 15 00 00 00 01 00 02 92 e8 15 00 00 00 01 00 02 93 01 15 00 00 00 01 00 02 94 ea 15 00 00 00 01 00 02 95 02 15 00 00 00 01 00 02 96 22 15 00 00 00 01 00 02 97 02 15 00 00 00 01 00 02 98 61 15 00 00 00 01 00 02 99 02 15 00 00 00 01 00 02 9a 89 15 00 00 00 01 00 02 9b 02 15 00 00 00 01 00 02 9c c4 15 00 00 00 01 00 02 9d 02 15 00 00 00 01 00 02 9e f0 15 00 00 00 01 00 02 9f 03 15 00 00 00 01 00 02 a0 30 15 00 00 00 01 00 02 a2 03 15 00 00 00 01 00 02 a3 44 15 00 00 00 01 00 02 a4 03 15 00 00 00 01 00 02 a5 5a 15 00 00 00 01 00 02 a6 03 15 00 00 00 01 00 02 a7 73 15 00 00 00 01 00 02 a9 03 15 00 00 00 01 00 02 aa 8d 15 00 00 00 01 00 02 ab 03 15 00 00 00 01 00 02 ac aa 15 00 00 00 01 00 02 ad 03 15 00 00 00 01 00 02 ae ca 15 00 00 00 01 00 02 af 03 15 00 00 00 01 00 02 b0 ee 15 00 00 00 01 00 02 b1 03 15 00 00 00 01 00 02 b2 ff 15 00 00 00 01 00 02 b3 00 15 00 00 00 01 00 02 b4 4a 15 00 00 00 01 00 02 b5 00 15 00 00 00 01 00 02 b6 54 15 00 00 00 01 00 02 b7 00 15 00 00 00 01 00 02 b8 69 15 00 00 00 01 00 02 b9 00 15 00 00 00 01 00 02 ba 7a 15 00 00 00 01 00 02 bb 00 15 00 00 00 01 00 02 bc 8b 15 00 00 00 01 00 02 bd 00 15 00 00 00 01 00 02 be 99 15 00 00 00 01 00 02 bf 00 15 00 00 00 01 00 02 c0 a7 15 00 00 00 01 00 02 c1 00 15 00 00 00 01 00 02 c2 b3 15 00 00 00 01 00 02 c3 00 15 00 00 00 01 00 02 c4 be 15 00 00 00 01 00 02 c5 00 15 00 00 00 01 00 02 c6 e5 15 00 00 00 01 00 02 c7 01 15 00 00 00 01 00 02 c8 04 15 00 00 00 01 00 02 c9 01 15 00 00 00 01 00 02 ca 34 15 00 00 00 01 00 02 cb 01 15 00 00 00 01 00 02 cc 5f 15 00 00 00 01 00 02 cd 01 15 00 00 00 01 00 02 ce a9 15 00 00 00 01 00 02 cf 01 15 00 00 00 01 00 02 d0 e8 15 00 00 00 01 00 02 d1 01 15 00 00 00 01 00 02 d2 ea 15 00 00 00 01 00 02 d3 02 15 00 00 00 01 00 02 d4 22 15 00 00 00 01 00 02 d5 02 15 00 00 00 01 00 02 d6 61 15 00 00 00 01 00 02 d7 02 15 00 00 00 01 00 02 d8 89 15 00 00 00 01 00 02 d9 02 15 00 00 00 01 00 02 da c4 15 00 00 00 01 00 02 db 02 15 00 00 00 01 00 02 dc f0 15 00 00 00 01 00 02 dd 03 15 00 00 00 01 00 02 de 30 15 00 00 00 01 00 02 df 03 15 00 00 00 01 00 02 e0 44 15 00 00 00 01 00 02 e1 03 15 00 00 00 01 00 02 e2 5a 15 00 00 00 01 00 02 e3 03 15 00 00 00 01 00 02 e4 73 15 00 00 00 01 00 02 e5 03 15 00 00 00 01 00 02 e6 8d 15 00 00 00 01 00 02 e7 03 15 00 00 00 01 00 02 e8 aa 15 00 00 00 01 00 02 e9 03 15 00 00 00 01 00 02 ea ca 15 00 00 00 01 00 02 eb 03 15 00 00 00 01 00 02 ec ee 15 00 00 00 01 00 02 ed 03 15 00 00 00 01 00 02 ee ff 15 00 00 00 01 00 02 ef 00 15 00 00 00 01 00 02 f0 91 15 00 00 00 01 00 02 f1 00 15 00 00 00 01 00 02 f2 97 15 00 00 00 01 00 02 f3 00 15 00 00 00 01 00 02 f4 a3 15 00 00 00 01 00 02 f5 00 15 00 00 00 01 00 02 f6 ac 15 00 00 00 01 00 02 f7 00 15 00 00 00 01 00 02 f8 b7 15 00 00 00 01 00 02 f9 00 15 00 00 00 01 00 02 fa c1 15 00 00 00 01 00 02 fb 01 15 00 00 00 01 00 02 ff 21 15 00 00 00 01 00 02 00 00 15 00 00 00 01 00 02 01 cb 15 00 00 00 01 00 02 02 00 15 00 00 00 01 00 02 03 d4 15 00 00 00 01 00 02 04 00 15 00 00 00 01 00 02 05 dd 15 00 00 00 01 00 02 06 00 15 00 00 00 01 00 02 07 ff 15 00 00 00 01 00 02 08 01 15 00 00 00 01 00 02 09 1d 15 00 00 00 01 00 02 0a 01 15 00 00 00 01 00 02 0b 53 15 00 00 00 01 00 02 0c 01 15 00 00 00 01 00 02 0d 7e 15 00 00 00 01 00 02 0e 01 15 00 00 00 01 00 02 0f be 15 00 00 00 01 00 02 10 01 15 00 00 00 01 00 02 11 f5 15 00 00 00 01 00 02 12 01 15 00 00 00 01 00 02 13 f7 15 00 00 00 01 00 02 14 02 15 00 00 00 01 00 02 15 2b 15 00 00 00 01 00 02 16 02 15 00 00 00 01 00 02 17 68 15 00 00 00 01 00 02 18 02 15 00 00 00 01 00 02 19 91 15 00 00 00 01 00 02 1a 02 15 00 00 00 01 00 02 1b cb 15 00 00 00 01 00 02 1c 02 15 00 00 00 01 00 02 1d f5 15 00 00 00 01 00 02 1e 03 15 00 00 00 01 00 02 1f 36 15 00 00 00 01 00 02 20 03 15 00 00 00 01 00 02 21 49 15 00 00 00 01 00 02 22 03 15 00 00 00 01 00 02 23 5f 15 00 00 00 01 00 02 24 03 15 00 00 00 01 00 02 25 76 15 00 00 00 01 00 02 26 03 15 00 00 00 01 00 02 27 90 15 00 00 00 01 00 02 28 03 15 00 00 00 01 00 02 29 ac 15 00 00 00 01 00 02 2a 03 15 00 00 00 01 00 02 2b cb 15 00 00 00 01 00 02 2d 03 15 00 00 00 01 00 02 2f ee 15 00 00 00 01 00 02 30 03 15 00 00 00 01 00 02 31 ff 15 00 00 00 01 00 02 32 00 15 00 00 00 01 00 02 33 d0 15 00 00 00 01 00 02 34 00 15 00 00 00 01 00 02 35 d4 15 00 00 00 01 00 02 36 00 15 00 00 00 01 00 02 37 de 15 00 00 00 01 00 02 38 00 15 00 00 00 01 00 02 39 e5 15 00 00 00 01 00 02 3a 00 15 00 00 00 01 00 02 3b ee 15 00 00 00 01 00 02 3d 00 15 00 00 00 01 00 02 3f f5 15 00 00 00 01 00 02 40 00 15 00 00 00 01 00 02 41 fd 15 00 00 00 01 00 02 42 01 15 00 00 00 01 00 02 43 04 15 00 00 00 01 00 02 44 01 15 00 00 00 01 00 02 45 0b 15 00 00 00 01 00 02 46 01 15 00 00 00 01 00 02 47 23 15 00 00 00 01 00 02 48 01 15 00 00 00 01 00 02 49 39 15 00 00 00 01 00 02 4a 01 15 00 00 00 01 00 02 4b 5c 15 00 00 00 01 00 02 4c 01 15 00 00 00 01 00 02 4d 7e 15 00 00 00 01 00 02 4e 01 15 00 00 00 01 00 02 4f be 15 00 00 00 01 00 02 50 01 15 00 00 00 01 00 02 51 f5 15 00 00 00 01 00 02 52 01 15 00 00 00 01 00 02 53 f7 15 00 00 00 01 00 02 54 02 15 00 00 00 01 00 02 55 2b 15 00 00 00 01 00 02 56 02 15 00 00 00 01 00 02 58 68 15 00 00 00 01 00 02 59 02 15 00 00 00 01 00 02 5a 91 15 00 00 00 01 00 02 5b 02 15 00 00 00 01 00 02 5c cb 15 00 00 00 01 00 02 5d 02 15 00 00 00 01 00 02 5e f5 15 00 00 00 01 00 02 5f 03 15 00 00 00 01 00 02 60 36 15 00 00 00 01 00 02 61 03 15 00 00 00 01 00 02 62 49 15 00 00 00 01 00 02 63 03 15 00 00 00 01 00 02 64 5f 15 00 00 00 01 00 02 65 03 15 00 00 00 01 00 02 66 76 15 00 00 00 01 00 02 67 03 15 00 00 00 01 00 02 68 90 15 00 00 00 01 00 02 69 03 15 00 00 00 01 00 02 6a ac 15 00 00 00 01 00 02 6b 03 15 00 00 00 01 00 02 6c cb 15 00 00 00 01 00 02 6d 03 15 00 00 00 01 00 02 6e ee 15 00 00 00 01 00 02 6f 03 15 00 00 00 01 00 02 70 ff 15 00 00 00 01 00 02 71 00 15 00 00 00 01 00 02 72 d6 15 00 00 00 01 00 02 73 00 15 00 00 00 01 00 02 74 d9 15 00 00 00 01 00 02 75 00 15 00 00 00 01 00 02 76 e2 15 00 00 00 01 00 02 77 00 15 00 00 00 01 00 02 78 ea 15 00 00 00 01 00 02 79 00 15 00 00 00 01 00 02 7a f0 15 00 00 00 01 00 02 7b 00 15 00 00 00 01 00 02 7c f8 15 00 00 00 01 00 02 7d 01 15 00 00 00 01 00 02 7e 00 15 00 00 00 01 00 02 7f 01 15 00 00 00 01 00 02 80 07 15 00 00 00 01 00 02 81 01 15 00 00 00 01 00 02 82 0e 15 00 00 00 01 00 02 83 01 15 00 00 00 01 00 02 84 29 15 00 00 00 01 00 02 85 01 15 00 00 00 01 00 02 86 42 15 00 00 00 01 00 02 87 01 15 00 00 00 01 00 02 88 6f 15 00 00 00 01 00 02 89 01 15 00 00 00 01 00 02 8a 94 15 00 00 00 01 00 02 8b 01 15 00 00 00 01 00 02 8c cd 15 00 00 00 01 00 02 8d 02 15 00 00 00 01 00 02 8e 00 15 00 00 00 01 00 02 8f 02 15 00 00 00 01 00 02 90 02 15 00 00 00 01 00 02 91 02 15 00 00 00 01 00 02 92 33 15 00 00 00 01 00 02 93 02 15 00 00 00 01 00 02 94 70 15 00 00 00 01 00 02 95 02 15 00 00 00 01 00 02 96 98 15 00 00 00 01 00 02 97 02 15 00 00 00 01 00 02 98 d8 15 00 00 00 01 00 02 99 03 15 00 00 00 01 00 02 9a 03 15 00 00 00 01 00 02 9b 03 15 00 00 00 01 00 02 9c 2d 15 00 00 00 01 00 02 9d 03 15 00 00 00 01 00 02 9e 40 15 00 00 00 01 00 02 9f 03 15 00 00 00 01 00 02 a0 56 15 00 00 00 01 00 02 a2 03 15 00 00 00 01 00 02 a3 6e 15 00 00 00 01 00 02 a4 03 15 00 00 00 01 00 02 a5 88 15 00 00 00 01 00 02 a6 03 15 00 00 00 01 00 02 a7 a6 15 00 00 00 01 00 02 a9 03 15 00 00 00 01 00 02 aa c7 15 00 00 00 01 00 02 ab 03 15 00 00 00 01 00 02 ac ed 15 00 00 00 01 00 02 ad 03 15 00 00 00 01 00 02 ae ff 15 00 00 00 01 00 02 af 01 15 00 00 00 01 00 02 b0 0d 15 00 00 00 01 00 02 b1 01 15 00 00 00 01 00 02 b2 0f 15 00 00 00 01 00 02 b3 01 15 00 00 00 01 00 02 b4 16 15 00 00 00 01 00 02 b5 01 15 00 00 00 01 00 02 b6 1c 15 00 00 00 01 00 02 b7 01 15 00 00 00 01 00 02 b8 21 15 00 00 00 01 00 02 b9 01 15 00 00 00 01 00 02 ba 26 15 00 00 00 01 00 02 bb 01 15 00 00 00 01 00 02 bc 2c 15 00 00 00 01 00 02 bd 01 15 00 00 00 01 00 02 be 31 15 00 00 00 01 00 02 bf 01 15 00 00 00 01 00 02 c0 37 15 00 00 00 01 00 02 c1 01 15 00 00 00 01 00 02 c2 49 15 00 00 00 01 00 02 c3 01 15 00 00 00 01 00 02 c4 5a 15 00 00 00 01 00 02 c5 01 15 00 00 00 01 00 02 c6 77 15 00 00 00 01 00 02 c7 01 15 00 00 00 01 00 02 c8 94 15 00 00 00 01 00 02 c9 01 15 00 00 00 01 00 02 ca cd 15 00 00 00 01 00 02 cb 02 15 00 00 00 01 00 02 cc 00 15 00 00 00 01 00 02 cd 02 15 00 00 00 01 00 02 ce 02 15 00 00 00 01 00 02 cf 02 15 00 00 00 01 00 02 d0 33 15 00 00 00 01 00 02 d1 02 15 00 00 00 01 00 02 d2 70 15 00 00 00 01 00 02 d3 02 15 00 00 00 01 00 02 d4 98 15 00 00 00 01 00 02 d5 02 15 00 00 00 01 00 02 d6 d8 15 00 00 00 01 00 02 d7 03 15 00 00 00 01 00 02 d8 03 15 00 00 00 01 00 02 d9 03 15 00 00 00 01 00 02 da 2d 15 00 00 00 01 00 02 db 03 15 00 00 00 01 00 02 dc 40 15 00 00 00 01 00 02 dd 03 15 00 00 00 01 00 02 de 56 15 00 00 00 01 00 02 df 03 15 00 00 00 01 00 02 e0 6e 15 00 00 00 01 00 02 e1 03 15 00 00 00 01 00 02 e2 88 15 00 00 00 01 00 02 e3 03 15 00 00 00 01 00 02 e4 a6 15 00 00 00 01 00 02 e5 03 15 00 00 00 01 00 02 e6 c7 15 00 00 00 01 00 02 e7 03 15 00 00 00 01 00 02 e8 ed 15 00 00 00 01 00 02 e9 03 15 00 00 00 01 00 02 ea ff 15 00 00 00 01 00 02 eb 30 15 00 00 00 01 00 02 ec 17 15 00 00 00 01 00 02 ed 20 15 00 00 00 01 00 02 ee 0f 15 00 00 00 01 00 02 ef 1f 15 00 00 00 01 00 02 f0 0f 15 00 00 00 01 00 02 f1 0f 15 00 00 00 01 00 02 f2 07 15 00 00 00 01 00 02 fb 01 15 01 00 00 01 00 02 ff 10];
        qcom,mdss-dsi-dispparam-warm-command-state = "dsi_hs_mode";
        qcom,mdss-dsi-dispparam-default-command = [15 00 00 00 01 00 02 ff 20 15 00 00 00 01 00 02 75 00 15 00 00 00 01 00 02 76 00 15 00 00 00 01 00 02 77 00 15 00 00 00 01 00 02 78 0c 15 00 00 00 01 00 02 79 00 15 00 00 00 01 00 02 7a 26 15 00 00 00 01 00 02 7b 00 15 00 00 00 01 00 02 7c 3b 15 00 00 00 01 00 02 7d 00 15 00 00 00 01 00 02 7e 50 15 00 00 00 01 00 02 7f 00 15 00 00 00 01 00 02 80 61 15 00 00 00 01 00 02 81 00 15 00 00 00 01 00 02 82 72 15 00 00 00 01 00 02 83 00 15 00 00 00 01 00 02 84 81 15 00 00 00 01 00 02 85 00 15 00 00 00 01 00 02 86 90 15 00 00 00 01 00 02 87 00 15 00 00 00 01 00 02 88 c3 15 00 00 00 01 00 02 89 00 15 00 00 00 01 00 02 8a ee 15 00 00 00 01 00 02 8b 01 15 00 00 00 01 00 02 8c 35 15 00 00 00 01 00 02 8d 01 15 00 00 00 01 00 02 8e 6c 15 00 00 00 01 00 02 8f 01 15 00 00 00 01 00 02 90 b8 15 00 00 00 01 00 02 91 01 15 00 00 00 01 00 02 92 f4 15 00 00 00 01 00 02 93 01 15 00 00 00 01 00 02 94 f6 15 00 00 00 01 00 02 95 02 15 00 00 00 01 00 02 96 2e 15 00 00 00 01 00 02 97 02 15 00 00 00 01 00 02 98 70 15 00 00 00 01 00 02 99 02 15 00 00 00 01 00 02 9a 9c 15 00 00 00 01 00 02 9b 02 15 00 00 00 01 00 02 9c da 15 00 00 00 01 00 02 9d 03 15 00 00 00 01 00 02 9e 08 15 00 00 00 01 00 02 9f 03 15 00 00 00 01 00 02 a0 46 15 00 00 00 01 00 02 a2 03 15 00 00 00 01 00 02 a3 59 15 00 00 00 01 00 02 a4 03 15 00 00 00 01 00 02 a5 6e 15 00 00 00 01 00 02 a6 03 15 00 00 00 01 00 02 a7 85 15 00 00 00 01 00 02 a9 03 15 00 00 00 01 00 02 aa 9c 15 00 00 00 01 00 02 ab 03 15 00 00 00 01 00 02 ac b6 15 00 00 00 01 00 02 ad 03 15 00 00 00 01 00 02 ae d2 15 00 00 00 01 00 02 af 03 15 00 00 00 01 00 02 b0 f1 15 00 00 00 01 00 02 b1 03 15 00 00 00 01 00 02 b2 ff 15 00 00 00 01 00 02 b3 00 15 00 00 00 01 00 02 b4 4a 15 00 00 00 01 00 02 b5 00 15 00 00 00 01 00 02 b6 55 15 00 00 00 01 00 02 b7 00 15 00 00 00 01 00 02 b8 6c 15 00 00 00 01 00 02 b9 00 15 00 00 00 01 00 02 ba 7f 15 00 00 00 01 00 02 bb 00 15 00 00 00 01 00 02 bc 90 15 00 00 00 01 00 02 bd 00 15 00 00 00 01 00 02 be 9f 15 00 00 00 01 00 02 bf 00 15 00 00 00 01 00 02 c0 ae 15 00 00 00 01 00 02 c1 00 15 00 00 00 01 00 02 c2 ba 15 00 00 00 01 00 02 c3 00 15 00 00 00 01 00 02 c4 c6 15 00 00 00 01 00 02 c5 00 15 00 00 00 01 00 02 c6 ee 15 00 00 00 01 00 02 c7 01 15 00 00 00 01 00 02 c8 0e 15 00 00 00 01 00 02 c9 01 15 00 00 00 01 00 02 ca 40 15 00 00 00 01 00 02 cb 01 15 00 00 00 01 00 02 cc 6c 15 00 00 00 01 00 02 cd 01 15 00 00 00 01 00 02 ce b8 15 00 00 00 01 00 02 cf 01 15 00 00 00 01 00 02 d0 f4 15 00 00 00 01 00 02 d1 01 15 00 00 00 01 00 02 d2 f6 15 00 00 00 01 00 02 d3 02 15 00 00 00 01 00 02 d4 2e 15 00 00 00 01 00 02 d5 02 15 00 00 00 01 00 02 d6 70 15 00 00 00 01 00 02 d7 02 15 00 00 00 01 00 02 d8 9c 15 00 00 00 01 00 02 d9 02 15 00 00 00 01 00 02 da da 15 00 00 00 01 00 02 db 03 15 00 00 00 01 00 02 dc 08 15 00 00 00 01 00 02 dd 03 15 00 00 00 01 00 02 de 46 15 00 00 00 01 00 02 df 03 15 00 00 00 01 00 02 e0 59 15 00 00 00 01 00 02 e1 03 15 00 00 00 01 00 02 e2 6e 15 00 00 00 01 00 02 e3 03 15 00 00 00 01 00 02 e4 85 15 00 00 00 01 00 02 e5 03 15 00 00 00 01 00 02 e6 9c 15 00 00 00 01 00 02 e7 03 15 00 00 00 01 00 02 e8 b6 15 00 00 00 01 00 02 e9 03 15 00 00 00 01 00 02 ea d2 15 00 00 00 01 00 02 eb 03 15 00 00 00 01 00 02 ec f1 15 00 00 00 01 00 02 ed 03 15 00 00 00 01 00 02 ee ff 15 00 00 00 01 00 02 ef 00 15 00 00 00 01 00 02 f0 5d 15 00 00 00 01 00 02 f1 00 15 00 00 00 01 00 02 f2 64 15 00 00 00 01 00 02 f3 00 15 00 00 00 01 00 02 f4 74 15 00 00 00 01 00 02 f5 00 15 00 00 00 01 00 02 f6 82 15 00 00 00 01 00 02 f7 00 15 00 00 00 01 00 02 f8 90 15 00 00 00 01 00 02 f9 00 15 00 00 00 01 00 02 fa 9c 15 00 00 00 01 00 02 fb 01 15 00 00 00 01 00 02 ff 21 15 00 00 00 01 00 02 00 00 15 00 00 00 01 00 02 01 a9 15 00 00 00 01 00 02 02 00 15 00 00 00 01 00 02 03 b5 15 00 00 00 01 00 02 04 00 15 00 00 00 01 00 02 05 c0 15 00 00 00 01 00 02 06 00 15 00 00 00 01 00 02 07 e9 15 00 00 00 01 00 02 08 01 15 00 00 00 01 00 02 09 0d 15 00 00 00 01 00 02 0a 01 15 00 00 00 01 00 02 0b 4b 15 00 00 00 01 00 02 0c 01 15 00 00 00 01 00 02 0d 7b 15 00 00 00 01 00 02 0e 01 15 00 00 00 01 00 02 0f c1 15 00 00 00 01 00 02 10 01 15 00 00 00 01 00 02 11 fa 15 00 00 00 01 00 02 12 01 15 00 00 00 01 00 02 13 fc 15 00 00 00 01 00 02 14 02 15 00 00 00 01 00 02 15 33 15 00 00 00 01 00 02 16 02 15 00 00 00 01 00 02 17 75 15 00 00 00 01 00 02 18 02 15 00 00 00 01 00 02 19 a1 15 00 00 00 01 00 02 1a 02 15 00 00 00 01 00 02 1b de 15 00 00 00 01 00 02 1c 03 15 00 00 00 01 00 02 1d 0a 15 00 00 00 01 00 02 1e 03 15 00 00 00 01 00 02 1f 47 15 00 00 00 01 00 02 20 03 15 00 00 00 01 00 02 21 59 15 00 00 00 01 00 02 22 03 15 00 00 00 01 00 02 23 6d 15 00 00 00 01 00 02 24 03 15 00 00 00 01 00 02 25 84 15 00 00 00 01 00 02 26 03 15 00 00 00 01 00 02 27 9b 15 00 00 00 01 00 02 28 03 15 00 00 00 01 00 02 29 b5 15 00 00 00 01 00 02 2a 03 15 00 00 00 01 00 02 2b d1 15 00 00 00 01 00 02 2d 03 15 00 00 00 01 00 02 2f f0 15 00 00 00 01 00 02 30 03 15 00 00 00 01 00 02 31 ff 15 00 00 00 01 00 02 32 00 15 00 00 00 01 00 02 33 a0 15 00 00 00 01 00 02 34 00 15 00 00 00 01 00 02 35 a7 15 00 00 00 01 00 02 36 00 15 00 00 00 01 00 02 37 b4 15 00 00 00 01 00 02 38 00 15 00 00 00 01 00 02 39 bf 15 00 00 00 01 00 02 3a 00 15 00 00 00 01 00 02 3b cb 15 00 00 00 01 00 02 3d 00 15 00 00 00 01 00 02 3f d5 15 00 00 00 01 00 02 40 00 15 00 00 00 01 00 02 41 df 15 00 00 00 01 00 02 42 00 15 00 00 00 01 00 02 43 e8 15 00 00 00 01 00 02 44 00 15 00 00 00 01 00 02 45 f1 15 00 00 00 01 00 02 46 01 15 00 00 00 01 00 02 47 11 15 00 00 00 01 00 02 48 01 15 00 00 00 01 00 02 49 2b 15 00 00 00 01 00 02 4a 01 15 00 00 00 01 00 02 4b 55 15 00 00 00 01 00 02 4c 01 15 00 00 00 01 00 02 4d 7b 15 00 00 00 01 00 02 4e 01 15 00 00 00 01 00 02 4f c1 15 00 00 00 01 00 02 50 01 15 00 00 00 01 00 02 51 fa 15 00 00 00 01 00 02 52 01 15 00 00 00 01 00 02 53 fc 15 00 00 00 01 00 02 54 02 15 00 00 00 01 00 02 55 33 15 00 00 00 01 00 02 56 02 15 00 00 00 01 00 02 58 75 15 00 00 00 01 00 02 59 02 15 00 00 00 01 00 02 5a a1 15 00 00 00 01 00 02 5b 02 15 00 00 00 01 00 02 5c de 15 00 00 00 01 00 02 5d 03 15 00 00 00 01 00 02 5e 0a 15 00 00 00 01 00 02 5f 03 15 00 00 00 01 00 02 60 47 15 00 00 00 01 00 02 61 03 15 00 00 00 01 00 02 62 59 15 00 00 00 01 00 02 63 03 15 00 00 00 01 00 02 64 6d 15 00 00 00 01 00 02 65 03 15 00 00 00 01 00 02 66 84 15 00 00 00 01 00 02 67 03 15 00 00 00 01 00 02 68 9b 15 00 00 00 01 00 02 69 03 15 00 00 00 01 00 02 6a b5 15 00 00 00 01 00 02 6b 03 15 00 00 00 01 00 02 6c d1 15 00 00 00 01 00 02 6d 03 15 00 00 00 01 00 02 6e f0 15 00 00 00 01 00 02 6f 03 15 00 00 00 01 00 02 70 ff 15 00 00 00 01 00 02 71 00 15 00 00 00 01 00 02 72 82 15 00 00 00 01 00 02 73 00 15 00 00 00 01 00 02 74 88 15 00 00 00 01 00 02 75 00 15 00 00 00 01 00 02 76 96 15 00 00 00 01 00 02 77 00 15 00 00 00 01 00 02 78 a2 15 00 00 00 01 00 02 79 00 15 00 00 00 01 00 02 7a ae 15 00 00 00 01 00 02 7b 00 15 00 00 00 01 00 02 7c b9 15 00 00 00 01 00 02 7d 00 15 00 00 00 01 00 02 7e c3 15 00 00 00 01 00 02 7f 00 15 00 00 00 01 00 02 80 ce 15 00 00 00 01 00 02 81 00 15 00 00 00 01 00 02 82 d8 15 00 00 00 01 00 02 83 00 15 00 00 00 01 00 02 84 fd 15 00 00 00 01 00 02 85 01 15 00 00 00 01 00 02 86 1e 15 00 00 00 01 00 02 87 01 15 00 00 00 01 00 02 88 58 15 00 00 00 01 00 02 89 01 15 00 00 00 01 00 02 8a 85 15 00 00 00 01 00 02 8b 01 15 00 00 00 01 00 02 8c c7 15 00 00 00 01 00 02 8d 01 15 00 00 00 01 00 02 8e ff 15 00 00 00 01 00 02 8f 02 15 00 00 00 01 00 02 90 01 15 00 00 00 01 00 02 91 02 15 00 00 00 01 00 02 92 36 15 00 00 00 01 00 02 93 02 15 00 00 00 01 00 02 94 76 15 00 00 00 01 00 02 95 02 15 00 00 00 01 00 02 96 a4 15 00 00 00 01 00 02 97 02 15 00 00 00 01 00 02 98 e0 15 00 00 00 01 00 02 99 03 15 00 00 00 01 00 02 9a 06 15 00 00 00 01 00 02 9b 03 15 00 00 00 01 00 02 9c 3e 15 00 00 00 01 00 02 9d 03 15 00 00 00 01 00 02 9e 50 15 00 00 00 01 00 02 9f 03 15 00 00 00 01 00 02 a0 64 15 00 00 00 01 00 02 a2 03 15 00 00 00 01 00 02 a3 7a 15 00 00 00 01 00 02 a4 03 15 00 00 00 01 00 02 a5 92 15 00 00 00 01 00 02 a6 03 15 00 00 00 01 00 02 a7 ad 15 00 00 00 01 00 02 a9 03 15 00 00 00 01 00 02 aa cc 15 00 00 00 01 00 02 ab 03 15 00 00 00 01 00 02 ac ee 15 00 00 00 01 00 02 ad 03 15 00 00 00 01 00 02 ae ff 15 00 00 00 01 00 02 af 00 15 00 00 00 01 00 02 b0 c3 15 00 00 00 01 00 02 b1 00 15 00 00 00 01 00 02 b2 c8 15 00 00 00 01 00 02 b3 00 15 00 00 00 01 00 02 b4 d3 15 00 00 00 01 00 02 b5 00 15 00 00 00 01 00 02 b6 dd 15 00 00 00 01 00 02 b7 00 15 00 00 00 01 00 02 b8 e6 15 00 00 00 01 00 02 b9 00 15 00 00 00 01 00 02 ba ee 15 00 00 00 01 00 02 bb 00 15 00 00 00 01 00 02 bc f7 15 00 00 00 01 00 02 bd 00 15 00 00 00 01 00 02 be ff 15 00 00 00 01 00 02 bf 01 15 00 00 00 01 00 02 c0 07 15 00 00 00 01 00 02 c1 01 15 00 00 00 01 00 02 c2 23 15 00 00 00 01 00 02 c3 01 15 00 00 00 01 00 02 c4 3a 15 00 00 00 01 00 02 c5 01 15 00 00 00 01 00 02 c6 61 15 00 00 00 01 00 02 c7 01 15 00 00 00 01 00 02 c8 85 15 00 00 00 01 00 02 c9 01 15 00 00 00 01 00 02 ca c7 15 00 00 00 01 00 02 cb 01 15 00 00 00 01 00 02 cc ff 15 00 00 00 01 00 02 cd 02 15 00 00 00 01 00 02 ce 01 15 00 00 00 01 00 02 cf 02 15 00 00 00 01 00 02 d0 36 15 00 00 00 01 00 02 d1 02 15 00 00 00 01 00 02 d2 76 15 00 00 00 01 00 02 d3 02 15 00 00 00 01 00 02 d4 a4 15 00 00 00 01 00 02 d5 02 15 00 00 00 01 00 02 d6 e0 15 00 00 00 01 00 02 d7 03 15 00 00 00 01 00 02 d8 06 15 00 00 00 01 00 02 d9 03 15 00 00 00 01 00 02 da 3e 15 00 00 00 01 00 02 db 03 15 00 00 00 01 00 02 dc 50 15 00 00 00 01 00 02 dd 03 15 00 00 00 01 00 02 de 64 15 00 00 00 01 00 02 df 03 15 00 00 00 01 00 02 e0 7a 15 00 00 00 01 00 02 e1 03 15 00 00 00 01 00 02 e2 92 15 00 00 00 01 00 02 e3 03 15 00 00 00 01 00 02 e4 ad 15 00 00 00 01 00 02 e5 03 15 00 00 00 01 00 02 e6 cc 15 00 00 00 01 00 02 e7 03 15 00 00 00 01 00 02 e8 ee 15 00 00 00 01 00 02 e9 03 15 00 00 00 01 00 02 ea ff 15 00 00 00 01 00 02 eb 30 15 00 00 00 01 00 02 ec 17 15 00 00 00 01 00 02 ed 20 15 00 00 00 01 00 02 ee 0f 15 00 00 00 01 00 02 ef 1f 15 00 00 00 01 00 02 f0 0f 15 00 00 00 01 00 02 f1 0f 15 00 00 00 01 00 02 f2 07 15 00 00 00 01 00 02 fb 01 15 01 00 00 01 00 02 ff 10];
        qcom,mdss-dsi-dispparam-default-command-state = "dsi_hs_mode";
        qcom,mdss-dsi-dispparam-cold-command = [15 00 00 00 01 00 02 ff 20 15 00 00 00 01 00 02 75 00 15 00 00 00 01 00 02 76 32 15 00 00 00 01 00 02 77 00 15 00 00 00 01 00 02 78 3c 15 00 00 00 01 00 02 79 00 15 00 00 00 01 00 02 7a 50 15 00 00 00 01 00 02 7b 00 15 00 00 00 01 00 02 7c 61 15 00 00 00 01 00 02 7d 00 15 00 00 00 01 00 02 7e 72 15 00 00 00 01 00 02 7f 00 15 00 00 00 01 00 02 80 81 15 00 00 00 01 00 02 81 00 15 00 00 00 01 00 02 82 8f 15 00 00 00 01 00 02 83 00 15 00 00 00 01 00 02 84 9d 15 00 00 00 01 00 02 85 00 15 00 00 00 01 00 02 86 aa 15 00 00 00 01 00 02 87 00 15 00 00 00 01 00 02 88 d8 15 00 00 00 01 00 02 89 00 15 00 00 00 01 00 02 8a ff 15 00 00 00 01 00 02 8b 01 15 00 00 00 01 00 02 8c 43 15 00 00 00 01 00 02 8d 01 15 00 00 00 01 00 02 8e 74 15 00 00 00 01 00 02 8f 01 15 00 00 00 01 00 02 90 bd 15 00 00 00 01 00 02 91 01 15 00 00 00 01 00 02 92 f8 15 00 00 00 01 00 02 93 01 15 00 00 00 01 00 02 94 f9 15 00 00 00 01 00 02 95 02 15 00 00 00 01 00 02 96 31 15 00 00 00 01 00 02 97 02 15 00 00 00 01 00 02 98 72 15 00 00 00 01 00 02 99 02 15 00 00 00 01 00 02 9a a0 15 00 00 00 01 00 02 9b 02 15 00 00 00 01 00 02 9c dd 15 00 00 00 01 00 02 9d 03 15 00 00 00 01 00 02 9e 08 15 00 00 00 01 00 02 9f 03 15 00 00 00 01 00 02 a0 46 15 00 00 00 01 00 02 a2 03 15 00 00 00 01 00 02 a3 58 15 00 00 00 01 00 02 a4 03 15 00 00 00 01 00 02 a5 6d 15 00 00 00 01 00 02 a6 03 15 00 00 00 01 00 02 a7 83 15 00 00 00 01 00 02 a9 03 15 00 00 00 01 00 02 aa 9a 15 00 00 00 01 00 02 ab 03 15 00 00 00 01 00 02 ac b4 15 00 00 00 01 00 02 ad 03 15 00 00 00 01 00 02 ae d1 15 00 00 00 01 00 02 af 03 15 00 00 00 01 00 02 b0 f0 15 00 00 00 01 00 02 b1 03 15 00 00 00 01 00 02 b2 ff 15 00 00 00 01 00 02 b3 00 15 00 00 00 01 00 02 b4 79 15 00 00 00 01 00 02 b5 00 15 00 00 00 01 00 02 b6 82 15 00 00 00 01 00 02 b7 00 15 00 00 00 01 00 02 b8 93 15 00 00 00 01 00 02 b9 00 15 00 00 00 01 00 02 ba a2 15 00 00 00 01 00 02 bb 00 15 00 00 00 01 00 02 bc b0 15 00 00 00 01 00 02 bd 00 15 00 00 00 01 00 02 be bc 15 00 00 00 01 00 02 bf 00 15 00 00 00 01 00 02 c0 c7 15 00 00 00 01 00 02 c1 00 15 00 00 00 01 00 02 c2 d4 15 00 00 00 01 00 02 c3 00 15 00 00 00 01 00 02 c4 de 15 00 00 00 01 00 02 c5 01 15 00 00 00 01 00 02 c6 01 15 00 00 00 01 00 02 c7 01 15 00 00 00 01 00 02 c8 1e 15 00 00 00 01 00 02 c9 01 15 00 00 00 01 00 02 ca 4d 15 00 00 00 01 00 02 cb 01 15 00 00 00 01 00 02 cc 74 15 00 00 00 01 00 02 cd 01 15 00 00 00 01 00 02 ce bd 15 00 00 00 01 00 02 cf 01 15 00 00 00 01 00 02 d0 f8 15 00 00 00 01 00 02 d1 01 15 00 00 00 01 00 02 d2 f9 15 00 00 00 01 00 02 d3 02 15 00 00 00 01 00 02 d4 31 15 00 00 00 01 00 02 d5 02 15 00 00 00 01 00 02 d6 72 15 00 00 00 01 00 02 d7 02 15 00 00 00 01 00 02 d8 a0 15 00 00 00 01 00 02 d9 02 15 00 00 00 01 00 02 da dd 15 00 00 00 01 00 02 db 03 15 00 00 00 01 00 02 dc 08 15 00 00 00 01 00 02 dd 03 15 00 00 00 01 00 02 de 46 15 00 00 00 01 00 02 df 03 15 00 00 00 01 00 02 e0 58 15 00 00 00 01 00 02 e1 03 15 00 00 00 01 00 02 e2 6d 15 00 00 00 01 00 02 e3 03 15 00 00 00 01 00 02 e4 83 15 00 00 00 01 00 02 e5 03 15 00 00 00 01 00 02 e6 9a 15 00 00 00 01 00 02 e7 03 15 00 00 00 01 00 02 e8 b4 15 00 00 00 01 00 02 e9 03 15 00 00 00 01 00 02 ea d1 15 00 00 00 01 00 02 eb 03 15 00 00 00 01 00 02 ec f0 15 00 00 00 01 00 02 ed 03 15 00 00 00 01 00 02 ee ff 15 00 00 00 01 00 02 ef 00 15 00 00 00 01 00 02 f0 00 15 00 00 00 01 00 02 f1 00 15 00 00 00 01 00 02 f2 0e 15 00 00 00 01 00 02 f3 00 15 00 00 00 01 00 02 f4 28 15 00 00 00 01 00 02 f5 00 15 00 00 00 01 00 02 f6 3b 15 00 00 00 01 00 02 f7 00 15 00 00 00 01 00 02 f8 50 15 00 00 00 01 00 02 f9 00 15 00 00 00 01 00 02 fa 61 15 00 00 00 01 00 02 fb 01 15 00 00 00 01 00 02 ff 21 15 00 00 00 01 00 02 00 00 15 00 00 00 01 00 02 01 72 15 00 00 00 01 00 02 02 00 15 00 00 00 01 00 02 03 82 15 00 00 00 01 00 02 04 00 15 00 00 00 01 00 02 05 91 15 00 00 00 01 00 02 06 00 15 00 00 00 01 00 02 07 c4 15 00 00 00 01 00 02 08 00 15 00 00 00 01 00 02 09 ee 15 00 00 00 01 00 02 0a 01 15 00 00 00 01 00 02 0b 35 15 00 00 00 01 00 02 0c 01 15 00 00 00 01 00 02 0d 6b 15 00 00 00 01 00 02 0e 01 15 00 00 00 01 00 02 0f b6 15 00 00 00 01 00 02 10 01 15 00 00 00 01 00 02 11 f4 15 00 00 00 01 00 02 12 01 15 00 00 00 01 00 02 13 f5 15 00 00 00 01 00 02 14 02 15 00 00 00 01 00 02 15 2d 15 00 00 00 01 00 02 16 02 15 00 00 00 01 00 02 17 6e 15 00 00 00 01 00 02 18 02 15 00 00 00 01 00 02 19 9c 15 00 00 00 01 00 02 1a 02 15 00 00 00 01 00 02 1b d6 15 00 00 00 01 00 02 1c 03 15 00 00 00 01 00 02 1d 04 15 00 00 00 01 00 02 1e 03 15 00 00 00 01 00 02 1f 42 15 00 00 00 01 00 02 20 03 15 00 00 00 01 00 02 21 54 15 00 00 00 01 00 02 22 03 15 00 00 00 01 00 02 23 69 15 00 00 00 01 00 02 24 03 15 00 00 00 01 00 02 25 80 15 00 00 00 01 00 02 26 03 15 00 00 00 01 00 02 27 97 15 00 00 00 01 00 02 28 03 15 00 00 00 01 00 02 29 b2 15 00 00 00 01 00 02 2a 03 15 00 00 00 01 00 02 2b cf 15 00 00 00 01 00 02 2d 03 15 00 00 00 01 00 02 2f f0 15 00 00 00 01 00 02 30 03 15 00 00 00 01 00 02 31 ff 15 00 00 00 01 00 02 32 00 15 00 00 00 01 00 02 33 4a 15 00 00 00 01 00 02 34 00 15 00 00 00 01 00 02 35 57 15 00 00 00 01 00 02 36 00 15 00 00 00 01 00 02 37 6e 15 00 00 00 01 00 02 38 00 15 00 00 00 01 00 02 39 7f 15 00 00 00 01 00 02 3a 00 15 00 00 00 01 00 02 3b 90 15 00 00 00 01 00 02 3d 00 15 00 00 00 01 00 02 3f 9f 15 00 00 00 01 00 02 40 00 15 00 00 00 01 00 02 41 ae 15 00 00 00 01 00 02 42 00 15 00 00 00 01 00 02 43 bb 15 00 00 00 01 00 02 44 00 15 00 00 00 01 00 02 45 c7 15 00 00 00 01 00 02 46 00 15 00 00 00 01 00 02 47 ef 15 00 00 00 01 00 02 48 01 15 00 00 00 01 00 02 49 0e 15 00 00 00 01 00 02 4a 01 15 00 00 00 01 00 02 4b 40 15 00 00 00 01 00 02 4c 01 15 00 00 00 01 00 02 4d 6b 15 00 00 00 01 00 02 4e 01 15 00 00 00 01 00 02 4f b6 15 00 00 00 01 00 02 50 01 15 00 00 00 01 00 02 51 f4 15 00 00 00 01 00 02 52 01 15 00 00 00 01 00 02 53 f5 15 00 00 00 01 00 02 54 02 15 00 00 00 01 00 02 55 2d 15 00 00 00 01 00 02 56 02 15 00 00 00 01 00 02 58 6e 15 00 00 00 01 00 02 59 02 15 00 00 00 01 00 02 5a 9c 15 00 00 00 01 00 02 5b 02 15 00 00 00 01 00 02 5c d6 15 00 00 00 01 00 02 5d 03 15 00 00 00 01 00 02 5e 04 15 00 00 00 01 00 02 5f 03 15 00 00 00 01 00 02 60 42 15 00 00 00 01 00 02 61 03 15 00 00 00 01 00 02 62 54 15 00 00 00 01 00 02 63 03 15 00 00 00 01 00 02 64 69 15 00 00 00 01 00 02 65 03 15 00 00 00 01 00 02 66 80 15 00 00 00 01 00 02 67 03 15 00 00 00 01 00 02 68 97 15 00 00 00 01 00 02 69 03 15 00 00 00 01 00 02 6a b2 15 00 00 00 01 00 02 6b 03 15 00 00 00 01 00 02 6c cf 15 00 00 00 01 00 02 6d 03 15 00 00 00 01 00 02 6e f0 15 00 00 00 01 00 02 6f 03 15 00 00 00 01 00 02 70 ff 15 00 00 00 01 00 02 71 00 15 00 00 00 01 00 02 72 17 15 00 00 00 01 00 02 73 00 15 00 00 00 01 00 02 74 22 15 00 00 00 01 00 02 75 00 15 00 00 00 01 00 02 76 39 15 00 00 00 01 00 02 77 00 15 00 00 00 01 00 02 78 4b 15 00 00 00 01 00 02 79 00 15 00 00 00 01 00 02 7a 5f 15 00 00 00 01 00 02 7b 00 15 00 00 00 01 00 02 7c 6f 15 00 00 00 01 00 02 7d 00 15 00 00 00 01 00 02 7e 7e 15 00 00 00 01 00 02 7f 00 15 00 00 00 01 00 02 80 8c 15 00 00 00 01 00 02 81 00 15 00 00 00 01 00 02 82 9b 15 00 00 00 01 00 02 83 00 15 00 00 00 01 00 02 84 cb 15 00 00 00 01 00 02 85 00 15 00 00 00 01 00 02 86 f5 15 00 00 00 01 00 02 87 01 15 00 00 00 01 00 02 88 3a 15 00 00 00 01 00 02 89 01 15 00 00 00 01 00 02 8a 6f 15 00 00 00 01 00 02 8b 01 15 00 00 00 01 00 02 8c b9 15 00 00 00 01 00 02 8d 01 15 00 00 00 01 00 02 8e f6 15 00 00 00 01 00 02 8f 01 15 00 00 00 01 00 02 90 f7 15 00 00 00 01 00 02 91 02 15 00 00 00 01 00 02 92 2f 15 00 00 00 01 00 02 93 02 15 00 00 00 01 00 02 94 70 15 00 00 00 01 00 02 95 02 15 00 00 00 01 00 02 96 9f 15 00 00 00 01 00 02 97 02 15 00 00 00 01 00 02 98 e0 15 00 00 00 01 00 02 99 03 15 00 00 00 01 00 02 9a 06 15 00 00 00 01 00 02 9b 03 15 00 00 00 01 00 02 9c 38 15 00 00 00 01 00 02 9d 03 15 00 00 00 01 00 02 9e 4b 15 00 00 00 01 00 02 9f 03 15 00 00 00 01 00 02 a0 60 15 00 00 00 01 00 02 a2 03 15 00 00 00 01 00 02 a3 78 15 00 00 00 01 00 02 a4 03 15 00 00 00 01 00 02 a5 90 15 00 00 00 01 00 02 a6 03 15 00 00 00 01 00 02 a7 ac 15 00 00 00 01 00 02 a9 03 15 00 00 00 01 00 02 aa cc 15 00 00 00 01 00 02 ab 03 15 00 00 00 01 00 02 ac ee 15 00 00 00 01 00 02 ad 03 15 00 00 00 01 00 02 ae ff 15 00 00 00 01 00 02 af 00 15 00 00 00 01 00 02 b0 60 15 00 00 00 01 00 02 b1 00 15 00 00 00 01 00 02 b2 69 15 00 00 00 01 00 02 b3 00 15 00 00 00 01 00 02 b4 7d 15 00 00 00 01 00 02 b5 00 15 00 00 00 01 00 02 b6 8d 15 00 00 00 01 00 02 b7 00 15 00 00 00 01 00 02 b8 9e 15 00 00 00 01 00 02 b9 00 15 00 00 00 01 00 02 ba ac 15 00 00 00 01 00 02 bb 00 15 00 00 00 01 00 02 bc b9 15 00 00 00 01 00 02 bd 00 15 00 00 00 01 00 02 be c4 15 00 00 00 01 00 02 bf 00 15 00 00 00 01 00 02 c0 d0 15 00 00 00 01 00 02 c1 00 15 00 00 00 01 00 02 c2 f5 15 00 00 00 01 00 02 c3 01 15 00 00 00 01 00 02 c4 14 15 00 00 00 01 00 02 c5 01 15 00 00 00 01 00 02 c6 45 15 00 00 00 01 00 02 c7 01 15 00 00 00 01 00 02 c8 6f 15 00 00 00 01 00 02 c9 01 15 00 00 00 01 00 02 ca b9 15 00 00 00 01 00 02 cb 01 15 00 00 00 01 00 02 cc f6 15 00 00 00 01 00 02 cd 01 15 00 00 00 01 00 02 ce f7 15 00 00 00 01 00 02 cf 02 15 00 00 00 01 00 02 d0 2f 15 00 00 00 01 00 02 d1 02 15 00 00 00 01 00 02 d2 70 15 00 00 00 01 00 02 d3 02 15 00 00 00 01 00 02 d4 9f 15 00 00 00 01 00 02 d5 02 15 00 00 00 01 00 02 d6 e0 15 00 00 00 01 00 02 d7 03 15 00 00 00 01 00 02 d8 06 15 00 00 00 01 00 02 d9 03 15 00 00 00 01 00 02 da 38 15 00 00 00 01 00 02 db 03 15 00 00 00 01 00 02 dc 4b 15 00 00 00 01 00 02 dd 03 15 00 00 00 01 00 02 de 60 15 00 00 00 01 00 02 df 03 15 00 00 00 01 00 02 e0 78 15 00 00 00 01 00 02 e1 03 15 00 00 00 01 00 02 e2 90 15 00 00 00 01 00 02 e3 03 15 00 00 00 01 00 02 e4 ac 15 00 00 00 01 00 02 e5 03 15 00 00 00 01 00 02 e6 cc 15 00 00 00 01 00 02 e7 03 15 00 00 00 01 00 02 e8 ee 15 00 00 00 01 00 02 e9 03 15 00 00 00 01 00 02 ea ff 15 00 00 00 01 00 02 eb 30 15 00 00 00 01 00 02 ec 17 15 00 00 00 01 00 02 ed 20 15 00 00 00 01 00 02 ee 0f 15 00 00 00 01 00 02 ef 1f 15 00 00 00 01 00 02 f0 0f 15 00 00 00 01 00 02 f1 0f 15 00 00 00 01 00 02 f2 07 15 00 00 00 01 00 02 fb 01 15 01 00 00 01 00 02 ff 10];
        qcom,mdss-dsi-dispparam-cold-command-state = "dsi_hs_mode";
        qcom,mdss-dsi-dispparam-papermode-command = [15 01 00 00 78 00 02 ff 20 15 00 00 00 01 00 02 fb 01 15 00 00 00 01 00 02 75 01 15 00 00 00 01 00 02 76 60 15 00 00 00 01 00 02 77 01 15 00 00 00 01 00 02 78 63 15 00 00 00 01 00 02 79 01 15 00 00 00 01 00 02 7a 68 15 00 00 00 01 00 02 7b 01 15 00 00 00 01 00 02 7c 6e 15 00 00 00 01 00 02 7d 01 15 00 00 00 01 00 02 7e 73 15 00 00 00 01 00 02 7f 01 15 00 00 00 01 00 02 80 78 15 00 00 00 01 00 02 81 01 15 00 00 00 01 00 02 82 7d 15 00 00 00 01 00 02 83 01 15 00 00 00 01 00 02 84 82 15 00 00 00 01 00 02 85 01 15 00 00 00 01 00 02 86 87 15 00 00 00 01 00 02 87 01 15 00 00 00 01 00 02 88 99 15 00 00 00 01 00 02 89 01 15 00 00 00 01 00 02 8a aa 15 00 00 00 01 00 02 8b 01 15 00 00 00 01 00 02 8c c9 15 00 00 00 01 00 02 8d 01 15 00 00 00 01 00 02 8e e5 15 00 00 00 01 00 02 8f 02 15 00 00 00 01 00 02 90 0c 15 00 00 00 01 00 02 91 02 15 00 00 00 01 00 02 92 31 15 00 00 00 01 00 02 93 02 15 00 00 00 01 00 02 94 33 15 00 00 00 01 00 02 95 02 15 00 00 00 01 00 02 96 60 15 00 00 00 01 00 02 97 02 15 00 00 00 01 00 02 98 9b 15 00 00 00 01 00 02 99 02 15 00 00 00 01 00 02 9a c4 15 00 00 00 01 00 02 9b 02 15 00 00 00 01 00 02 9c fa 15 00 00 00 01 00 02 9d 03 15 00 00 00 01 00 02 9e 17 15 00 00 00 01 00 02 9f 03 15 00 00 00 01 00 02 a0 4e 15 00 00 00 01 00 02 a2 03 15 00 00 00 01 00 02 a3 60 15 00 00 00 01 00 02 a4 03 15 00 00 00 01 00 02 a5 73 15 00 00 00 01 00 02 a6 03 15 00 00 00 01 00 02 a7 86 15 00 00 00 01 00 02 a9 03 15 00 00 00 01 00 02 aa 98 15 00 00 00 01 00 02 ab 03 15 00 00 00 01 00 02 ac a7 15 00 00 00 01 00 02 ad 03 15 00 00 00 01 00 02 ae b1 15 00 00 00 01 00 02 af 03 15 00 00 00 01 00 02 b0 b6 15 00 00 00 01 00 02 b1 03 15 00 00 00 01 00 02 b2 ff 15 00 00 00 01 00 02 b3 01 15 00 00 00 01 00 02 b4 60 15 00 00 00 01 00 02 b5 01 15 00 00 00 01 00 02 b6 63 15 00 00 00 01 00 02 b7 01 15 00 00 00 01 00 02 b8 68 15 00 00 00 01 00 02 b9 01 15 00 00 00 01 00 02 ba 6e 15 00 00 00 01 00 02 bb 01 15 00 00 00 01 00 02 bc 73 15 00 00 00 01 00 02 bd 01 15 00 00 00 01 00 02 be 78 15 00 00 00 01 00 02 bf 01 15 00 00 00 01 00 02 c0 7d 15 00 00 00 01 00 02 c1 01 15 00 00 00 01 00 02 c2 82 15 00 00 00 01 00 02 c3 01 15 00 00 00 01 00 02 c4 87 15 00 00 00 01 00 02 c5 01 15 00 00 00 01 00 02 c6 99 15 00 00 00 01 00 02 c7 01 15 00 00 00 01 00 02 c8 aa 15 00 00 00 01 00 02 c9 01 15 00 00 00 01 00 02 ca c9 15 00 00 00 01 00 02 cb 01 15 00 00 00 01 00 02 cc e5 15 00 00 00 01 00 02 cd 02 15 00 00 00 01 00 02 ce 0c 15 00 00 00 01 00 02 cf 02 15 00 00 00 01 00 02 d0 31 15 00 00 00 01 00 02 d1 02 15 00 00 00 01 00 02 d2 33 15 00 00 00 01 00 02 d3 02 15 00 00 00 01 00 02 d4 60 15 00 00 00 01 00 02 d5 02 15 00 00 00 01 00 02 d6 9b 15 00 00 00 01 00 02 d7 02 15 00 00 00 01 00 02 d8 c4 15 00 00 00 01 00 02 d9 02 15 00 00 00 01 00 02 da fa 15 00 00 00 01 00 02 db 03 15 00 00 00 01 00 02 dc 17 15 00 00 00 01 00 02 dd 03 15 00 00 00 01 00 02 de 4e 15 00 00 00 01 00 02 df 03 15 00 00 00 01 00 02 e0 60 15 00 00 00 01 00 02 e1 03 15 00 00 00 01 00 02 e2 73 15 00 00 00 01 00 02 e3 03 15 00 00 00 01 00 02 e4 86 15 00 00 00 01 00 02 e5 03 15 00 00 00 01 00 02 e6 98 15 00 00 00 01 00 02 e7 03 15 00 00 00 01 00 02 e8 a7 15 00 00 00 01 00 02 e9 03 15 00 00 00 01 00 02 ea b1 15 00 00 00 01 00 02 eb 03 15 00 00 00 01 00 02 ec b6 15 00 00 00 01 00 02 ed 03 15 00 00 00 01 00 02 ee ff 15 00 00 00 01 00 02 ef 01 15 00 00 00 01 00 02 f0 6a 15 00 00 00 01 00 02 f1 01 15 00 00 00 01 00 02 f2 6d 15 00 00 00 01 00 02 f3 01 15 00 00 00 01 00 02 f4 72 15 00 00 00 01 00 02 f5 01 15 00 00 00 01 00 02 f6 77 15 00 00 00 01 00 02 f7 01 15 00 00 00 01 00 02 f8 7c 15 00 00 00 01 00 02 f9 01 15 00 00 00 01 00 02 fa 81 15 00 00 00 01 00 02 ff 21 15 00 00 00 01 00 02 fb 01 15 00 00 00 01 00 02 00 01 15 00 00 00 01 00 02 01 86 15 00 00 00 01 00 02 02 01 15 00 00 00 01 00 02 03 8a 15 00 00 00 01 00 02 04 01 15 00 00 00 01 00 02 05 8f 15 00 00 00 01 00 02 06 01 15 00 00 00 01 00 02 07 a0 15 00 00 00 01 00 02 08 01 15 00 00 00 01 00 02 09 b0 15 00 00 00 01 00 02 0a 01 15 00 00 00 01 00 02 0b ce 15 00 00 00 01 00 02 0c 01 15 00 00 00 01 00 02 0d ea 15 00 00 00 01 00 02 0e 02 15 00 00 00 01 00 02 0f 0f 15 00 00 00 01 00 02 10 02 15 00 00 00 01 00 02 11 34 15 00 00 00 01 00 02 12 02 15 00 00 00 01 00 02 13 35 15 00 00 00 01 00 02 14 02 15 00 00 00 01 00 02 15 62 15 00 00 00 01 00 02 16 02 15 00 00 00 01 00 02 17 9e 15 00 00 00 01 00 02 18 02 15 00 00 00 01 00 02 19 c6 15 00 00 00 01 00 02 1a 02 15 00 00 00 01 00 02 1b fa 15 00 00 00 01 00 02 1c 03 15 00 00 00 01 00 02 1d 16 15 00 00 00 01 00 02 1e 03 15 00 00 00 01 00 02 1f 48 15 00 00 00 01 00 02 20 03 15 00 00 00 01 00 02 21 57 15 00 00 00 01 00 02 22 03 15 00 00 00 01 00 02 23 68 15 00 00 00 01 00 02 24 03 15 00 00 00 01 00 02 25 7b 15 00 00 00 01 00 02 26 03 15 00 00 00 01 00 02 27 91 15 00 00 00 01 00 02 28 03 15 00 00 00 01 00 02 29 a9 15 00 00 00 01 00 02 2a 03 15 00 00 00 01 00 02 2b bf 15 00 00 00 01 00 02 2d 03 15 00 00 00 01 00 02 2f cc 15 00 00 00 01 00 02 30 03 15 00 00 00 01 00 02 31 ff 15 00 00 00 01 00 02 32 01 15 00 00 00 01 00 02 33 6a 15 00 00 00 01 00 02 34 01 15 00 00 00 01 00 02 35 6d 15 00 00 00 01 00 02 36 01 15 00 00 00 01 00 02 37 72 15 00 00 00 01 00 02 38 01 15 00 00 00 01 00 02 39 77 15 00 00 00 01 00 02 3a 01 15 00 00 00 01 00 02 3b 7c 15 00 00 00 01 00 02 3d 01 15 00 00 00 01 00 02 3f 81 15 00 00 00 01 00 02 40 01 15 00 00 00 01 00 02 41 86 15 00 00 00 01 00 02 42 01 15 00 00 00 01 00 02 43 8a 15 00 00 00 01 00 02 44 01 15 00 00 00 01 00 02 45 8f 15 00 00 00 01 00 02 46 01 15 00 00 00 01 00 02 47 a0 15 00 00 00 01 00 02 48 01 15 00 00 00 01 00 02 49 b0 15 00 00 00 01 00 02 4a 01 15 00 00 00 01 00 02 4b ce 15 00 00 00 01 00 02 4c 01 15 00 00 00 01 00 02 4d ea 15 00 00 00 01 00 02 4e 02 15 00 00 00 01 00 02 4f 0f 15 00 00 00 01 00 02 50 02 15 00 00 00 01 00 02 51 34 15 00 00 00 01 00 02 52 02 15 00 00 00 01 00 02 53 35 15 00 00 00 01 00 02 54 02 15 00 00 00 01 00 02 55 62 15 00 00 00 01 00 02 56 02 15 00 00 00 01 00 02 58 9e 15 00 00 00 01 00 02 59 02 15 00 00 00 01 00 02 5a c6 15 00 00 00 01 00 02 5b 02 15 00 00 00 01 00 02 5c fa 15 00 00 00 01 00 02 5d 03 15 00 00 00 01 00 02 5e 16 15 00 00 00 01 00 02 5f 03 15 00 00 00 01 00 02 60 48 15 00 00 00 01 00 02 61 03 15 00 00 00 01 00 02 62 57 15 00 00 00 01 00 02 63 03 15 00 00 00 01 00 02 64 68 15 00 00 00 01 00 02 65 03 15 00 00 00 01 00 02 66 7b 15 00 00 00 01 00 02 67 03 15 00 00 00 01 00 02 68 91 15 00 00 00 01 00 02 69 03 15 00 00 00 01 00 02 6a a9 15 00 00 00 01 00 02 6b 03 15 00 00 00 01 00 02 6c bf 15 00 00 00 01 00 02 6d 03 15 00 00 00 01 00 02 6e cc 15 00 00 00 01 00 02 6f 03 15 00 00 00 01 00 02 70 ff 15 00 00 00 01 00 02 71 02 15 00 00 00 01 00 02 72 15 15 00 00 00 01 00 02 73 02 15 00 00 00 01 00 02 74 16 15 00 00 00 01 00 02 75 02 15 00 00 00 01 00 02 76 17 15 00 00 00 01 00 02 77 02 15 00 00 00 01 00 02 78 18 15 00 00 00 01 00 02 79 02 15 00 00 00 01 00 02 7a 1a 15 00 00 00 01 00 02 7b 02 15 00 00 00 01 00 02 7c 1b 15 00 00 00 01 00 02 7d 02 15 00 00 00 01 00 02 7e 1c 15 00 00 00 01 00 02 7f 02 15 00 00 00 01 00 02 80 1e 15 00 00 00 01 00 02 81 02 15 00 00 00 01 00 02 82 1f 15 00 00 00 01 00 02 83 02 15 00 00 00 01 00 02 84 25 15 00 00 00 01 00 02 85 02 15 00 00 00 01 00 02 86 2b 15 00 00 00 01 00 02 87 02 15 00 00 00 01 00 02 88 37 15 00 00 00 01 00 02 89 02 15 00 00 00 01 00 02 8a 43 15 00 00 00 01 00 02 8b 02 15 00 00 00 01 00 02 8c 5f 15 00 00 00 01 00 02 8d 02 15 00 00 00 01 00 02 8e 7f 15 00 00 00 01 00 02 8f 02 15 00 00 00 01 00 02 90 80 15 00 00 00 01 00 02 91 02 15 00 00 00 01 00 02 92 a9 15 00 00 00 01 00 02 93 02 15 00 00 00 01 00 02 94 e0 15 00 00 00 01 00 02 95 03 15 00 00 00 01 00 02 96 03 15 00 00 00 01 00 02 97 03 15 00 00 00 01 00 02 98 35 15 00 00 00 01 00 02 99 03 15 00 00 00 01 00 02 9a 5d 15 00 00 00 01 00 02 9b 03 15 00 00 00 01 00 02 9c 89 15 00 00 00 01 00 02 9d 03 15 00 00 00 01 00 02 9e 93 15 00 00 00 01 00 02 9f 03 15 00 00 00 01 00 02 a0 9d 15 00 00 00 01 00 02 a2 03 15 00 00 00 01 00 02 a3 a5 15 00 00 00 01 00 02 a4 03 15 00 00 00 01 00 02 a5 ac 15 00 00 00 01 00 02 a6 03 15 00 00 00 01 00 02 a7 b1 15 00 00 00 01 00 02 a9 03 15 00 00 00 01 00 02 aa b5 15 00 00 00 01 00 02 ab 03 15 00 00 00 01 00 02 ac b6 15 00 00 00 01 00 02 ad 03 15 00 00 00 01 00 02 ae ff 15 00 00 00 01 00 02 af 02 15 00 00 00 01 00 02 b0 15 15 00 00 00 01 00 02 b1 02 15 00 00 00 01 00 02 b2 16 15 00 00 00 01 00 02 b3 02 15 00 00 00 01 00 02 b4 17 15 00 00 00 01 00 02 b5 02 15 00 00 00 01 00 02 b6 18 15 00 00 00 01 00 02 b7 02 15 00 00 00 01 00 02 b8 1a 15 00 00 00 01 00 02 b9 02 15 00 00 00 01 00 02 ba 1b 15 00 00 00 01 00 02 bb 02 15 00 00 00 01 00 02 bc 1c 15 00 00 00 01 00 02 bd 02 15 00 00 00 01 00 02 be 1e 15 00 00 00 01 00 02 bf 02 15 00 00 00 01 00 02 c0 1f 15 00 00 00 01 00 02 c1 02 15 00 00 00 01 00 02 c2 25 15 00 00 00 01 00 02 c3 02 15 00 00 00 01 00 02 c4 2b 15 00 00 00 01 00 02 c5 02 15 00 00 00 01 00 02 c6 37 15 00 00 00 01 00 02 c7 02 15 00 00 00 01 00 02 c8 43 15 00 00 00 01 00 02 c9 02 15 00 00 00 01 00 02 ca 5f 15 00 00 00 01 00 02 cb 02 15 00 00 00 01 00 02 cc 7f 15 00 00 00 01 00 02 cd 02 15 00 00 00 01 00 02 ce 80 15 00 00 00 01 00 02 cf 02 15 00 00 00 01 00 02 d0 a9 15 00 00 00 01 00 02 d1 02 15 00 00 00 01 00 02 d2 e0 15 00 00 00 01 00 02 d3 03 15 00 00 00 01 00 02 d4 03 15 00 00 00 01 00 02 d5 03 15 00 00 00 01 00 02 d6 35 15 00 00 00 01 00 02 d7 03 15 00 00 00 01 00 02 d8 5d 15 00 00 00 01 00 02 d9 03 15 00 00 00 01 00 02 da 89 15 00 00 00 01 00 02 db 03 15 00 00 00 01 00 02 dc 93 15 00 00 00 01 00 02 dd 03 15 00 00 00 01 00 02 de 9d 15 00 00 00 01 00 02 df 03 15 00 00 00 01 00 02 e0 a5 15 00 00 00 01 00 02 e1 03 15 00 00 00 01 00 02 e2 ac 15 00 00 00 01 00 02 e3 03 15 00 00 00 01 00 02 e4 b1 15 00 00 00 01 00 02 e5 03 15 00 00 00 01 00 02 e6 b5 15 00 00 00 01 00 02 e7 03 15 00 00 00 01 00 02 e8 b6 15 00 00 00 01 00 02 e9 03 15 00 00 00 01 00 02 ea ff 15 00 00 00 01 00 02 fb 01 15 01 00 00 01 00 02 ff 10];
        qcom,mdss-dsi-dispparam-papermode-state = "dsi_hs_mode";
        qcom,mdss-dsi-dispparam-papermode1-command = [15 01 00 00 78 00 02 ff 20 15 00 00 00 01 00 02 fb 01 15 00 00 00 01 00 02 75 00 15 00 00 00 01 00 02 76 df 15 00 00 00 01 00 02 77 00 15 00 00 00 01 00 02 78 e0 15 00 00 00 01 00 02 79 00 15 00 00 00 01 00 02 7a ed 15 00 00 00 01 00 02 7b 00 15 00 00 00 01 00 02 7c f8 15 00 00 00 01 00 02 7d 01 15 00 00 00 01 00 02 7e 03 15 00 00 00 01 00 02 7f 01 15 00 00 00 01 00 02 80 0d 15 00 00 00 01 00 02 81 01 15 00 00 00 01 00 02 82 17 15 00 00 00 01 00 02 83 01 15 00 00 00 01 00 02 84 20 15 00 00 00 01 00 02 85 01 15 00 00 00 01 00 02 86 29 15 00 00 00 01 00 02 87 01 15 00 00 00 01 00 02 88 49 15 00 00 00 01 00 02 89 01 15 00 00 00 01 00 02 8a 65 15 00 00 00 01 00 02 8b 01 15 00 00 00 01 00 02 8c 92 15 00 00 00 01 00 02 8d 01 15 00 00 00 01 00 02 8e b8 15 00 00 00 01 00 02 8f 01 15 00 00 00 01 00 02 90 f6 15 00 00 00 01 00 02 91 02 15 00 00 00 01 00 02 92 1d 15 00 00 00 01 00 02 93 02 15 00 00 00 01 00 02 94 1f 15 00 00 00 01 00 02 95 02 15 00 00 00 01 00 02 96 4d 15 00 00 00 01 00 02 97 02 15 00 00 00 01 00 02 98 8a 15 00 00 00 01 00 02 99 02 15 00 00 00 01 00 02 9a b3 15 00 00 00 01 00 02 9b 02 15 00 00 00 01 00 02 9c eb 15 00 00 00 01 00 02 9d 03 15 00 00 00 01 00 02 9e 0c 15 00 00 00 01 00 02 9f 03 15 00 00 00 01 00 02 a0 3e 15 00 00 00 01 00 02 a2 03 15 00 00 00 01 00 02 a3 51 15 00 00 00 01 00 02 a4 03 15 00 00 00 01 00 02 a5 65 15 00 00 00 01 00 02 a6 03 15 00 00 00 01 00 02 a7 7a 15 00 00 00 01 00 02 a9 03 15 00 00 00 01 00 02 aa 90 15 00 00 00 01 00 02 ab 03 15 00 00 00 01 00 02 ac a3 15 00 00 00 01 00 02 ad 03 15 00 00 00 01 00 02 ae b0 15 00 00 00 01 00 02 af 03 15 00 00 00 01 00 02 b0 b6 15 00 00 00 01 00 02 b1 03 15 00 00 00 01 00 02 b2 ff 15 00 00 00 01 00 02 b3 00 15 00 00 00 01 00 02 b4 df 15 00 00 00 01 00 02 b5 00 15 00 00 00 01 00 02 b6 e0 15 00 00 00 01 00 02 b7 00 15 00 00 00 01 00 02 b8 ed 15 00 00 00 01 00 02 b9 00 15 00 00 00 01 00 02 ba f8 15 00 00 00 01 00 02 bb 01 15 00 00 00 01 00 02 bc 03 15 00 00 00 01 00 02 bd 01 15 00 00 00 01 00 02 be 0d 15 00 00 00 01 00 02 bf 01 15 00 00 00 01 00 02 c0 17 15 00 00 00 01 00 02 c1 01 15 00 00 00 01 00 02 c2 20 15 00 00 00 01 00 02 c3 01 15 00 00 00 01 00 02 c4 29 15 00 00 00 01 00 02 c5 01 15 00 00 00 01 00 02 c6 49 15 00 00 00 01 00 02 c7 01 15 00 00 00 01 00 02 c8 65 15 00 00 00 01 00 02 c9 01 15 00 00 00 01 00 02 ca 92 15 00 00 00 01 00 02 cb 01 15 00 00 00 01 00 02 cc b8 15 00 00 00 01 00 02 cd 01 15 00 00 00 01 00 02 ce f6 15 00 00 00 01 00 02 cf 02 15 00 00 00 01 00 02 d0 1d 15 00 00 00 01 00 02 d1 02 15 00 00 00 01 00 02 d2 1f 15 00 00 00 01 00 02 d3 02 15 00 00 00 01 00 02 d4 4d 15 00 00 00 01 00 02 d5 02 15 00 00 00 01 00 02 d6 8a 15 00 00 00 01 00 02 d7 02 15 00 00 00 01 00 02 d8 b3 15 00 00 00 01 00 02 d9 02 15 00 00 00 01 00 02 da eb 15 00 00 00 01 00 02 db 03 15 00 00 00 01 00 02 dc 0c 15 00 00 00 01 00 02 dd 03 15 00 00 00 01 00 02 de 3e 15 00 00 00 01 00 02 df 03 15 00 00 00 01 00 02 e0 51 15 00 00 00 01 00 02 e1 03 15 00 00 00 01 00 02 e2 65 15 00 00 00 01 00 02 e3 03 15 00 00 00 01 00 02 e4 7a 15 00 00 00 01 00 02 e5 03 15 00 00 00 01 00 02 e6 90 15 00 00 00 01 00 02 e7 03 15 00 00 00 01 00 02 e8 a3 15 00 00 00 01 00 02 e9 03 15 00 00 00 01 00 02 ea b0 15 00 00 00 01 00 02 eb 03 15 00 00 00 01 00 02 ec b6 15 00 00 00 01 00 02 ed 03 15 00 00 00 01 00 02 ee ff 15 00 00 00 01 00 02 ef 00 15 00 00 00 01 00 02 f0 df 15 00 00 00 01 00 02 f1 00 15 00 00 00 01 00 02 f2 e0 15 00 00 00 01 00 02 f3 00 15 00 00 00 01 00 02 f4 ed 15 00 00 00 01 00 02 f5 00 15 00 00 00 01 00 02 f6 f9 15 00 00 00 01 00 02 f7 01 15 00 00 00 01 00 02 f8 03 15 00 00 00 01 00 02 f9 01 15 00 00 00 01 00 02 fa 0e 15 00 00 00 01 00 02 ff 21 15 00 00 00 01 00 02 fb 01 15 00 00 00 01 00 02 00 01 15 00 00 00 01 00 02 01 17 15 00 00 00 01 00 02 02 01 15 00 00 00 01 00 02 03 21 15 00 00 00 01 00 02 04 01 15 00 00 00 01 00 02 05 2a 15 00 00 00 01 00 02 06 01 15 00 00 00 01 00 02 07 4a 15 00 00 00 01 00 02 08 01 15 00 00 00 01 00 02 09 65 15 00 00 00 01 00 02 0a 01 15 00 00 00 01 00 02 0b 92 15 00 00 00 01 00 02 0c 01 15 00 00 00 01 00 02 0d b8 15 00 00 00 01 00 02 0e 01 15 00 00 00 01 00 02 0f f7 15 00 00 00 01 00 02 10 02 15 00 00 00 01 00 02 11 1e 15 00 00 00 01 00 02 12 02 15 00 00 00 01 00 02 13 1f 15 00 00 00 01 00 02 14 02 15 00 00 00 01 00 02 15 4e 15 00 00 00 01 00 02 16 02 15 00 00 00 01 00 02 17 8a 15 00 00 00 01 00 02 18 02 15 00 00 00 01 00 02 19 b4 15 00 00 00 01 00 02 1a 02 15 00 00 00 01 00 02 1b ea 15 00 00 00 01 00 02 1c 03 15 00 00 00 01 00 02 1d 0a 15 00 00 00 01 00 02 1e 03 15 00 00 00 01 00 02 1f 39 15 00 00 00 01 00 02 20 03 15 00 00 00 01 00 02 21 49 15 00 00 00 01 00 02 22 03 15 00 00 00 01 00 02 23 5b 15 00 00 00 01 00 02 24 03 15 00 00 00 01 00 02 25 6e 15 00 00 00 01 00 02 26 03 15 00 00 00 01 00 02 27 85 15 00 00 00 01 00 02 28 03 15 00 00 00 01 00 02 29 a0 15 00 00 00 01 00 02 2a 03 15 00 00 00 01 00 02 2b ba 15 00 00 00 01 00 02 2d 03 15 00 00 00 01 00 02 2f cb 15 00 00 00 01 00 02 30 03 15 00 00 00 01 00 02 31 ff 15 00 00 00 01 00 02 32 00 15 00 00 00 01 00 02 33 df 15 00 00 00 01 00 02 34 00 15 00 00 00 01 00 02 35 e0 15 00 00 00 01 00 02 36 00 15 00 00 00 01 00 02 37 ed 15 00 00 00 01 00 02 38 00 15 00 00 00 01 00 02 39 f9 15 00 00 00 01 00 02 3a 01 15 00 00 00 01 00 02 3b 03 15 00 00 00 01 00 02 3d 01 15 00 00 00 01 00 02 3f 0e 15 00 00 00 01 00 02 40 01 15 00 00 00 01 00 02 41 17 15 00 00 00 01 00 02 42 01 15 00 00 00 01 00 02 43 21 15 00 00 00 01 00 02 44 01 15 00 00 00 01 00 02 45 2a 15 00 00 00 01 00 02 46 01 15 00 00 00 01 00 02 47 4a 15 00 00 00 01 00 02 48 01 15 00 00 00 01 00 02 49 65 15 00 00 00 01 00 02 4a 01 15 00 00 00 01 00 02 4b 92 15 00 00 00 01 00 02 4c 01 15 00 00 00 01 00 02 4d b8 15 00 00 00 01 00 02 4e 01 15 00 00 00 01 00 02 4f f7 15 00 00 00 01 00 02 50 02 15 00 00 00 01 00 02 51 1e 15 00 00 00 01 00 02 52 02 15 00 00 00 01 00 02 53 1f 15 00 00 00 01 00 02 54 02 15 00 00 00 01 00 02 55 4e 15 00 00 00 01 00 02 56 02 15 00 00 00 01 00 02 58 8a 15 00 00 00 01 00 02 59 02 15 00 00 00 01 00 02 5a b4 15 00 00 00 01 00 02 5b 02 15 00 00 00 01 00 02 5c ea 15 00 00 00 01 00 02 5d 03 15 00 00 00 01 00 02 5e 0a 15 00 00 00 01 00 02 5f 03 15 00 00 00 01 00 02 60 39 15 00 00 00 01 00 02 61 03 15 00 00 00 01 00 02 62 49 15 00 00 00 01 00 02 63 03 15 00 00 00 01 00 02 64 5b 15 00 00 00 01 00 02 65 03 15 00 00 00 01 00 02 66 6e 15 00 00 00 01 00 02 67 03 15 00 00 00 01 00 02 68 85 15 00 00 00 01 00 02 69 03 15 00 00 00 01 00 02 6a a0 15 00 00 00 01 00 02 6b 03 15 00 00 00 01 00 02 6c ba 15 00 00 00 01 00 02 6d 03 15 00 00 00 01 00 02 6e cb 15 00 00 00 01 00 02 6f 03 15 00 00 00 01 00 02 70 ff 15 00 00 00 01 00 02 71 01 15 00 00 00 01 00 02 72 4e 15 00 00 00 01 00 02 73 01 15 00 00 00 01 00 02 74 4f 15 00 00 00 01 00 02 75 01 15 00 00 00 01 00 02 76 50 15 00 00 00 01 00 02 77 01 15 00 00 00 01 00 02 78 53 15 00 00 00 01 00 02 79 01 15 00 00 00 01 00 02 7a 59 15 00 00 00 01 00 02 7b 01 15 00 00 00 01 00 02 7c 5f 15 00 00 00 01 00 02 7d 01 15 00 00 00 01 00 02 7e 65 15 00 00 00 01 00 02 7f 01 15 00 00 00 01 00 02 80 6b 15 00 00 00 01 00 02 81 01 15 00 00 00 01 00 02 82 70 15 00 00 00 01 00 02 83 01 15 00 00 00 01 00 02 84 85 15 00 00 00 01 00 02 85 01 15 00 00 00 01 00 02 86 98 15 00 00 00 01 00 02 87 01 15 00 00 00 01 00 02 88 ba 15 00 00 00 01 00 02 89 01 15 00 00 00 01 00 02 8a d9 15 00 00 00 01 00 02 8b 02 15 00 00 00 01 00 02 8c 06 15 00 00 00 01 00 02 8d 02 15 00 00 00 01 00 02 8e 2b 15 00 00 00 01 00 02 8f 02 15 00 00 00 01 00 02 90 2d 15 00 00 00 01 00 02 91 02 15 00 00 00 01 00 02 92 5a 15 00 00 00 01 00 02 93 02 15 00 00 00 01 00 02 94 95 15 00 00 00 01 00 02 95 02 15 00 00 00 01 00 02 96 bd 15 00 00 00 01 00 02 97 02 15 00 00 00 01 00 02 98 f4 15 00 00 00 01 00 02 99 03 15 00 00 00 01 00 02 9a 13 15 00 00 00 01 00 02 9b 03 15 00 00 00 01 00 02 9c 4d 15 00 00 00 01 00 02 9d 03 15 00 00 00 01 00 02 9e 5f 15 00 00 00 01 00 02 9f 03 15 00 00 00 01 00 02 a0 72 15 00 00 00 01 00 02 a2 03 15 00 00 00 01 00 02 a3 85 15 00 00 00 01 00 02 a4 03 15 00 00 00 01 00 02 a5 97 15 00 00 00 01 00 02 a6 03 15 00 00 00 01 00 02 a7 a6 15 00 00 00 01 00 02 a9 03 15 00 00 00 01 00 02 aa b1 15 00 00 00 01 00 02 ab 03 15 00 00 00 01 00 02 ac b6 15 00 00 00 01 00 02 ad 03 15 00 00 00 01 00 02 ae ff 15 00 00 00 01 00 02 af 01 15 00 00 00 01 00 02 b0 4e 15 00 00 00 01 00 02 b1 01 15 00 00 00 01 00 02 b2 4f 15 00 00 00 01 00 02 b3 01 15 00 00 00 01 00 02 b4 50 15 00 00 00 01 00 02 b5 01 15 00 00 00 01 00 02 b6 53 15 00 00 00 01 00 02 b7 01 15 00 00 00 01 00 02 b8 59 15 00 00 00 01 00 02 b9 01 15 00 00 00 01 00 02 ba 5f 15 00 00 00 01 00 02 bb 01 15 00 00 00 01 00 02 bc 65 15 00 00 00 01 00 02 bd 01 15 00 00 00 01 00 02 be 6b 15 00 00 00 01 00 02 bf 01 15 00 00 00 01 00 02 c0 70 15 00 00 00 01 00 02 c1 01 15 00 00 00 01 00 02 c2 85 15 00 00 00 01 00 02 c3 01 15 00 00 00 01 00 02 c4 98 15 00 00 00 01 00 02 c5 01 15 00 00 00 01 00 02 c6 ba 15 00 00 00 01 00 02 c7 01 15 00 00 00 01 00 02 c8 d9 15 00 00 00 01 00 02 c9 02 15 00 00 00 01 00 02 ca 06 15 00 00 00 01 00 02 cb 02 15 00 00 00 01 00 02 cc 2b 15 00 00 00 01 00 02 cd 02 15 00 00 00 01 00 02 ce 2d 15 00 00 00 01 00 02 cf 02 15 00 00 00 01 00 02 d0 5a 15 00 00 00 01 00 02 d1 02 15 00 00 00 01 00 02 d2 95 15 00 00 00 01 00 02 d3 02 15 00 00 00 01 00 02 d4 bd 15 00 00 00 01 00 02 d5 02 15 00 00 00 01 00 02 d6 f4 15 00 00 00 01 00 02 d7 03 15 00 00 00 01 00 02 d8 13 15 00 00 00 01 00 02 d9 03 15 00 00 00 01 00 02 da 4d 15 00 00 00 01 00 02 db 03 15 00 00 00 01 00 02 dc 5f 15 00 00 00 01 00 02 dd 03 15 00 00 00 01 00 02 de 72 15 00 00 00 01 00 02 df 03 15 00 00 00 01 00 02 e0 85 15 00 00 00 01 00 02 e1 03 15 00 00 00 01 00 02 e2 97 15 00 00 00 01 00 02 e3 03 15 00 00 00 01 00 02 e4 a6 15 00 00 00 01 00 02 e5 03 15 00 00 00 01 00 02 e6 b1 15 00 00 00 01 00 02 e7 03 15 00 00 00 01 00 02 e8 b6 15 00 00 00 01 00 02 e9 03 15 00 00 00 01 00 02 ea ff 15 00 00 00 01 00 02 fb 01 15 01 00 00 01 00 02 ff 10];
        qcom,mdss-dsi-dispparam-papermode1-state = "dsi_hs_mode";
        qcom,mdss-dsi-dispparam-papermode2-command = [15 01 00 00 78 00 02 ff 20 15 00 00 00 01 00 02 fb 01 15 00 00 00 01 00 02 75 01 15 00 00 00 01 00 02 76 13 15 00 00 00 01 00 02 77 01 15 00 00 00 01 00 02 78 18 15 00 00 00 01 00 02 79 01 15 00 00 00 01 00 02 7a 21 15 00 00 00 01 00 02 7b 01 15 00 00 00 01 00 02 7c 29 15 00 00 00 01 00 02 7d 01 15 00 00 00 01 00 02 7e 31 15 00 00 00 01 00 02 7f 01 15 00 00 00 01 00 02 80 39 15 00 00 00 01 00 02 81 01 15 00 00 00 01 00 02 82 41 15 00 00 00 01 00 02 83 01 15 00 00 00 01 00 02 84 48 15 00 00 00 01 00 02 85 01 15 00 00 00 01 00 02 86 4f 15 00 00 00 01 00 02 87 01 15 00 00 00 01 00 02 88 68 15 00 00 00 01 00 02 89 01 15 00 00 00 01 00 02 8a 7f 15 00 00 00 01 00 02 8b 01 15 00 00 00 01 00 02 8c a6 15 00 00 00 01 00 02 8d 01 15 00 00 00 01 00 02 8e c8 15 00 00 00 01 00 02 8f 01 15 00 00 00 01 00 02 90 fe 15 00 00 00 01 00 02 91 02 15 00 00 00 01 00 02 92 24 15 00 00 00 01 00 02 93 02 15 00 00 00 01 00 02 94 25 15 00 00 00 01 00 02 95 02 15 00 00 00 01 00 02 96 53 15 00 00 00 01 00 02 97 02 15 00 00 00 01 00 02 98 8f 15 00 00 00 01 00 02 99 02 15 00 00 00 01 00 02 9a b9 15 00 00 00 01 00 02 9b 02 15 00 00 00 01 00 02 9c f0 15 00 00 00 01 00 02 9d 03 15 00 00 00 01 00 02 9e 10 15 00 00 00 01 00 02 9f 03 15 00 00 00 01 00 02 a0 44 15 00 00 00 01 00 02 a2 03 15 00 00 00 01 00 02 a3 56 15 00 00 00 01 00 02 a4 03 15 00 00 00 01 00 02 a5 69 15 00 00 00 01 00 02 a6 03 15 00 00 00 01 00 02 a7 7e 15 00 00 00 01 00 02 a9 03 15 00 00 00 01 00 02 aa 93 15 00 00 00 01 00 02 ab 03 15 00 00 00 01 00 02 ac a4 15 00 00 00 01 00 02 ad 03 15 00 00 00 01 00 02 ae b0 15 00 00 00 01 00 02 af 03 15 00 00 00 01 00 02 b0 b6 15 00 00 00 01 00 02 b1 03 15 00 00 00 01 00 02 b2 ff 15 00 00 00 01 00 02 b3 01 15 00 00 00 01 00 02 b4 13 15 00 00 00 01 00 02 b5 01 15 00 00 00 01 00 02 b6 18 15 00 00 00 01 00 02 b7 01 15 00 00 00 01 00 02 b8 21 15 00 00 00 01 00 02 b9 01 15 00 00 00 01 00 02 ba 29 15 00 00 00 01 00 02 bb 01 15 00 00 00 01 00 02 bc 31 15 00 00 00 01 00 02 bd 01 15 00 00 00 01 00 02 be 39 15 00 00 00 01 00 02 bf 01 15 00 00 00 01 00 02 c0 41 15 00 00 00 01 00 02 c1 01 15 00 00 00 01 00 02 c2 48 15 00 00 00 01 00 02 c3 01 15 00 00 00 01 00 02 c4 4f 15 00 00 00 01 00 02 c5 01 15 00 00 00 01 00 02 c6 68 15 00 00 00 01 00 02 c7 01 15 00 00 00 01 00 02 c8 7f 15 00 00 00 01 00 02 c9 01 15 00 00 00 01 00 02 ca a6 15 00 00 00 01 00 02 cb 01 15 00 00 00 01 00 02 cc c8 15 00 00 00 01 00 02 cd 01 15 00 00 00 01 00 02 ce fe 15 00 00 00 01 00 02 cf 02 15 00 00 00 01 00 02 d0 24 15 00 00 00 01 00 02 d1 02 15 00 00 00 01 00 02 d2 25 15 00 00 00 01 00 02 d3 02 15 00 00 00 01 00 02 d4 53 15 00 00 00 01 00 02 d5 02 15 00 00 00 01 00 02 d6 8f 15 00 00 00 01 00 02 d7 02 15 00 00 00 01 00 02 d8 b9 15 00 00 00 01 00 02 d9 02 15 00 00 00 01 00 02 da f0 15 00 00 00 01 00 02 db 03 15 00 00 00 01 00 02 dc 10 15 00 00 00 01 00 02 dd 03 15 00 00 00 01 00 02 de 44 15 00 00 00 01 00 02 df 03 15 00 00 00 01 00 02 e0 56 15 00 00 00 01 00 02 e1 03 15 00 00 00 01 00 02 e2 69 15 00 00 00 01 00 02 e3 03 15 00 00 00 01 00 02 e4 7e 15 00 00 00 01 00 02 e5 03 15 00 00 00 01 00 02 e6 93 15 00 00 00 01 00 02 e7 03 15 00 00 00 01 00 02 e8 a4 15 00 00 00 01 00 02 e9 03 15 00 00 00 01 00 02 ea b0 15 00 00 00 01 00 02 eb 03 15 00 00 00 01 00 02 ec b6 15 00 00 00 01 00 02 ed 03 15 00 00 00 01 00 02 ee ff 15 00 00 00 01 00 02 ef 01 15 00 00 00 01 00 02 f0 13 15 00 00 00 01 00 02 f1 01 15 00 00 00 01 00 02 f2 18 15 00 00 00 01 00 02 f3 01 15 00 00 00 01 00 02 f4 21 15 00 00 00 01 00 02 f5 01 15 00 00 00 01 00 02 f6 29 15 00 00 00 01 00 02 f7 01 15 00 00 00 01 00 02 f8 31 15 00 00 00 01 00 02 f9 01 15 00 00 00 01 00 02 fa 39 15 00 00 00 01 00 02 ff 21 15 00 00 00 01 00 02 fb 01 15 00 00 00 01 00 02 00 01 15 00 00 00 01 00 02 01 41 15 00 00 00 01 00 02 02 01 15 00 00 00 01 00 02 03 48 15 00 00 00 01 00 02 04 01 15 00 00 00 01 00 02 05 4f 15 00 00 00 01 00 02 06 01 15 00 00 00 01 00 02 07 69 15 00 00 00 01 00 02 08 01 15 00 00 00 01 00 02 09 7f 15 00 00 00 01 00 02 0a 01 15 00 00 00 01 00 02 0b a6 15 00 00 00 01 00 02 0c 01 15 00 00 00 01 00 02 0d c8 15 00 00 00 01 00 02 0e 01 15 00 00 00 01 00 02 0f fe 15 00 00 00 01 00 02 10 02 15 00 00 00 01 00 02 11 24 15 00 00 00 01 00 02 12 02 15 00 00 00 01 00 02 13 26 15 00 00 00 01 00 02 14 02 15 00 00 00 01 00 02 15 54 15 00 00 00 01 00 02 16 02 15 00 00 00 01 00 02 17 90 15 00 00 00 01 00 02 18 02 15 00 00 00 01 00 02 19 b9 15 00 00 00 01 00 02 1a 02 15 00 00 00 01 00 02 1b ef 15 00 00 00 01 00 02 1c 03 15 00 00 00 01 00 02 1d 0e 15 00 00 00 01 00 02 1e 03 15 00 00 00 01 00 02 1f 3e 15 00 00 00 01 00 02 20 03 15 00 00 00 01 00 02 21 4d 15 00 00 00 01 00 02 22 03 15 00 00 00 01 00 02 23 5f 15 00 00 00 01 00 02 24 03 15 00 00 00 01 00 02 25 72 15 00 00 00 01 00 02 26 03 15 00 00 00 01 00 02 27 89 15 00 00 00 01 00 02 28 03 15 00 00 00 01 00 02 29 a2 15 00 00 00 01 00 02 2a 03 15 00 00 00 01 00 02 2b bc 15 00 00 00 01 00 02 2d 03 15 00 00 00 01 00 02 2f cb 15 00 00 00 01 00 02 30 03 15 00 00 00 01 00 02 31 ff 15 00 00 00 01 00 02 32 01 15 00 00 00 01 00 02 33 13 15 00 00 00 01 00 02 34 01 15 00 00 00 01 00 02 35 18 15 00 00 00 01 00 02 36 01 15 00 00 00 01 00 02 37 21 15 00 00 00 01 00 02 38 01 15 00 00 00 01 00 02 39 29 15 00 00 00 01 00 02 3a 01 15 00 00 00 01 00 02 3b 31 15 00 00 00 01 00 02 3d 01 15 00 00 00 01 00 02 3f 39 15 00 00 00 01 00 02 40 01 15 00 00 00 01 00 02 41 41 15 00 00 00 01 00 02 42 01 15 00 00 00 01 00 02 43 48 15 00 00 00 01 00 02 44 01 15 00 00 00 01 00 02 45 4f 15 00 00 00 01 00 02 46 01 15 00 00 00 01 00 02 47 69 15 00 00 00 01 00 02 48 01 15 00 00 00 01 00 02 49 7f 15 00 00 00 01 00 02 4a 01 15 00 00 00 01 00 02 4b a6 15 00 00 00 01 00 02 4c 01 15 00 00 00 01 00 02 4d c8 15 00 00 00 01 00 02 4e 01 15 00 00 00 01 00 02 4f fe 15 00 00 00 01 00 02 50 02 15 00 00 00 01 00 02 51 24 15 00 00 00 01 00 02 52 02 15 00 00 00 01 00 02 53 26 15 00 00 00 01 00 02 54 02 15 00 00 00 01 00 02 55 54 15 00 00 00 01 00 02 56 02 15 00 00 00 01 00 02 58 90 15 00 00 00 01 00 02 59 02 15 00 00 00 01 00 02 5a b9 15 00 00 00 01 00 02 5b 02 15 00 00 00 01 00 02 5c ef 15 00 00 00 01 00 02 5d 03 15 00 00 00 01 00 02 5e 0e 15 00 00 00 01 00 02 5f 03 15 00 00 00 01 00 02 60 3e 15 00 00 00 01 00 02 61 03 15 00 00 00 01 00 02 62 4d 15 00 00 00 01 00 02 63 03 15 00 00 00 01 00 02 64 5f 15 00 00 00 01 00 02 65 03 15 00 00 00 01 00 02 66 72 15 00 00 00 01 00 02 67 03 15 00 00 00 01 00 02 68 89 15 00 00 00 01 00 02 69 03 15 00 00 00 01 00 02 6a a2 15 00 00 00 01 00 02 6b 03 15 00 00 00 01 00 02 6c bc 15 00 00 00 01 00 02 6d 03 15 00 00 00 01 00 02 6e cb 15 00 00 00 01 00 02 6f 03 15 00 00 00 01 00 02 70 ff 15 00 00 00 01 00 02 71 01 15 00 00 00 01 00 02 72 83 15 00 00 00 01 00 02 73 01 15 00 00 00 01 00 02 74 85 15 00 00 00 01 00 02 75 01 15 00 00 00 01 00 02 76 8a 15 00 00 00 01 00 02 77 01 15 00 00 00 01 00 02 78 8e 15 00 00 00 01 00 02 79 01 15 00 00 00 01 00 02 7a 92 15 00 00 00 01 00 02 7b 01 15 00 00 00 01 00 02 7c 97 15 00 00 00 01 00 02 7d 01 15 00 00 00 01 00 02 7e 9b 15 00 00 00 01 00 02 7f 01 15 00 00 00 01 00 02 80 9f 15 00 00 00 01 00 02 81 01 15 00 00 00 01 00 02 82 a3 15 00 00 00 01 00 02 83 01 15 00 00 00 01 00 02 84 b2 15 00 00 00 01 00 02 85 01 15 00 00 00 01 00 02 86 c1 15 00 00 00 01 00 02 87 01 15 00 00 00 01 00 02 88 dc 15 00 00 00 01 00 02 89 01 15 00 00 00 01 00 02 8a f5 15 00 00 00 01 00 02 8b 02 15 00 00 00 01 00 02 8c 15 15 00 00 00 01 00 02 8d 02 15 00 00 00 01 00 02 8e 3a 15 00 00 00 01 00 02 8f 02 15 00 00 00 01 00 02 90 3b 15 00 00 00 01 00 02 91 02 15 00 00 00 01 00 02 92 67 15 00 00 00 01 00 02 93 02 15 00 00 00 01 00 02 94 a2 15 00 00 00 01 00 02 95 02 15 00 00 00 01 00 02 96 ca 15 00 00 00 01 00 02 97 02 15 00 00 00 01 00 02 98 fe 15 00 00 00 01 00 02 99 03 15 00 00 00 01 00 02 9a 1b 15 00 00 00 01 00 02 9b 03 15 00 00 00 01 00 02 9c 58 15 00 00 00 01 00 02 9d 03 15 00 00 00 01 00 02 9e 6a 15 00 00 00 01 00 02 9f 03 15 00 00 00 01 00 02 a0 7b 15 00 00 00 01 00 02 a2 03 15 00 00 00 01 00 02 a3 8c 15 00 00 00 01 00 02 a4 03 15 00 00 00 01 00 02 a5 9c 15 00 00 00 01 00 02 a6 03 15 00 00 00 01 00 02 a7 a9 15 00 00 00 01 00 02 a9 03 15 00 00 00 01 00 02 aa b2 15 00 00 00 01 00 02 ab 03 15 00 00 00 01 00 02 ac b6 15 00 00 00 01 00 02 ad 03 15 00 00 00 01 00 02 ae ff 15 00 00 00 01 00 02 af 01 15 00 00 00 01 00 02 b0 83 15 00 00 00 01 00 02 b1 01 15 00 00 00 01 00 02 b2 85 15 00 00 00 01 00 02 b3 01 15 00 00 00 01 00 02 b4 8a 15 00 00 00 01 00 02 b5 01 15 00 00 00 01 00 02 b6 8e 15 00 00 00 01 00 02 b7 01 15 00 00 00 01 00 02 b8 92 15 00 00 00 01 00 02 b9 01 15 00 00 00 01 00 02 ba 97 15 00 00 00 01 00 02 bb 01 15 00 00 00 01 00 02 bc 9b 15 00 00 00 01 00 02 bd 01 15 00 00 00 01 00 02 be 9f 15 00 00 00 01 00 02 bf 01 15 00 00 00 01 00 02 c0 a3 15 00 00 00 01 00 02 c1 01 15 00 00 00 01 00 02 c2 b2 15 00 00 00 01 00 02 c3 01 15 00 00 00 01 00 02 c4 c1 15 00 00 00 01 00 02 c5 01 15 00 00 00 01 00 02 c6 dc 15 00 00 00 01 00 02 c7 01 15 00 00 00 01 00 02 c8 f5 15 00 00 00 01 00 02 c9 02 15 00 00 00 01 00 02 ca 15 15 00 00 00 01 00 02 cb 02 15 00 00 00 01 00 02 cc 3a 15 00 00 00 01 00 02 cd 02 15 00 00 00 01 00 02 ce 3b 15 00 00 00 01 00 02 cf 02 15 00 00 00 01 00 02 d0 67 15 00 00 00 01 00 02 d1 02 15 00 00 00 01 00 02 d2 a2 15 00 00 00 01 00 02 d3 02 15 00 00 00 01 00 02 d4 ca 15 00 00 00 01 00 02 d5 02 15 00 00 00 01 00 02 d6 fe 15 00 00 00 01 00 02 d7 03 15 00 00 00 01 00 02 d8 1b 15 00 00 00 01 00 02 d9 03 15 00 00 00 01 00 02 da 58 15 00 00 00 01 00 02 db 03 15 00 00 00 01 00 02 dc 6a 15 00 00 00 01 00 02 dd 03 15 00 00 00 01 00 02 de 7b 15 00 00 00 01 00 02 df 03 15 00 00 00 01 00 02 e0 8c 15 00 00 00 01 00 02 e1 03 15 00 00 00 01 00 02 e2 9c 15 00 00 00 01 00 02 e3 03 15 00 00 00 01 00 02 e4 a9 15 00 00 00 01 00 02 e5 03 15 00 00 00 01 00 02 e6 b2 15 00 00 00 01 00 02 e7 03 15 00 00 00 01 00 02 e8 b6 15 00 00 00 01 00 02 e9 03 15 00 00 00 01 00 02 ea ff 15 00 00 00 01 00 02 fb 01 15 01 00 00 01 00 02 ff 10];
        qcom,mdss-dsi-dispparam-papermode2-state = "dsi_hs_mode";
        qcom,mdss-dsi-dispparam-papermode3-command = [15 01 00 00 78 00 02 ff 20 15 00 00 00 01 00 02 fb 01 15 00 00 00 01 00 02 75 01 15 00 00 00 01 00 02 76 37 15 00 00 00 01 00 02 77 01 15 00 00 00 01 00 02 78 3b 15 00 00 00 01 00 02 79 01 15 00 00 00 01 00 02 7a 42 15 00 00 00 01 00 02 7b 01 15 00 00 00 01 00 02 7c 49 15 00 00 00 01 00 02 7d 01 15 00 00 00 01 00 02 7e 50 15 00 00 00 01 00 02 7f 01 15 00 00 00 01 00 02 80 56 15 00 00 00 01 00 02 81 01 15 00 00 00 01 00 02 82 5c 15 00 00 00 01 00 02 83 01 15 00 00 00 01 00 02 84 62 15 00 00 00 01 00 02 85 01 15 00 00 00 01 00 02 86 68 15 00 00 00 01 00 02 87 01 15 00 00 00 01 00 02 88 7e 15 00 00 00 01 00 02 89 01 15 00 00 00 01 00 02 8a 92 15 00 00 00 01 00 02 8b 01 15 00 00 00 01 00 02 8c b5 15 00 00 00 01 00 02 8d 01 15 00 00 00 01 00 02 8e d4 15 00 00 00 01 00 02 8f 02 15 00 00 00 01 00 02 90 04 15 00 00 00 01 00 02 91 02 15 00 00 00 01 00 02 92 2a 15 00 00 00 01 00 02 93 02 15 00 00 00 01 00 02 94 2b 15 00 00 00 01 00 02 95 02 15 00 00 00 01 00 02 96 58 15 00 00 00 01 00 02 97 02 15 00 00 00 01 00 02 98 94 15 00 00 00 01 00 02 99 02 15 00 00 00 01 00 02 9a be 15 00 00 00 01 00 02 9b 02 15 00 00 00 01 00 02 9c f4 15 00 00 00 01 00 02 9d 03 15 00 00 00 01 00 02 9e 12 15 00 00 00 01 00 02 9f 03 15 00 00 00 01 00 02 a0 48 15 00 00 00 01 00 02 a2 03 15 00 00 00 01 00 02 a3 5a 15 00 00 00 01 00 02 a4 03 15 00 00 00 01 00 02 a5 6d 15 00 00 00 01 00 02 a6 03 15 00 00 00 01 00 02 a7 82 15 00 00 00 01 00 02 a9 03 15 00 00 00 01 00 02 aa 95 15 00 00 00 01 00 02 ab 03 15 00 00 00 01 00 02 ac a6 15 00 00 00 01 00 02 ad 03 15 00 00 00 01 00 02 ae b1 15 00 00 00 01 00 02 af 03 15 00 00 00 01 00 02 b0 b6 15 00 00 00 01 00 02 b1 03 15 00 00 00 01 00 02 b2 ff 15 00 00 00 01 00 02 b3 01 15 00 00 00 01 00 02 b4 37 15 00 00 00 01 00 02 b5 01 15 00 00 00 01 00 02 b6 3b 15 00 00 00 01 00 02 b7 01 15 00 00 00 01 00 02 b8 42 15 00 00 00 01 00 02 b9 01 15 00 00 00 01 00 02 ba 49 15 00 00 00 01 00 02 bb 01 15 00 00 00 01 00 02 bc 50 15 00 00 00 01 00 02 bd 01 15 00 00 00 01 00 02 be 56 15 00 00 00 01 00 02 bf 01 15 00 00 00 01 00 02 c0 5c 15 00 00 00 01 00 02 c1 01 15 00 00 00 01 00 02 c2 62 15 00 00 00 01 00 02 c3 01 15 00 00 00 01 00 02 c4 68 15 00 00 00 01 00 02 c5 01 15 00 00 00 01 00 02 c6 7e 15 00 00 00 01 00 02 c7 01 15 00 00 00 01 00 02 c8 92 15 00 00 00 01 00 02 c9 01 15 00 00 00 01 00 02 ca b5 15 00 00 00 01 00 02 cb 01 15 00 00 00 01 00 02 cc d4 15 00 00 00 01 00 02 cd 02 15 00 00 00 01 00 02 ce 04 15 00 00 00 01 00 02 cf 02 15 00 00 00 01 00 02 d0 2a 15 00 00 00 01 00 02 d1 02 15 00 00 00 01 00 02 d2 2b 15 00 00 00 01 00 02 d3 02 15 00 00 00 01 00 02 d4 58 15 00 00 00 01 00 02 d5 02 15 00 00 00 01 00 02 d6 94 15 00 00 00 01 00 02 d7 02 15 00 00 00 01 00 02 d8 be 15 00 00 00 01 00 02 d9 02 15 00 00 00 01 00 02 da f4 15 00 00 00 01 00 02 db 03 15 00 00 00 01 00 02 dc 12 15 00 00 00 01 00 02 dd 03 15 00 00 00 01 00 02 de 48 15 00 00 00 01 00 02 df 03 15 00 00 00 01 00 02 e0 5a 15 00 00 00 01 00 02 e1 03 15 00 00 00 01 00 02 e2 6d 15 00 00 00 01 00 02 e3 03 15 00 00 00 01 00 02 e4 82 15 00 00 00 01 00 02 e5 03 15 00 00 00 01 00 02 e6 95 15 00 00 00 01 00 02 e7 03 15 00 00 00 01 00 02 e8 a6 15 00 00 00 01 00 02 e9 03 15 00 00 00 01 00 02 ea b1 15 00 00 00 01 00 02 eb 03 15 00 00 00 01 00 02 ec b6 15 00 00 00 01 00 02 ed 03 15 00 00 00 01 00 02 ee ff 15 00 00 00 01 00 02 ef 01 15 00 00 00 01 00 02 f0 37 15 00 00 00 01 00 02 f1 01 15 00 00 00 01 00 02 f2 3b 15 00 00 00 01 00 02 f3 01 15 00 00 00 01 00 02 f4 42 15 00 00 00 01 00 02 f5 01 15 00 00 00 01 00 02 f6 49 15 00 00 00 01 00 02 f7 01 15 00 00 00 01 00 02 f8 50 15 00 00 00 01 00 02 f9 01 15 00 00 00 01 00 02 fa 56 15 00 00 00 01 00 02 ff 21 15 00 00 00 01 00 02 fb 01 15 00 00 00 01 00 02 00 01 15 00 00 00 01 00 02 01 5c 15 00 00 00 01 00 02 02 01 15 00 00 00 01 00 02 03 63 15 00 00 00 01 00 02 04 01 15 00 00 00 01 00 02 05 68 15 00 00 00 01 00 02 06 01 15 00 00 00 01 00 02 07 7e 15 00 00 00 01 00 02 08 01 15 00 00 00 01 00 02 09 92 15 00 00 00 01 00 02 0a 01 15 00 00 00 01 00 02 0b b5 15 00 00 00 01 00 02 0c 01 15 00 00 00 01 00 02 0d d4 15 00 00 00 01 00 02 0e 02 15 00 00 00 01 00 02 0f 04 15 00 00 00 01 00 02 10 02 15 00 00 00 01 00 02 11 2a 15 00 00 00 01 00 02 12 02 15 00 00 00 01 00 02 13 2b 15 00 00 00 01 00 02 14 02 15 00 00 00 01 00 02 15 59 15 00 00 00 01 00 02 16 02 15 00 00 00 01 00 02 17 95 15 00 00 00 01 00 02 18 02 15 00 00 00 01 00 02 19 be 15 00 00 00 01 00 02 1a 02 15 00 00 00 01 00 02 1b f3 15 00 00 00 01 00 02 1c 03 15 00 00 00 01 00 02 1d 11 15 00 00 00 01 00 02 1e 03 15 00 00 00 01 00 02 1f 41 15 00 00 00 01 00 02 20 03 15 00 00 00 01 00 02 21 51 15 00 00 00 01 00 02 22 03 15 00 00 00 01 00 02 23 62 15 00 00 00 01 00 02 24 03 15 00 00 00 01 00 02 25 75 15 00 00 00 01 00 02 26 03 15 00 00 00 01 00 02 27 8b 15 00 00 00 01 00 02 28 03 15 00 00 00 01 00 02 29 a5 15 00 00 00 01 00 02 2a 03 15 00 00 00 01 00 02 2b bd 15 00 00 00 01 00 02 2d 03 15 00 00 00 01 00 02 2f cb 15 00 00 00 01 00 02 30 03 15 00 00 00 01 00 02 31 ff 15 00 00 00 01 00 02 32 01 15 00 00 00 01 00 02 33 37 15 00 00 00 01 00 02 34 01 15 00 00 00 01 00 02 35 3b 15 00 00 00 01 00 02 36 01 15 00 00 00 01 00 02 37 42 15 00 00 00 01 00 02 38 01 15 00 00 00 01 00 02 39 49 15 00 00 00 01 00 02 3a 01 15 00 00 00 01 00 02 3b 50 15 00 00 00 01 00 02 3d 01 15 00 00 00 01 00 02 3f 56 15 00 00 00 01 00 02 40 01 15 00 00 00 01 00 02 41 5c 15 00 00 00 01 00 02 42 01 15 00 00 00 01 00 02 43 63 15 00 00 00 01 00 02 44 01 15 00 00 00 01 00 02 45 68 15 00 00 00 01 00 02 46 01 15 00 00 00 01 00 02 47 7e 15 00 00 00 01 00 02 48 01 15 00 00 00 01 00 02 49 92 15 00 00 00 01 00 02 4a 01 15 00 00 00 01 00 02 4b b5 15 00 00 00 01 00 02 4c 01 15 00 00 00 01 00 02 4d d4 15 00 00 00 01 00 02 4e 02 15 00 00 00 01 00 02 4f 04 15 00 00 00 01 00 02 50 02 15 00 00 00 01 00 02 51 2a 15 00 00 00 01 00 02 52 02 15 00 00 00 01 00 02 53 2b 15 00 00 00 01 00 02 54 02 15 00 00 00 01 00 02 55 59 15 00 00 00 01 00 02 56 02 15 00 00 00 01 00 02 58 95 15 00 00 00 01 00 02 59 02 15 00 00 00 01 00 02 5a be 15 00 00 00 01 00 02 5b 02 15 00 00 00 01 00 02 5c f3 15 00 00 00 01 00 02 5d 03 15 00 00 00 01 00 02 5e 11 15 00 00 00 01 00 02 5f 03 15 00 00 00 01 00 02 60 41 15 00 00 00 01 00 02 61 03 15 00 00 00 01 00 02 62 51 15 00 00 00 01 00 02 63 03 15 00 00 00 01 00 02 64 62 15 00 00 00 01 00 02 65 03 15 00 00 00 01 00 02 66 75 15 00 00 00 01 00 02 67 03 15 00 00 00 01 00 02 68 8b 15 00 00 00 01 00 02 69 03 15 00 00 00 01 00 02 6a a5 15 00 00 00 01 00 02 6b 03 15 00 00 00 01 00 02 6c bd 15 00 00 00 01 00 02 6d 03 15 00 00 00 01 00 02 6e cb 15 00 00 00 01 00 02 6f 03 15 00 00 00 01 00 02 70 ff 15 00 00 00 01 00 02 71 01 15 00 00 00 01 00 02 72 b0 15 00 00 00 01 00 02 73 01 15 00 00 00 01 00 02 74 b2 15 00 00 00 01 00 02 75 01 15 00 00 00 01 00 02 76 b5 15 00 00 00 01 00 02 77 01 15 00 00 00 01 00 02 78 b8 15 00 00 00 01 00 02 79 01 15 00 00 00 01 00 02 7a bc 15 00 00 00 01 00 02 7b 01 15 00 00 00 01 00 02 7c bf 15 00 00 00 01 00 02 7d 01 15 00 00 00 01 00 02 7e c2 15 00 00 00 01 00 02 7f 01 15 00 00 00 01 00 02 80 c6 15 00 00 00 01 00 02 81 01 15 00 00 00 01 00 02 82 c9 15 00 00 00 01 00 02 83 01 15 00 00 00 01 00 02 84 d5 15 00 00 00 01 00 02 85 01 15 00 00 00 01 00 02 86 e1 15 00 00 00 01 00 02 87 01 15 00 00 00 01 00 02 88 f7 15 00 00 00 01 00 02 89 02 15 00 00 00 01 00 02 8a 05 15 00 00 00 01 00 02 8b 02 15 00 00 00 01 00 02 8c 24 15 00 00 00 01 00 02 8d 02 15 00 00 00 01 00 02 8e 48 15 00 00 00 01 00 02 8f 02 15 00 00 00 01 00 02 90 49 15 00 00 00 01 00 02 91 02 15 00 00 00 01 00 02 92 74 15 00 00 00 01 00 02 93 02 15 00 00 00 01 00 02 94 ae 15 00 00 00 01 00 02 95 02 15 00 00 00 01 00 02 96 d6 15 00 00 00 01 00 02 97 03 15 00 00 00 01 00 02 98 08 15 00 00 00 01 00 02 99 03 15 00 00 00 01 00 02 9a 2a 15 00 00 00 01 00 02 9b 03 15 00 00 00 01 00 02 9c 63 15 00 00 00 01 00 02 9d 03 15 00 00 00 01 00 02 9e 73 15 00 00 00 01 00 02 9f 03 15 00 00 00 01 00 02 a0 83 15 00 00 00 01 00 02 a2 03 15 00 00 00 01 00 02 a3 93 15 00 00 00 01 00 02 a4 03 15 00 00 00 01 00 02 a5 a0 15 00 00 00 01 00 02 a6 03 15 00 00 00 01 00 02 a7 ab 15 00 00 00 01 00 02 a9 03 15 00 00 00 01 00 02 aa b3 15 00 00 00 01 00 02 ab 03 15 00 00 00 01 00 02 ac b6 15 00 00 00 01 00 02 ad 03 15 00 00 00 01 00 02 ae ff 15 00 00 00 01 00 02 af 01 15 00 00 00 01 00 02 b0 b0 15 00 00 00 01 00 02 b1 01 15 00 00 00 01 00 02 b2 b2 15 00 00 00 01 00 02 b3 01 15 00 00 00 01 00 02 b4 b5 15 00 00 00 01 00 02 b5 01 15 00 00 00 01 00 02 b6 b8 15 00 00 00 01 00 02 b7 01 15 00 00 00 01 00 02 b8 bc 15 00 00 00 01 00 02 b9 01 15 00 00 00 01 00 02 ba bf 15 00 00 00 01 00 02 bb 01 15 00 00 00 01 00 02 bc c2 15 00 00 00 01 00 02 bd 01 15 00 00 00 01 00 02 be c6 15 00 00 00 01 00 02 bf 01 15 00 00 00 01 00 02 c0 c9 15 00 00 00 01 00 02 c1 01 15 00 00 00 01 00 02 c2 d5 15 00 00 00 01 00 02 c3 01 15 00 00 00 01 00 02 c4 e1 15 00 00 00 01 00 02 c5 01 15 00 00 00 01 00 02 c6 f7 15 00 00 00 01 00 02 c7 02 15 00 00 00 01 00 02 c8 05 15 00 00 00 01 00 02 c9 02 15 00 00 00 01 00 02 ca 24 15 00 00 00 01 00 02 cb 02 15 00 00 00 01 00 02 cc 48 15 00 00 00 01 00 02 cd 02 15 00 00 00 01 00 02 ce 49 15 00 00 00 01 00 02 cf 02 15 00 00 00 01 00 02 d0 74 15 00 00 00 01 00 02 d1 02 15 00 00 00 01 00 02 d2 ae 15 00 00 00 01 00 02 d3 02 15 00 00 00 01 00 02 d4 d6 15 00 00 00 01 00 02 d5 03 15 00 00 00 01 00 02 d6 08 15 00 00 00 01 00 02 d7 03 15 00 00 00 01 00 02 d8 2a 15 00 00 00 01 00 02 d9 03 15 00 00 00 01 00 02 da 63 15 00 00 00 01 00 02 db 03 15 00 00 00 01 00 02 dc 73 15 00 00 00 01 00 02 dd 03 15 00 00 00 01 00 02 de 83 15 00 00 00 01 00 02 df 03 15 00 00 00 01 00 02 e0 93 15 00 00 00 01 00 02 e1 03 15 00 00 00 01 00 02 e2 a0 15 00 00 00 01 00 02 e3 03 15 00 00 00 01 00 02 e4 ab 15 00 00 00 01 00 02 e5 03 15 00 00 00 01 00 02 e6 b3 15 00 00 00 01 00 02 e7 03 15 00 00 00 01 00 02 e8 b6 15 00 00 00 01 00 02 e9 03 15 00 00 00 01 00 02 ea ff 15 00 00 00 01 00 02 fb 01 15 01 00 00 01 00 02 ff 10];
        qcom,mdss-dsi-dispparam-papermode3-state = "dsi_hs_mode";
        qcom,mdss-dsi-dispparam-papermode4-command = [15 01 00 00 78 00 02 ff 20 15 00 00 00 01 00 02 fb 01 15 00 00 00 01 00 02 75 01 15 00 00 00 01 00 02 76 4f 15 00 00 00 01 00 02 77 01 15 00 00 00 01 00 02 78 52 15 00 00 00 01 00 02 79 01 15 00 00 00 01 00 02 7a 58 15 00 00 00 01 00 02 7b 01 15 00 00 00 01 00 02 7c 5e 15 00 00 00 01 00 02 7d 01 15 00 00 00 01 00 02 7e 64 15 00 00 00 01 00 02 7f 01 15 00 00 00 01 00 02 80 6a 15 00 00 00 01 00 02 81 01 15 00 00 00 01 00 02 82 6f 15 00 00 00 01 00 02 83 01 15 00 00 00 01 00 02 84 75 15 00 00 00 01 00 02 85 01 15 00 00 00 01 00 02 86 7a 15 00 00 00 01 00 02 87 01 15 00 00 00 01 00 02 88 8e 15 00 00 00 01 00 02 89 01 15 00 00 00 01 00 02 8a a0 15 00 00 00 01 00 02 8b 01 15 00 00 00 01 00 02 8c c0 15 00 00 00 01 00 02 8d 01 15 00 00 00 01 00 02 8e de 15 00 00 00 01 00 02 8f 02 15 00 00 00 01 00 02 90 08 15 00 00 00 01 00 02 91 02 15 00 00 00 01 00 02 92 2e 15 00 00 00 01 00 02 93 02 15 00 00 00 01 00 02 94 2f 15 00 00 00 01 00 02 95 02 15 00 00 00 01 00 02 96 5c 15 00 00 00 01 00 02 97 02 15 00 00 00 01 00 02 98 98 15 00 00 00 01 00 02 99 02 15 00 00 00 01 00 02 9a c1 15 00 00 00 01 00 02 9b 02 15 00 00 00 01 00 02 9c f7 15 00 00 00 01 00 02 9d 03 15 00 00 00 01 00 02 9e 15 15 00 00 00 01 00 02 9f 03 15 00 00 00 01 00 02 a0 4b 15 00 00 00 01 00 02 a2 03 15 00 00 00 01 00 02 a3 5d 15 00 00 00 01 00 02 a4 03 15 00 00 00 01 00 02 a5 70 15 00 00 00 01 00 02 a6 03 15 00 00 00 01 00 02 a7 84 15 00 00 00 01 00 02 a9 03 15 00 00 00 01 00 02 aa 97 15 00 00 00 01 00 02 ab 03 15 00 00 00 01 00 02 ac a7 15 00 00 00 01 00 02 ad 03 15 00 00 00 01 00 02 ae b1 15 00 00 00 01 00 02 af 03 15 00 00 00 01 00 02 b0 b6 15 00 00 00 01 00 02 b1 03 15 00 00 00 01 00 02 b2 ff 15 00 00 00 01 00 02 b3 01 15 00 00 00 01 00 02 b4 4f 15 00 00 00 01 00 02 b5 01 15 00 00 00 01 00 02 b6 52 15 00 00 00 01 00 02 b7 01 15 00 00 00 01 00 02 b8 58 15 00 00 00 01 00 02 b9 01 15 00 00 00 01 00 02 ba 5e 15 00 00 00 01 00 02 bb 01 15 00 00 00 01 00 02 bc 64 15 00 00 00 01 00 02 bd 01 15 00 00 00 01 00 02 be 6a 15 00 00 00 01 00 02 bf 01 15 00 00 00 01 00 02 c0 6f 15 00 00 00 01 00 02 c1 01 15 00 00 00 01 00 02 c2 75 15 00 00 00 01 00 02 c3 01 15 00 00 00 01 00 02 c4 7a 15 00 00 00 01 00 02 c5 01 15 00 00 00 01 00 02 c6 8e 15 00 00 00 01 00 02 c7 01 15 00 00 00 01 00 02 c8 a0 15 00 00 00 01 00 02 c9 01 15 00 00 00 01 00 02 ca c0 15 00 00 00 01 00 02 cb 01 15 00 00 00 01 00 02 cc de 15 00 00 00 01 00 02 cd 02 15 00 00 00 01 00 02 ce 08 15 00 00 00 01 00 02 cf 02 15 00 00 00 01 00 02 d0 2e 15 00 00 00 01 00 02 d1 02 15 00 00 00 01 00 02 d2 2f 15 00 00 00 01 00 02 d3 02 15 00 00 00 01 00 02 d4 5c 15 00 00 00 01 00 02 d5 02 15 00 00 00 01 00 02 d6 98 15 00 00 00 01 00 02 d7 02 15 00 00 00 01 00 02 d8 c1 15 00 00 00 01 00 02 d9 02 15 00 00 00 01 00 02 da f7 15 00 00 00 01 00 02 db 03 15 00 00 00 01 00 02 dc 15 15 00 00 00 01 00 02 dd 03 15 00 00 00 01 00 02 de 4b 15 00 00 00 01 00 02 df 03 15 00 00 00 01 00 02 e0 5d 15 00 00 00 01 00 02 e1 03 15 00 00 00 01 00 02 e2 70 15 00 00 00 01 00 02 e3 03 15 00 00 00 01 00 02 e4 84 15 00 00 00 01 00 02 e5 03 15 00 00 00 01 00 02 e6 97 15 00 00 00 01 00 02 e7 03 15 00 00 00 01 00 02 e8 a7 15 00 00 00 01 00 02 e9 03 15 00 00 00 01 00 02 ea b1 15 00 00 00 01 00 02 eb 03 15 00 00 00 01 00 02 ec b6 15 00 00 00 01 00 02 ed 03 15 00 00 00 01 00 02 ee ff 15 00 00 00 01 00 02 ef 01 15 00 00 00 01 00 02 f0 4f 15 00 00 00 01 00 02 f1 01 15 00 00 00 01 00 02 f2 52 15 00 00 00 01 00 02 f3 01 15 00 00 00 01 00 02 f4 58 15 00 00 00 01 00 02 f5 01 15 00 00 00 01 00 02 f6 5e 15 00 00 00 01 00 02 f7 01 15 00 00 00 01 00 02 f8 64 15 00 00 00 01 00 02 f9 01 15 00 00 00 01 00 02 fa 6a 15 00 00 00 01 00 02 ff 21 15 00 00 00 01 00 02 fb 01 15 00 00 00 01 00 02 00 01 15 00 00 00 01 00 02 01 70 15 00 00 00 01 00 02 02 01 15 00 00 00 01 00 02 03 75 15 00 00 00 01 00 02 04 01 15 00 00 00 01 00 02 05 7a 15 00 00 00 01 00 02 06 01 15 00 00 00 01 00 02 07 8e 15 00 00 00 01 00 02 08 01 15 00 00 00 01 00 02 09 a0 15 00 00 00 01 00 02 0a 01 15 00 00 00 01 00 02 0b c0 15 00 00 00 01 00 02 0c 01 15 00 00 00 01 00 02 0d de 15 00 00 00 01 00 02 0e 02 15 00 00 00 01 00 02 0f 09 15 00 00 00 01 00 02 10 02 15 00 00 00 01 00 02 11 2e 15 00 00 00 01 00 02 12 02 15 00 00 00 01 00 02 13 30 15 00 00 00 01 00 02 14 02 15 00 00 00 01 00 02 15 5d 15 00 00 00 01 00 02 16 02 15 00 00 00 01 00 02 17 99 15 00 00 00 01 00 02 18 02 15 00 00 00 01 00 02 19 c2 15 00 00 00 01 00 02 1a 02 15 00 00 00 01 00 02 1b f6 15 00 00 00 01 00 02 1c 03 15 00 00 00 01 00 02 1d 13 15 00 00 00 01 00 02 1e 03 15 00 00 00 01 00 02 1f 44 15 00 00 00 01 00 02 20 03 15 00 00 00 01 00 02 21 54 15 00 00 00 01 00 02 22 03 15 00 00 00 01 00 02 23 65 15 00 00 00 01 00 02 24 03 15 00 00 00 01 00 02 25 78 15 00 00 00 01 00 02 26 03 15 00 00 00 01 00 02 27 8e 15 00 00 00 01 00 02 28 03 15 00 00 00 01 00 02 29 a6 15 00 00 00 01 00 02 2a 03 15 00 00 00 01 00 02 2b be 15 00 00 00 01 00 02 2d 03 15 00 00 00 01 00 02 2f cb 15 00 00 00 01 00 02 30 03 15 00 00 00 01 00 02 31 ff 15 00 00 00 01 00 02 32 01 15 00 00 00 01 00 02 33 4f 15 00 00 00 01 00 02 34 01 15 00 00 00 01 00 02 35 52 15 00 00 00 01 00 02 36 01 15 00 00 00 01 00 02 37 58 15 00 00 00 01 00 02 38 01 15 00 00 00 01 00 02 39 5e 15 00 00 00 01 00 02 3a 01 15 00 00 00 01 00 02 3b 64 15 00 00 00 01 00 02 3d 01 15 00 00 00 01 00 02 3f 6a 15 00 00 00 01 00 02 40 01 15 00 00 00 01 00 02 41 70 15 00 00 00 01 00 02 42 01 15 00 00 00 01 00 02 43 75 15 00 00 00 01 00 02 44 01 15 00 00 00 01 00 02 45 7a 15 00 00 00 01 00 02 46 01 15 00 00 00 01 00 02 47 8e 15 00 00 00 01 00 02 48 01 15 00 00 00 01 00 02 49 a0 15 00 00 00 01 00 02 4a 01 15 00 00 00 01 00 02 4b c0 15 00 00 00 01 00 02 4c 01 15 00 00 00 01 00 02 4d de 15 00 00 00 01 00 02 4e 02 15 00 00 00 01 00 02 4f 09 15 00 00 00 01 00 02 50 02 15 00 00 00 01 00 02 51 2e 15 00 00 00 01 00 02 52 02 15 00 00 00 01 00 02 53 30 15 00 00 00 01 00 02 54 02 15 00 00 00 01 00 02 55 5d 15 00 00 00 01 00 02 56 02 15 00 00 00 01 00 02 58 99 15 00 00 00 01 00 02 59 02 15 00 00 00 01 00 02 5a c2 15 00 00 00 01 00 02 5b 02 15 00 00 00 01 00 02 5c f6 15 00 00 00 01 00 02 5d 03 15 00 00 00 01 00 02 5e 13 15 00 00 00 01 00 02 5f 03 15 00 00 00 01 00 02 60 44 15 00 00 00 01 00 02 61 03 15 00 00 00 01 00 02 62 54 15 00 00 00 01 00 02 63 03 15 00 00 00 01 00 02 64 65 15 00 00 00 01 00 02 65 03 15 00 00 00 01 00 02 66 78 15 00 00 00 01 00 02 67 03 15 00 00 00 01 00 02 68 8e 15 00 00 00 01 00 02 69 03 15 00 00 00 01 00 02 6a a6 15 00 00 00 01 00 02 6b 03 15 00 00 00 01 00 02 6c be 15 00 00 00 01 00 02 6d 03 15 00 00 00 01 00 02 6e cb 15 00 00 00 01 00 02 6f 03 15 00 00 00 01 00 02 70 ff 15 00 00 00 01 00 02 71 01 15 00 00 00 01 00 02 72 d2 15 00 00 00 01 00 02 73 01 15 00 00 00 01 00 02 74 d3 15 00 00 00 01 00 02 75 01 15 00 00 00 01 00 02 76 d6 15 00 00 00 01 00 02 77 01 15 00 00 00 01 00 02 78 d9 15 00 00 00 01 00 02 79 01 15 00 00 00 01 00 02 7a dc 15 00 00 00 01 00 02 7b 01 15 00 00 00 01 00 02 7c df 15 00 00 00 01 00 02 7d 01 15 00 00 00 01 00 02 7e e1 15 00 00 00 01 00 02 7f 01 15 00 00 00 01 00 02 80 e4 15 00 00 00 01 00 02 81 01 15 00 00 00 01 00 02 82 e7 15 00 00 00 01 00 02 83 01 15 00 00 00 01 00 02 84 f2 15 00 00 00 01 00 02 85 01 15 00 00 00 01 00 02 86 f9 15 00 00 00 01 00 02 87 02 15 00 00 00 01 00 02 88 06 15 00 00 00 01 00 02 89 02 15 00 00 00 01 00 02 8a 14 15 00 00 00 01 00 02 8b 02 15 00 00 00 01 00 02 8c 32 15 00 00 00 01 00 02 8d 02 15 00 00 00 01 00 02 8e 55 15 00 00 00 01 00 02 8f 02 15 00 00 00 01 00 02 90 56 15 00 00 00 01 00 02 91 02 15 00 00 00 01 00 02 92 80 15 00 00 00 01 00 02 93 02 15 00 00 00 01 00 02 94 ba 15 00 00 00 01 00 02 95 02 15 00 00 00 01 00 02 96 e1 15 00 00 00 01 00 02 97 03 15 00 00 00 01 00 02 98 10 15 00 00 00 01 00 02 99 03 15 00 00 00 01 00 02 9a 36 15 00 00 00 01 00 02 9b 03 15 00 00 00 01 00 02 9c 6d 15 00 00 00 01 00 02 9d 03 15 00 00 00 01 00 02 9e 7c 15 00 00 00 01 00 02 9f 03 15 00 00 00 01 00 02 a0 8a 15 00 00 00 01 00 02 a2 03 15 00 00 00 01 00 02 a3 98 15 00 00 00 01 00 02 a4 03 15 00 00 00 01 00 02 a5 a4 15 00 00 00 01 00 02 a6 03 15 00 00 00 01 00 02 a7 ad 15 00 00 00 01 00 02 a9 03 15 00 00 00 01 00 02 aa b3 15 00 00 00 01 00 02 ab 03 15 00 00 00 01 00 02 ac b6 15 00 00 00 01 00 02 ad 03 15 00 00 00 01 00 02 ae ff 15 00 00 00 01 00 02 af 01 15 00 00 00 01 00 02 b0 d2 15 00 00 00 01 00 02 b1 01 15 00 00 00 01 00 02 b2 d3 15 00 00 00 01 00 02 b3 01 15 00 00 00 01 00 02 b4 d6 15 00 00 00 01 00 02 b5 01 15 00 00 00 01 00 02 b6 d9 15 00 00 00 01 00 02 b7 01 15 00 00 00 01 00 02 b8 dc 15 00 00 00 01 00 02 b9 01 15 00 00 00 01 00 02 ba df 15 00 00 00 01 00 02 bb 01 15 00 00 00 01 00 02 bc e1 15 00 00 00 01 00 02 bd 01 15 00 00 00 01 00 02 be e4 15 00 00 00 01 00 02 bf 01 15 00 00 00 01 00 02 c0 e7 15 00 00 00 01 00 02 c1 01 15 00 00 00 01 00 02 c2 f2 15 00 00 00 01 00 02 c3 01 15 00 00 00 01 00 02 c4 f9 15 00 00 00 01 00 02 c5 02 15 00 00 00 01 00 02 c6 06 15 00 00 00 01 00 02 c7 02 15 00 00 00 01 00 02 c8 14 15 00 00 00 01 00 02 c9 02 15 00 00 00 01 00 02 ca 32 15 00 00 00 01 00 02 cb 02 15 00 00 00 01 00 02 cc 55 15 00 00 00 01 00 02 cd 02 15 00 00 00 01 00 02 ce 56 15 00 00 00 01 00 02 cf 02 15 00 00 00 01 00 02 d0 80 15 00 00 00 01 00 02 d1 02 15 00 00 00 01 00 02 d2 ba 15 00 00 00 01 00 02 d3 02 15 00 00 00 01 00 02 d4 e1 15 00 00 00 01 00 02 d5 03 15 00 00 00 01 00 02 d6 10 15 00 00 00 01 00 02 d7 03 15 00 00 00 01 00 02 d8 36 15 00 00 00 01 00 02 d9 03 15 00 00 00 01 00 02 da 6d 15 00 00 00 01 00 02 db 03 15 00 00 00 01 00 02 dc 7c 15 00 00 00 01 00 02 dd 03 15 00 00 00 01 00 02 de 8a 15 00 00 00 01 00 02 df 03 15 00 00 00 01 00 02 e0 98 15 00 00 00 01 00 02 e1 03 15 00 00 00 01 00 02 e2 a4 15 00 00 00 01 00 02 e3 03 15 00 00 00 01 00 02 e4 ad 15 00 00 00 01 00 02 e5 03 15 00 00 00 01 00 02 e6 b3 15 00 00 00 01 00 02 e7 03 15 00 00 00 01 00 02 e8 b6 15 00 00 00 01 00 02 e9 03 15 00 00 00 01 00 02 ea ff 15 00 00 00 01 00 02 fb 01 15 01 00 00 01 00 02 ff 10];
        qcom,mdss-dsi-dispparam-papermode4-state = "dsi_hs_mode";
        qcom,mdss-dsi-dispparam-papermode5-command = [15 01 00 00 78 00 02 ff 20 15 00 00 00 01 00 02 fb 01 15 00 00 00 01 00 02 75 01 15 00 00 00 01 00 02 76 5f 15 00 00 00 01 00 02 77 01 15 00 00 00 01 00 02 78 62 15 00 00 00 01 00 02 79 01 15 00 00 00 01 00 02 7a 68 15 00 00 00 01 00 02 7b 01 15 00 00 00 01 00 02 7c 6d 15 00 00 00 01 00 02 7d 01 15 00 00 00 01 00 02 7e 72 15 00 00 00 01 00 02 7f 01 15 00 00 00 01 00 02 80 77 15 00 00 00 01 00 02 81 01 15 00 00 00 01 00 02 82 7d 15 00 00 00 01 00 02 83 01 15 00 00 00 01 00 02 84 81 15 00 00 00 01 00 02 85 01 15 00 00 00 01 00 02 86 86 15 00 00 00 01 00 02 87 01 15 00 00 00 01 00 02 88 99 15 00 00 00 01 00 02 89 01 15 00 00 00 01 00 02 8a a9 15 00 00 00 01 00 02 8b 01 15 00 00 00 01 00 02 8c c8 15 00 00 00 01 00 02 8d 01 15 00 00 00 01 00 02 8e e5 15 00 00 00 01 00 02 8f 02 15 00 00 00 01 00 02 90 0c 15 00 00 00 01 00 02 91 02 15 00 00 00 01 00 02 92 31 15 00 00 00 01 00 02 93 02 15 00 00 00 01 00 02 94 33 15 00 00 00 01 00 02 95 02 15 00 00 00 01 00 02 96 5f 15 00 00 00 01 00 02 97 02 15 00 00 00 01 00 02 98 9b 15 00 00 00 01 00 02 99 02 15 00 00 00 01 00 02 9a c4 15 00 00 00 01 00 02 9b 02 15 00 00 00 01 00 02 9c fa 15 00 00 00 01 00 02 9d 03 15 00 00 00 01 00 02 9e 16 15 00 00 00 01 00 02 9f 03 15 00 00 00 01 00 02 a0 4e 15 00 00 00 01 00 02 a2 03 15 00 00 00 01 00 02 a3 5f 15 00 00 00 01 00 02 a4 03 15 00 00 00 01 00 02 a5 72 15 00 00 00 01 00 02 a6 03 15 00 00 00 01 00 02 a7 86 15 00 00 00 01 00 02 a9 03 15 00 00 00 01 00 02 aa 98 15 00 00 00 01 00 02 ab 03 15 00 00 00 01 00 02 ac a7 15 00 00 00 01 00 02 ad 03 15 00 00 00 01 00 02 ae b1 15 00 00 00 01 00 02 af 03 15 00 00 00 01 00 02 b0 b6 15 00 00 00 01 00 02 b1 03 15 00 00 00 01 00 02 b2 ff 15 00 00 00 01 00 02 b3 01 15 00 00 00 01 00 02 b4 5f 15 00 00 00 01 00 02 b5 01 15 00 00 00 01 00 02 b6 62 15 00 00 00 01 00 02 b7 01 15 00 00 00 01 00 02 b8 68 15 00 00 00 01 00 02 b9 01 15 00 00 00 01 00 02 ba 6d 15 00 00 00 01 00 02 bb 01 15 00 00 00 01 00 02 bc 72 15 00 00 00 01 00 02 bd 01 15 00 00 00 01 00 02 be 77 15 00 00 00 01 00 02 bf 01 15 00 00 00 01 00 02 c0 7d 15 00 00 00 01 00 02 c1 01 15 00 00 00 01 00 02 c2 81 15 00 00 00 01 00 02 c3 01 15 00 00 00 01 00 02 c4 86 15 00 00 00 01 00 02 c5 01 15 00 00 00 01 00 02 c6 99 15 00 00 00 01 00 02 c7 01 15 00 00 00 01 00 02 c8 a9 15 00 00 00 01 00 02 c9 01 15 00 00 00 01 00 02 ca c8 15 00 00 00 01 00 02 cb 01 15 00 00 00 01 00 02 cc e5 15 00 00 00 01 00 02 cd 02 15 00 00 00 01 00 02 ce 0c 15 00 00 00 01 00 02 cf 02 15 00 00 00 01 00 02 d0 31 15 00 00 00 01 00 02 d1 02 15 00 00 00 01 00 02 d2 33 15 00 00 00 01 00 02 d3 02 15 00 00 00 01 00 02 d4 5f 15 00 00 00 01 00 02 d5 02 15 00 00 00 01 00 02 d6 9b 15 00 00 00 01 00 02 d7 02 15 00 00 00 01 00 02 d8 c4 15 00 00 00 01 00 02 d9 02 15 00 00 00 01 00 02 da fa 15 00 00 00 01 00 02 db 03 15 00 00 00 01 00 02 dc 16 15 00 00 00 01 00 02 dd 03 15 00 00 00 01 00 02 de 4e 15 00 00 00 01 00 02 df 03 15 00 00 00 01 00 02 e0 5f 15 00 00 00 01 00 02 e1 03 15 00 00 00 01 00 02 e2 72 15 00 00 00 01 00 02 e3 03 15 00 00 00 01 00 02 e4 86 15 00 00 00 01 00 02 e5 03 15 00 00 00 01 00 02 e6 98 15 00 00 00 01 00 02 e7 03 15 00 00 00 01 00 02 e8 a7 15 00 00 00 01 00 02 e9 03 15 00 00 00 01 00 02 ea b1 15 00 00 00 01 00 02 eb 03 15 00 00 00 01 00 02 ec b6 15 00 00 00 01 00 02 ed 03 15 00 00 00 01 00 02 ee ff 15 00 00 00 01 00 02 ef 01 15 00 00 00 01 00 02 f0 5f 15 00 00 00 01 00 02 f1 01 15 00 00 00 01 00 02 f2 62 15 00 00 00 01 00 02 f3 01 15 00 00 00 01 00 02 f4 68 15 00 00 00 01 00 02 f5 01 15 00 00 00 01 00 02 f6 6d 15 00 00 00 01 00 02 f7 01 15 00 00 00 01 00 02 f8 72 15 00 00 00 01 00 02 f9 01 15 00 00 00 01 00 02 fa 78 15 00 00 00 01 00 02 ff 21 15 00 00 00 01 00 02 fb 01 15 00 00 00 01 00 02 00 01 15 00 00 00 01 00 02 01 7d 15 00 00 00 01 00 02 02 01 15 00 00 00 01 00 02 03 82 15 00 00 00 01 00 02 04 01 15 00 00 00 01 00 02 05 86 15 00 00 00 01 00 02 06 01 15 00 00 00 01 00 02 07 99 15 00 00 00 01 00 02 08 01 15 00 00 00 01 00 02 09 a9 15 00 00 00 01 00 02 0a 01 15 00 00 00 01 00 02 0b c8 15 00 00 00 01 00 02 0c 01 15 00 00 00 01 00 02 0d e5 15 00 00 00 01 00 02 0e 02 15 00 00 00 01 00 02 0f 0c 15 00 00 00 01 00 02 10 02 15 00 00 00 01 00 02 11 32 15 00 00 00 01 00 02 12 02 15 00 00 00 01 00 02 13 33 15 00 00 00 01 00 02 14 02 15 00 00 00 01 00 02 15 60 15 00 00 00 01 00 02 16 02 15 00 00 00 01 00 02 17 9c 15 00 00 00 01 00 02 18 02 15 00 00 00 01 00 02 19 c4 15 00 00 00 01 00 02 1a 02 15 00 00 00 01 00 02 1b f8 15 00 00 00 01 00 02 1c 03 15 00 00 00 01 00 02 1d 14 15 00 00 00 01 00 02 1e 03 15 00 00 00 01 00 02 1f 47 15 00 00 00 01 00 02 20 03 15 00 00 00 01 00 02 21 56 15 00 00 00 01 00 02 22 03 15 00 00 00 01 00 02 23 67 15 00 00 00 01 00 02 24 03 15 00 00 00 01 00 02 25 7a 15 00 00 00 01 00 02 26 03 15 00 00 00 01 00 02 27 8f 15 00 00 00 01 00 02 28 03 15 00 00 00 01 00 02 29 a8 15 00 00 00 01 00 02 2a 03 15 00 00 00 01 00 02 2b be 15 00 00 00 01 00 02 2d 03 15 00 00 00 01 00 02 2f cc 15 00 00 00 01 00 02 30 03 15 00 00 00 01 00 02 31 ff 15 00 00 00 01 00 02 32 01 15 00 00 00 01 00 02 33 5f 15 00 00 00 01 00 02 34 01 15 00 00 00 01 00 02 35 62 15 00 00 00 01 00 02 36 01 15 00 00 00 01 00 02 37 68 15 00 00 00 01 00 02 38 01 15 00 00 00 01 00 02 39 6d 15 00 00 00 01 00 02 3a 01 15 00 00 00 01 00 02 3b 72 15 00 00 00 01 00 02 3d 01 15 00 00 00 01 00 02 3f 78 15 00 00 00 01 00 02 40 01 15 00 00 00 01 00 02 41 7d 15 00 00 00 01 00 02 42 01 15 00 00 00 01 00 02 43 82 15 00 00 00 01 00 02 44 01 15 00 00 00 01 00 02 45 86 15 00 00 00 01 00 02 46 01 15 00 00 00 01 00 02 47 99 15 00 00 00 01 00 02 48 01 15 00 00 00 01 00 02 49 a9 15 00 00 00 01 00 02 4a 01 15 00 00 00 01 00 02 4b c8 15 00 00 00 01 00 02 4c 01 15 00 00 00 01 00 02 4d e5 15 00 00 00 01 00 02 4e 02 15 00 00 00 01 00 02 4f 0c 15 00 00 00 01 00 02 50 02 15 00 00 00 01 00 02 51 32 15 00 00 00 01 00 02 52 02 15 00 00 00 01 00 02 53 33 15 00 00 00 01 00 02 54 02 15 00 00 00 01 00 02 55 60 15 00 00 00 01 00 02 56 02 15 00 00 00 01 00 02 58 9c 15 00 00 00 01 00 02 59 02 15 00 00 00 01 00 02 5a c4 15 00 00 00 01 00 02 5b 02 15 00 00 00 01 00 02 5c f8 15 00 00 00 01 00 02 5d 03 15 00 00 00 01 00 02 5e 14 15 00 00 00 01 00 02 5f 03 15 00 00 00 01 00 02 60 47 15 00 00 00 01 00 02 61 03 15 00 00 00 01 00 02 62 56 15 00 00 00 01 00 02 63 03 15 00 00 00 01 00 02 64 67 15 00 00 00 01 00 02 65 03 15 00 00 00 01 00 02 66 7a 15 00 00 00 01 00 02 67 03 15 00 00 00 01 00 02 68 8f 15 00 00 00 01 00 02 69 03 15 00 00 00 01 00 02 6a a8 15 00 00 00 01 00 02 6b 03 15 00 00 00 01 00 02 6c be 15 00 00 00 01 00 02 6d 03 15 00 00 00 01 00 02 6e cc 15 00 00 00 01 00 02 6f 03 15 00 00 00 01 00 02 70 ff 15 00 00 00 01 00 02 71 01 15 00 00 00 01 00 02 72 e5 15 00 00 00 01 00 02 73 01 15 00 00 00 01 00 02 74 e6 15 00 00 00 01 00 02 75 01 15 00 00 00 01 00 02 76 e9 15 00 00 00 01 00 02 77 01 15 00 00 00 01 00 02 78 ec 15 00 00 00 01 00 02 79 01 15 00 00 00 01 00 02 7a ee 15 00 00 00 01 00 02 7b 01 15 00 00 00 01 00 02 7c f1 15 00 00 00 01 00 02 7d 01 15 00 00 00 01 00 02 7e f3 15 00 00 00 01 00 02 7f 01 15 00 00 00 01 00 02 80 f5 15 00 00 00 01 00 02 81 01 15 00 00 00 01 00 02 82 f6 15 00 00 00 01 00 02 83 01 15 00 00 00 01 00 02 84 fd 15 00 00 00 01 00 02 85 02 15 00 00 00 01 00 02 86 03 15 00 00 00 01 00 02 87 02 15 00 00 00 01 00 02 88 10 15 00 00 00 01 00 02 89 02 15 00 00 00 01 00 02 8a 1d 15 00 00 00 01 00 02 8b 02 15 00 00 00 01 00 02 8c 3b 15 00 00 00 01 00 02 8d 02 15 00 00 00 01 00 02 8e 5d 15 00 00 00 01 00 02 8f 02 15 00 00 00 01 00 02 90 5e 15 00 00 00 01 00 02 91 02 15 00 00 00 01 00 02 92 88 15 00 00 00 01 00 02 93 02 15 00 00 00 01 00 02 94 c1 15 00 00 00 01 00 02 95 02 15 00 00 00 01 00 02 96 e8 15 00 00 00 01 00 02 97 03 15 00 00 00 01 00 02 98 15 15 00 00 00 01 00 02 99 03 15 00 00 00 01 00 02 9a 3e 15 00 00 00 01 00 02 9b 03 15 00 00 00 01 00 02 9c 73 15 00 00 00 01 00 02 9d 03 15 00 00 00 01 00 02 9e 81 15 00 00 00 01 00 02 9f 03 15 00 00 00 01 00 02 a0 8e 15 00 00 00 01 00 02 a2 03 15 00 00 00 01 00 02 a3 9b 15 00 00 00 01 00 02 a4 03 15 00 00 00 01 00 02 a5 a6 15 00 00 00 01 00 02 a6 03 15 00 00 00 01 00 02 a7 ae 15 00 00 00 01 00 02 a9 03 15 00 00 00 01 00 02 aa b4 15 00 00 00 01 00 02 ab 03 15 00 00 00 01 00 02 ac b6 15 00 00 00 01 00 02 ad 03 15 00 00 00 01 00 02 ae ff 15 00 00 00 01 00 02 af 01 15 00 00 00 01 00 02 b0 e5 15 00 00 00 01 00 02 b1 01 15 00 00 00 01 00 02 b2 e6 15 00 00 00 01 00 02 b3 01 15 00 00 00 01 00 02 b4 e9 15 00 00 00 01 00 02 b5 01 15 00 00 00 01 00 02 b6 ec 15 00 00 00 01 00 02 b7 01 15 00 00 00 01 00 02 b8 ee 15 00 00 00 01 00 02 b9 01 15 00 00 00 01 00 02 ba f1 15 00 00 00 01 00 02 bb 01 15 00 00 00 01 00 02 bc f3 15 00 00 00 01 00 02 bd 01 15 00 00 00 01 00 02 be f5 15 00 00 00 01 00 02 bf 01 15 00 00 00 01 00 02 c0 f6 15 00 00 00 01 00 02 c1 01 15 00 00 00 01 00 02 c2 fd 15 00 00 00 01 00 02 c3 02 15 00 00 00 01 00 02 c4 03 15 00 00 00 01 00 02 c5 02 15 00 00 00 01 00 02 c6 10 15 00 00 00 01 00 02 c7 02 15 00 00 00 01 00 02 c8 1d 15 00 00 00 01 00 02 c9 02 15 00 00 00 01 00 02 ca 3b 15 00 00 00 01 00 02 cb 02 15 00 00 00 01 00 02 cc 5d 15 00 00 00 01 00 02 cd 02 15 00 00 00 01 00 02 ce 5e 15 00 00 00 01 00 02 cf 02 15 00 00 00 01 00 02 d0 88 15 00 00 00 01 00 02 d1 02 15 00 00 00 01 00 02 d2 c1 15 00 00 00 01 00 02 d3 02 15 00 00 00 01 00 02 d4 e8 15 00 00 00 01 00 02 d5 03 15 00 00 00 01 00 02 d6 15 15 00 00 00 01 00 02 d7 03 15 00 00 00 01 00 02 d8 3e 15 00 00 00 01 00 02 d9 03 15 00 00 00 01 00 02 da 73 15 00 00 00 01 00 02 db 03 15 00 00 00 01 00 02 dc 81 15 00 00 00 01 00 02 dd 03 15 00 00 00 01 00 02 de 8e 15 00 00 00 01 00 02 df 03 15 00 00 00 01 00 02 e0 9b 15 00 00 00 01 00 02 e1 03 15 00 00 00 01 00 02 e2 a6 15 00 00 00 01 00 02 e3 03 15 00 00 00 01 00 02 e4 ae 15 00 00 00 01 00 02 e5 03 15 00 00 00 01 00 02 e6 b4 15 00 00 00 01 00 02 e7 03 15 00 00 00 01 00 02 e8 b6 15 00 00 00 01 00 02 e9 03 15 00 00 00 01 00 02 ea ff 15 00 00 00 01 00 02 fb 01 15 01 00 00 01 00 02 ff 10];
        qcom,mdss-dsi-dispparam-papermode5-state = "dsi_hs_mode";
        qcom,mdss-dsi-dispparam-papermode6-command = [15 01 00 00 78 00 02 ff 20 15 00 00 00 01 00 02 fb 01 15 00 00 00 01 00 02 75 01 15 00 00 00 01 00 02 76 60 15 00 00 00 01 00 02 77 01 15 00 00 00 01 00 02 78 63 15 00 00 00 01 00 02 79 01 15 00 00 00 01 00 02 7a 68 15 00 00 00 01 00 02 7b 01 15 00 00 00 01 00 02 7c 6e 15 00 00 00 01 00 02 7d 01 15 00 00 00 01 00 02 7e 73 15 00 00 00 01 00 02 7f 01 15 00 00 00 01 00 02 80 78 15 00 00 00 01 00 02 81 01 15 00 00 00 01 00 02 82 7d 15 00 00 00 01 00 02 83 01 15 00 00 00 01 00 02 84 82 15 00 00 00 01 00 02 85 01 15 00 00 00 01 00 02 86 87 15 00 00 00 01 00 02 87 01 15 00 00 00 01 00 02 88 99 15 00 00 00 01 00 02 89 01 15 00 00 00 01 00 02 8a aa 15 00 00 00 01 00 02 8b 01 15 00 00 00 01 00 02 8c c9 15 00 00 00 01 00 02 8d 01 15 00 00 00 01 00 02 8e e5 15 00 00 00 01 00 02 8f 02 15 00 00 00 01 00 02 90 0c 15 00 00 00 01 00 02 91 02 15 00 00 00 01 00 02 92 31 15 00 00 00 01 00 02 93 02 15 00 00 00 01 00 02 94 33 15 00 00 00 01 00 02 95 02 15 00 00 00 01 00 02 96 60 15 00 00 00 01 00 02 97 02 15 00 00 00 01 00 02 98 9b 15 00 00 00 01 00 02 99 02 15 00 00 00 01 00 02 9a c4 15 00 00 00 01 00 02 9b 02 15 00 00 00 01 00 02 9c fa 15 00 00 00 01 00 02 9d 03 15 00 00 00 01 00 02 9e 17 15 00 00 00 01 00 02 9f 03 15 00 00 00 01 00 02 a0 4e 15 00 00 00 01 00 02 a2 03 15 00 00 00 01 00 02 a3 60 15 00 00 00 01 00 02 a4 03 15 00 00 00 01 00 02 a5 73 15 00 00 00 01 00 02 a6 03 15 00 00 00 01 00 02 a7 86 15 00 00 00 01 00 02 a9 03 15 00 00 00 01 00 02 aa 98 15 00 00 00 01 00 02 ab 03 15 00 00 00 01 00 02 ac a7 15 00 00 00 01 00 02 ad 03 15 00 00 00 01 00 02 ae b1 15 00 00 00 01 00 02 af 03 15 00 00 00 01 00 02 b0 b6 15 00 00 00 01 00 02 b1 03 15 00 00 00 01 00 02 b2 ff 15 00 00 00 01 00 02 b3 01 15 00 00 00 01 00 02 b4 60 15 00 00 00 01 00 02 b5 01 15 00 00 00 01 00 02 b6 63 15 00 00 00 01 00 02 b7 01 15 00 00 00 01 00 02 b8 68 15 00 00 00 01 00 02 b9 01 15 00 00 00 01 00 02 ba 6e 15 00 00 00 01 00 02 bb 01 15 00 00 00 01 00 02 bc 73 15 00 00 00 01 00 02 bd 01 15 00 00 00 01 00 02 be 78 15 00 00 00 01 00 02 bf 01 15 00 00 00 01 00 02 c0 7d 15 00 00 00 01 00 02 c1 01 15 00 00 00 01 00 02 c2 82 15 00 00 00 01 00 02 c3 01 15 00 00 00 01 00 02 c4 87 15 00 00 00 01 00 02 c5 01 15 00 00 00 01 00 02 c6 99 15 00 00 00 01 00 02 c7 01 15 00 00 00 01 00 02 c8 aa 15 00 00 00 01 00 02 c9 01 15 00 00 00 01 00 02 ca c9 15 00 00 00 01 00 02 cb 01 15 00 00 00 01 00 02 cc e5 15 00 00 00 01 00 02 cd 02 15 00 00 00 01 00 02 ce 0c 15 00 00 00 01 00 02 cf 02 15 00 00 00 01 00 02 d0 31 15 00 00 00 01 00 02 d1 02 15 00 00 00 01 00 02 d2 33 15 00 00 00 01 00 02 d3 02 15 00 00 00 01 00 02 d4 60 15 00 00 00 01 00 02 d5 02 15 00 00 00 01 00 02 d6 9b 15 00 00 00 01 00 02 d7 02 15 00 00 00 01 00 02 d8 c4 15 00 00 00 01 00 02 d9 02 15 00 00 00 01 00 02 da fa 15 00 00 00 01 00 02 db 03 15 00 00 00 01 00 02 dc 17 15 00 00 00 01 00 02 dd 03 15 00 00 00 01 00 02 de 4e 15 00 00 00 01 00 02 df 03 15 00 00 00 01 00 02 e0 60 15 00 00 00 01 00 02 e1 03 15 00 00 00 01 00 02 e2 73 15 00 00 00 01 00 02 e3 03 15 00 00 00 01 00 02 e4 86 15 00 00 00 01 00 02 e5 03 15 00 00 00 01 00 02 e6 98 15 00 00 00 01 00 02 e7 03 15 00 00 00 01 00 02 e8 a7 15 00 00 00 01 00 02 e9 03 15 00 00 00 01 00 02 ea b1 15 00 00 00 01 00 02 eb 03 15 00 00 00 01 00 02 ec b6 15 00 00 00 01 00 02 ed 03 15 00 00 00 01 00 02 ee ff 15 00 00 00 01 00 02 ef 01 15 00 00 00 01 00 02 f0 6a 15 00 00 00 01 00 02 f1 01 15 00 00 00 01 00 02 f2 6d 15 00 00 00 01 00 02 f3 01 15 00 00 00 01 00 02 f4 72 15 00 00 00 01 00 02 f5 01 15 00 00 00 01 00 02 f6 77 15 00 00 00 01 00 02 f7 01 15 00 00 00 01 00 02 f8 7c 15 00 00 00 01 00 02 f9 01 15 00 00 00 01 00 02 fa 81 15 00 00 00 01 00 02 ff 21 15 00 00 00 01 00 02 fb 01 15 00 00 00 01 00 02 00 01 15 00 00 00 01 00 02 01 86 15 00 00 00 01 00 02 02 01 15 00 00 00 01 00 02 03 8a 15 00 00 00 01 00 02 04 01 15 00 00 00 01 00 02 05 8f 15 00 00 00 01 00 02 06 01 15 00 00 00 01 00 02 07 a0 15 00 00 00 01 00 02 08 01 15 00 00 00 01 00 02 09 b0 15 00 00 00 01 00 02 0a 01 15 00 00 00 01 00 02 0b ce 15 00 00 00 01 00 02 0c 01 15 00 00 00 01 00 02 0d ea 15 00 00 00 01 00 02 0e 02 15 00 00 00 01 00 02 0f 0f 15 00 00 00 01 00 02 10 02 15 00 00 00 01 00 02 11 34 15 00 00 00 01 00 02 12 02 15 00 00 00 01 00 02 13 35 15 00 00 00 01 00 02 14 02 15 00 00 00 01 00 02 15 62 15 00 00 00 01 00 02 16 02 15 00 00 00 01 00 02 17 9e 15 00 00 00 01 00 02 18 02 15 00 00 00 01 00 02 19 c6 15 00 00 00 01 00 02 1a 02 15 00 00 00 01 00 02 1b fa 15 00 00 00 01 00 02 1c 03 15 00 00 00 01 00 02 1d 16 15 00 00 00 01 00 02 1e 03 15 00 00 00 01 00 02 1f 48 15 00 00 00 01 00 02 20 03 15 00 00 00 01 00 02 21 57 15 00 00 00 01 00 02 22 03 15 00 00 00 01 00 02 23 68 15 00 00 00 01 00 02 24 03 15 00 00 00 01 00 02 25 7b 15 00 00 00 01 00 02 26 03 15 00 00 00 01 00 02 27 91 15 00 00 00 01 00 02 28 03 15 00 00 00 01 00 02 29 a9 15 00 00 00 01 00 02 2a 03 15 00 00 00 01 00 02 2b bf 15 00 00 00 01 00 02 2d 03 15 00 00 00 01 00 02 2f cc 15 00 00 00 01 00 02 30 03 15 00 00 00 01 00 02 31 ff 15 00 00 00 01 00 02 32 01 15 00 00 00 01 00 02 33 6a 15 00 00 00 01 00 02 34 01 15 00 00 00 01 00 02 35 6d 15 00 00 00 01 00 02 36 01 15 00 00 00 01 00 02 37 72 15 00 00 00 01 00 02 38 01 15 00 00 00 01 00 02 39 77 15 00 00 00 01 00 02 3a 01 15 00 00 00 01 00 02 3b 7c 15 00 00 00 01 00 02 3d 01 15 00 00 00 01 00 02 3f 81 15 00 00 00 01 00 02 40 01 15 00 00 00 01 00 02 41 86 15 00 00 00 01 00 02 42 01 15 00 00 00 01 00 02 43 8a 15 00 00 00 01 00 02 44 01 15 00 00 00 01 00 02 45 8f 15 00 00 00 01 00 02 46 01 15 00 00 00 01 00 02 47 a0 15 00 00 00 01 00 02 48 01 15 00 00 00 01 00 02 49 b0 15 00 00 00 01 00 02 4a 01 15 00 00 00 01 00 02 4b ce 15 00 00 00 01 00 02 4c 01 15 00 00 00 01 00 02 4d ea 15 00 00 00 01 00 02 4e 02 15 00 00 00 01 00 02 4f 0f 15 00 00 00 01 00 02 50 02 15 00 00 00 01 00 02 51 34 15 00 00 00 01 00 02 52 02 15 00 00 00 01 00 02 53 35 15 00 00 00 01 00 02 54 02 15 00 00 00 01 00 02 55 62 15 00 00 00 01 00 02 56 02 15 00 00 00 01 00 02 58 9e 15 00 00 00 01 00 02 59 02 15 00 00 00 01 00 02 5a c6 15 00 00 00 01 00 02 5b 02 15 00 00 00 01 00 02 5c fa 15 00 00 00 01 00 02 5d 03 15 00 00 00 01 00 02 5e 16 15 00 00 00 01 00 02 5f 03 15 00 00 00 01 00 02 60 48 15 00 00 00 01 00 02 61 03 15 00 00 00 01 00 02 62 57 15 00 00 00 01 00 02 63 03 15 00 00 00 01 00 02 64 68 15 00 00 00 01 00 02 65 03 15 00 00 00 01 00 02 66 7b 15 00 00 00 01 00 02 67 03 15 00 00 00 01 00 02 68 91 15 00 00 00 01 00 02 69 03 15 00 00 00 01 00 02 6a a9 15 00 00 00 01 00 02 6b 03 15 00 00 00 01 00 02 6c bf 15 00 00 00 01 00 02 6d 03 15 00 00 00 01 00 02 6e cc 15 00 00 00 01 00 02 6f 03 15 00 00 00 01 00 02 70 ff 15 00 00 00 01 00 02 71 01 15 00 00 00 01 00 02 72 f4 15 00 00 00 01 00 02 73 01 15 00 00 00 01 00 02 74 f5 15 00 00 00 01 00 02 75 01 15 00 00 00 01 00 02 76 f6 15 00 00 00 01 00 02 77 01 15 00 00 00 01 00 02 78 f7 15 00 00 00 01 00 02 79 01 15 00 00 00 01 00 02 7a f8 15 00 00 00 01 00 02 7b 01 15 00 00 00 01 00 02 7c f9 15 00 00 00 01 00 02 7d 01 15 00 00 00 01 00 02 7e fa 15 00 00 00 01 00 02 7f 01 15 00 00 00 01 00 02 80 fc 15 00 00 00 01 00 02 81 01 15 00 00 00 01 00 02 82 fd 15 00 00 00 01 00 02 83 02 15 00 00 00 01 00 02 84 03 15 00 00 00 01 00 02 85 02 15 00 00 00 01 00 02 86 09 15 00 00 00 01 00 02 87 02 15 00 00 00 01 00 02 88 16 15 00 00 00 01 00 02 89 02 15 00 00 00 01 00 02 8a 23 15 00 00 00 01 00 02 8b 02 15 00 00 00 01 00 02 8c 41 15 00 00 00 01 00 02 8d 02 15 00 00 00 01 00 02 8e 62 15 00 00 00 01 00 02 8f 02 15 00 00 00 01 00 02 90 64 15 00 00 00 01 00 02 91 02 15 00 00 00 01 00 02 92 8d 15 00 00 00 01 00 02 93 02 15 00 00 00 01 00 02 94 c6 15 00 00 00 01 00 02 95 02 15 00 00 00 01 00 02 96 ec 15 00 00 00 01 00 02 97 03 15 00 00 00 01 00 02 98 18 15 00 00 00 01 00 02 99 03 15 00 00 00 01 00 02 9a 43 15 00 00 00 01 00 02 9b 03 15 00 00 00 01 00 02 9c 77 15 00 00 00 01 00 02 9d 03 15 00 00 00 01 00 02 9e 84 15 00 00 00 01 00 02 9f 03 15 00 00 00 01 00 02 a0 91 15 00 00 00 01 00 02 a2 03 15 00 00 00 01 00 02 a3 9d 15 00 00 00 01 00 02 a4 03 15 00 00 00 01 00 02 a5 a7 15 00 00 00 01 00 02 a6 03 15 00 00 00 01 00 02 a7 af 15 00 00 00 01 00 02 a9 03 15 00 00 00 01 00 02 aa b4 15 00 00 00 01 00 02 ab 03 15 00 00 00 01 00 02 ac b6 15 00 00 00 01 00 02 ad 03 15 00 00 00 01 00 02 ae ff 15 00 00 00 01 00 02 af 01 15 00 00 00 01 00 02 b0 f4 15 00 00 00 01 00 02 b1 01 15 00 00 00 01 00 02 b2 f5 15 00 00 00 01 00 02 b3 01 15 00 00 00 01 00 02 b4 f6 15 00 00 00 01 00 02 b5 01 15 00 00 00 01 00 02 b6 f7 15 00 00 00 01 00 02 b7 01 15 00 00 00 01 00 02 b8 f8 15 00 00 00 01 00 02 b9 01 15 00 00 00 01 00 02 ba f9 15 00 00 00 01 00 02 bb 01 15 00 00 00 01 00 02 bc fa 15 00 00 00 01 00 02 bd 01 15 00 00 00 01 00 02 be fc 15 00 00 00 01 00 02 bf 01 15 00 00 00 01 00 02 c0 fd 15 00 00 00 01 00 02 c1 02 15 00 00 00 01 00 02 c2 03 15 00 00 00 01 00 02 c3 02 15 00 00 00 01 00 02 c4 09 15 00 00 00 01 00 02 c5 02 15 00 00 00 01 00 02 c6 16 15 00 00 00 01 00 02 c7 02 15 00 00 00 01 00 02 c8 23 15 00 00 00 01 00 02 c9 02 15 00 00 00 01 00 02 ca 41 15 00 00 00 01 00 02 cb 02 15 00 00 00 01 00 02 cc 62 15 00 00 00 01 00 02 cd 02 15 00 00 00 01 00 02 ce 64 15 00 00 00 01 00 02 cf 02 15 00 00 00 01 00 02 d0 8d 15 00 00 00 01 00 02 d1 02 15 00 00 00 01 00 02 d2 c6 15 00 00 00 01 00 02 d3 02 15 00 00 00 01 00 02 d4 ec 15 00 00 00 01 00 02 d5 03 15 00 00 00 01 00 02 d6 18 15 00 00 00 01 00 02 d7 03 15 00 00 00 01 00 02 d8 43 15 00 00 00 01 00 02 d9 03 15 00 00 00 01 00 02 da 77 15 00 00 00 01 00 02 db 03 15 00 00 00 01 00 02 dc 84 15 00 00 00 01 00 02 dd 03 15 00 00 00 01 00 02 de 91 15 00 00 00 01 00 02 df 03 15 00 00 00 01 00 02 e0 9d 15 00 00 00 01 00 02 e1 03 15 00 00 00 01 00 02 e2 a7 15 00 00 00 01 00 02 e3 03 15 00 00 00 01 00 02 e4 af 15 00 00 00 01 00 02 e5 03 15 00 00 00 01 00 02 e6 b4 15 00 00 00 01 00 02 e7 03 15 00 00 00 01 00 02 e8 b6 15 00 00 00 01 00 02 e9 03 15 00 00 00 01 00 02 ea ff 15 00 00 00 01 00 02 fb 01 15 01 00 00 01 00 02 ff 10];
        qcom,mdss-dsi-dispparam-papermode6-state = "dsi_hs_mode";
        qcom,mdss-dsi-dispparam-papermode7-command = [15 01 00 00 78 00 02 ff 20 15 00 00 00 01 00 02 fb 01 15 00 00 00 01 00 02 75 01 15 00 00 00 01 00 02 76 60 15 00 00 00 01 00 02 77 01 15 00 00 00 01 00 02 78 63 15 00 00 00 01 00 02 79 01 15 00 00 00 01 00 02 7a 68 15 00 00 00 01 00 02 7b 01 15 00 00 00 01 00 02 7c 6e 15 00 00 00 01 00 02 7d 01 15 00 00 00 01 00 02 7e 73 15 00 00 00 01 00 02 7f 01 15 00 00 00 01 00 02 80 78 15 00 00 00 01 00 02 81 01 15 00 00 00 01 00 02 82 7d 15 00 00 00 01 00 02 83 01 15 00 00 00 01 00 02 84 82 15 00 00 00 01 00 02 85 01 15 00 00 00 01 00 02 86 87 15 00 00 00 01 00 02 87 01 15 00 00 00 01 00 02 88 99 15 00 00 00 01 00 02 89 01 15 00 00 00 01 00 02 8a aa 15 00 00 00 01 00 02 8b 01 15 00 00 00 01 00 02 8c c9 15 00 00 00 01 00 02 8d 01 15 00 00 00 01 00 02 8e e5 15 00 00 00 01 00 02 8f 02 15 00 00 00 01 00 02 90 0c 15 00 00 00 01 00 02 91 02 15 00 00 00 01 00 02 92 31 15 00 00 00 01 00 02 93 02 15 00 00 00 01 00 02 94 33 15 00 00 00 01 00 02 95 02 15 00 00 00 01 00 02 96 60 15 00 00 00 01 00 02 97 02 15 00 00 00 01 00 02 98 9b 15 00 00 00 01 00 02 99 02 15 00 00 00 01 00 02 9a c4 15 00 00 00 01 00 02 9b 02 15 00 00 00 01 00 02 9c fa 15 00 00 00 01 00 02 9d 03 15 00 00 00 01 00 02 9e 17 15 00 00 00 01 00 02 9f 03 15 00 00 00 01 00 02 a0 4e 15 00 00 00 01 00 02 a2 03 15 00 00 00 01 00 02 a3 60 15 00 00 00 01 00 02 a4 03 15 00 00 00 01 00 02 a5 73 15 00 00 00 01 00 02 a6 03 15 00 00 00 01 00 02 a7 86 15 00 00 00 01 00 02 a9 03 15 00 00 00 01 00 02 aa 98 15 00 00 00 01 00 02 ab 03 15 00 00 00 01 00 02 ac a7 15 00 00 00 01 00 02 ad 03 15 00 00 00 01 00 02 ae b1 15 00 00 00 01 00 02 af 03 15 00 00 00 01 00 02 b0 b6 15 00 00 00 01 00 02 b1 03 15 00 00 00 01 00 02 b2 ff 15 00 00 00 01 00 02 b3 01 15 00 00 00 01 00 02 b4 60 15 00 00 00 01 00 02 b5 01 15 00 00 00 01 00 02 b6 63 15 00 00 00 01 00 02 b7 01 15 00 00 00 01 00 02 b8 68 15 00 00 00 01 00 02 b9 01 15 00 00 00 01 00 02 ba 6e 15 00 00 00 01 00 02 bb 01 15 00 00 00 01 00 02 bc 73 15 00 00 00 01 00 02 bd 01 15 00 00 00 01 00 02 be 78 15 00 00 00 01 00 02 bf 01 15 00 00 00 01 00 02 c0 7d 15 00 00 00 01 00 02 c1 01 15 00 00 00 01 00 02 c2 82 15 00 00 00 01 00 02 c3 01 15 00 00 00 01 00 02 c4 87 15 00 00 00 01 00 02 c5 01 15 00 00 00 01 00 02 c6 99 15 00 00 00 01 00 02 c7 01 15 00 00 00 01 00 02 c8 aa 15 00 00 00 01 00 02 c9 01 15 00 00 00 01 00 02 ca c9 15 00 00 00 01 00 02 cb 01 15 00 00 00 01 00 02 cc e5 15 00 00 00 01 00 02 cd 02 15 00 00 00 01 00 02 ce 0c 15 00 00 00 01 00 02 cf 02 15 00 00 00 01 00 02 d0 31 15 00 00 00 01 00 02 d1 02 15 00 00 00 01 00 02 d2 33 15 00 00 00 01 00 02 d3 02 15 00 00 00 01 00 02 d4 60 15 00 00 00 01 00 02 d5 02 15 00 00 00 01 00 02 d6 9b 15 00 00 00 01 00 02 d7 02 15 00 00 00 01 00 02 d8 c4 15 00 00 00 01 00 02 d9 02 15 00 00 00 01 00 02 da fa 15 00 00 00 01 00 02 db 03 15 00 00 00 01 00 02 dc 17 15 00 00 00 01 00 02 dd 03 15 00 00 00 01 00 02 de 4e 15 00 00 00 01 00 02 df 03 15 00 00 00 01 00 02 e0 60 15 00 00 00 01 00 02 e1 03 15 00 00 00 01 00 02 e2 73 15 00 00 00 01 00 02 e3 03 15 00 00 00 01 00 02 e4 86 15 00 00 00 01 00 02 e5 03 15 00 00 00 01 00 02 e6 98 15 00 00 00 01 00 02 e7 03 15 00 00 00 01 00 02 e8 a7 15 00 00 00 01 00 02 e9 03 15 00 00 00 01 00 02 ea b1 15 00 00 00 01 00 02 eb 03 15 00 00 00 01 00 02 ec b6 15 00 00 00 01 00 02 ed 03 15 00 00 00 01 00 02 ee ff 15 00 00 00 01 00 02 ef 01 15 00 00 00 01 00 02 f0 6a 15 00 00 00 01 00 02 f1 01 15 00 00 00 01 00 02 f2 6d 15 00 00 00 01 00 02 f3 01 15 00 00 00 01 00 02 f4 72 15 00 00 00 01 00 02 f5 01 15 00 00 00 01 00 02 f6 77 15 00 00 00 01 00 02 f7 01 15 00 00 00 01 00 02 f8 7c 15 00 00 00 01 00 02 f9 01 15 00 00 00 01 00 02 fa 81 15 00 00 00 01 00 02 ff 21 15 00 00 00 01 00 02 fb 01 15 00 00 00 01 00 02 00 01 15 00 00 00 01 00 02 01 86 15 00 00 00 01 00 02 02 01 15 00 00 00 01 00 02 03 8a 15 00 00 00 01 00 02 04 01 15 00 00 00 01 00 02 05 8f 15 00 00 00 01 00 02 06 01 15 00 00 00 01 00 02 07 a0 15 00 00 00 01 00 02 08 01 15 00 00 00 01 00 02 09 b0 15 00 00 00 01 00 02 0a 01 15 00 00 00 01 00 02 0b ce 15 00 00 00 01 00 02 0c 01 15 00 00 00 01 00 02 0d ea 15 00 00 00 01 00 02 0e 02 15 00 00 00 01 00 02 0f 0f 15 00 00 00 01 00 02 10 02 15 00 00 00 01 00 02 11 34 15 00 00 00 01 00 02 12 02 15 00 00 00 01 00 02 13 35 15 00 00 00 01 00 02 14 02 15 00 00 00 01 00 02 15 62 15 00 00 00 01 00 02 16 02 15 00 00 00 01 00 02 17 9e 15 00 00 00 01 00 02 18 02 15 00 00 00 01 00 02 19 c6 15 00 00 00 01 00 02 1a 02 15 00 00 00 01 00 02 1b fa 15 00 00 00 01 00 02 1c 03 15 00 00 00 01 00 02 1d 16 15 00 00 00 01 00 02 1e 03 15 00 00 00 01 00 02 1f 48 15 00 00 00 01 00 02 20 03 15 00 00 00 01 00 02 21 57 15 00 00 00 01 00 02 22 03 15 00 00 00 01 00 02 23 68 15 00 00 00 01 00 02 24 03 15 00 00 00 01 00 02 25 7b 15 00 00 00 01 00 02 26 03 15 00 00 00 01 00 02 27 91 15 00 00 00 01 00 02 28 03 15 00 00 00 01 00 02 29 a9 15 00 00 00 01 00 02 2a 03 15 00 00 00 01 00 02 2b bf 15 00 00 00 01 00 02 2d 03 15 00 00 00 01 00 02 2f cc 15 00 00 00 01 00 02 30 03 15 00 00 00 01 00 02 31 ff 15 00 00 00 01 00 02 32 01 15 00 00 00 01 00 02 33 6a 15 00 00 00 01 00 02 34 01 15 00 00 00 01 00 02 35 6d 15 00 00 00 01 00 02 36 01 15 00 00 00 01 00 02 37 72 15 00 00 00 01 00 02 38 01 15 00 00 00 01 00 02 39 77 15 00 00 00 01 00 02 3a 01 15 00 00 00 01 00 02 3b 7c 15 00 00 00 01 00 02 3d 01 15 00 00 00 01 00 02 3f 81 15 00 00 00 01 00 02 40 01 15 00 00 00 01 00 02 41 86 15 00 00 00 01 00 02 42 01 15 00 00 00 01 00 02 43 8a 15 00 00 00 01 00 02 44 01 15 00 00 00 01 00 02 45 8f 15 00 00 00 01 00 02 46 01 15 00 00 00 01 00 02 47 a0 15 00 00 00 01 00 02 48 01 15 00 00 00 01 00 02 49 b0 15 00 00 00 01 00 02 4a 01 15 00 00 00 01 00 02 4b ce 15 00 00 00 01 00 02 4c 01 15 00 00 00 01 00 02 4d ea 15 00 00 00 01 00 02 4e 02 15 00 00 00 01 00 02 4f 0f 15 00 00 00 01 00 02 50 02 15 00 00 00 01 00 02 51 34 15 00 00 00 01 00 02 52 02 15 00 00 00 01 00 02 53 35 15 00 00 00 01 00 02 54 02 15 00 00 00 01 00 02 55 62 15 00 00 00 01 00 02 56 02 15 00 00 00 01 00 02 58 9e 15 00 00 00 01 00 02 59 02 15 00 00 00 01 00 02 5a c6 15 00 00 00 01 00 02 5b 02 15 00 00 00 01 00 02 5c fa 15 00 00 00 01 00 02 5d 03 15 00 00 00 01 00 02 5e 16 15 00 00 00 01 00 02 5f 03 15 00 00 00 01 00 02 60 48 15 00 00 00 01 00 02 61 03 15 00 00 00 01 00 02 62 57 15 00 00 00 01 00 02 63 03 15 00 00 00 01 00 02 64 68 15 00 00 00 01 00 02 65 03 15 00 00 00 01 00 02 66 7b 15 00 00 00 01 00 02 67 03 15 00 00 00 01 00 02 68 91 15 00 00 00 01 00 02 69 03 15 00 00 00 01 00 02 6a a9 15 00 00 00 01 00 02 6b 03 15 00 00 00 01 00 02 6c bf 15 00 00 00 01 00 02 6d 03 15 00 00 00 01 00 02 6e cc 15 00 00 00 01 00 02 6f 03 15 00 00 00 01 00 02 70 ff 15 00 00 00 01 00 02 71 02 15 00 00 00 01 00 02 72 01 15 00 00 00 01 00 02 73 02 15 00 00 00 01 00 02 74 02 15 00 00 00 01 00 02 75 02 15 00 00 00 01 00 02 76 03 15 00 00 00 01 00 02 77 02 15 00 00 00 01 00 02 78 04 15 00 00 00 01 00 02 79 02 15 00 00 00 01 00 02 7a 06 15 00 00 00 01 00 02 7b 02 15 00 00 00 01 00 02 7c 07 15 00 00 00 01 00 02 7d 02 15 00 00 00 01 00 02 7e 09 15 00 00 00 01 00 02 7f 02 15 00 00 00 01 00 02 80 0a 15 00 00 00 01 00 02 81 02 15 00 00 00 01 00 02 82 0c 15 00 00 00 01 00 02 83 02 15 00 00 00 01 00 02 84 11 15 00 00 00 01 00 02 85 02 15 00 00 00 01 00 02 86 17 15 00 00 00 01 00 02 87 02 15 00 00 00 01 00 02 88 24 15 00 00 00 01 00 02 89 02 15 00 00 00 01 00 02 8a 31 15 00 00 00 01 00 02 8b 02 15 00 00 00 01 00 02 8c 4e 15 00 00 00 01 00 02 8d 02 15 00 00 00 01 00 02 8e 6f 15 00 00 00 01 00 02 8f 02 15 00 00 00 01 00 02 90 70 15 00 00 00 01 00 02 91 02 15 00 00 00 01 00 02 92 9a 15 00 00 00 01 00 02 93 02 15 00 00 00 01 00 02 94 d3 15 00 00 00 01 00 02 95 02 15 00 00 00 01 00 02 96 f8 15 00 00 00 01 00 02 97 03 15 00 00 00 01 00 02 98 24 15 00 00 00 01 00 02 99 03 15 00 00 00 01 00 02 9a 4b 15 00 00 00 01 00 02 9b 03 15 00 00 00 01 00 02 9c 7c 15 00 00 00 01 00 02 9d 03 15 00 00 00 01 00 02 9e 89 15 00 00 00 01 00 02 9f 03 15 00 00 00 01 00 02 a0 95 15 00 00 00 01 00 02 a2 03 15 00 00 00 01 00 02 a3 a0 15 00 00 00 01 00 02 a4 03 15 00 00 00 01 00 02 a5 a9 15 00 00 00 01 00 02 a6 03 15 00 00 00 01 00 02 a7 b0 15 00 00 00 01 00 02 a9 03 15 00 00 00 01 00 02 aa b4 15 00 00 00 01 00 02 ab 03 15 00 00 00 01 00 02 ac b6 15 00 00 00 01 00 02 ad 03 15 00 00 00 01 00 02 ae ff 15 00 00 00 01 00 02 af 02 15 00 00 00 01 00 02 b0 01 15 00 00 00 01 00 02 b1 02 15 00 00 00 01 00 02 b2 02 15 00 00 00 01 00 02 b3 02 15 00 00 00 01 00 02 b4 03 15 00 00 00 01 00 02 b5 02 15 00 00 00 01 00 02 b6 04 15 00 00 00 01 00 02 b7 02 15 00 00 00 01 00 02 b8 06 15 00 00 00 01 00 02 b9 02 15 00 00 00 01 00 02 ba 07 15 00 00 00 01 00 02 bb 02 15 00 00 00 01 00 02 bc 09 15 00 00 00 01 00 02 bd 02 15 00 00 00 01 00 02 be 0a 15 00 00 00 01 00 02 bf 02 15 00 00 00 01 00 02 c0 0c 15 00 00 00 01 00 02 c1 02 15 00 00 00 01 00 02 c2 11 15 00 00 00 01 00 02 c3 02 15 00 00 00 01 00 02 c4 17 15 00 00 00 01 00 02 c5 02 15 00 00 00 01 00 02 c6 24 15 00 00 00 01 00 02 c7 02 15 00 00 00 01 00 02 c8 31 15 00 00 00 01 00 02 c9 02 15 00 00 00 01 00 02 ca 4e 15 00 00 00 01 00 02 cb 02 15 00 00 00 01 00 02 cc 6f 15 00 00 00 01 00 02 cd 02 15 00 00 00 01 00 02 ce 70 15 00 00 00 01 00 02 cf 02 15 00 00 00 01 00 02 d0 9a 15 00 00 00 01 00 02 d1 02 15 00 00 00 01 00 02 d2 d3 15 00 00 00 01 00 02 d3 02 15 00 00 00 01 00 02 d4 f8 15 00 00 00 01 00 02 d5 03 15 00 00 00 01 00 02 d6 24 15 00 00 00 01 00 02 d7 03 15 00 00 00 01 00 02 d8 4b 15 00 00 00 01 00 02 d9 03 15 00 00 00 01 00 02 da 7c 15 00 00 00 01 00 02 db 03 15 00 00 00 01 00 02 dc 89 15 00 00 00 01 00 02 dd 03 15 00 00 00 01 00 02 de 95 15 00 00 00 01 00 02 df 03 15 00 00 00 01 00 02 e0 a0 15 00 00 00 01 00 02 e1 03 15 00 00 00 01 00 02 e2 a9 15 00 00 00 01 00 02 e3 03 15 00 00 00 01 00 02 e4 b0 15 00 00 00 01 00 02 e5 03 15 00 00 00 01 00 02 e6 b4 15 00 00 00 01 00 02 e7 03 15 00 00 00 01 00 02 e8 b6 15 00 00 00 01 00 02 e9 03 15 00 00 00 01 00 02 ea ff 15 00 00 00 01 00 02 fb 01 15 01 00 00 01 00 02 ff 10];
        qcom,mdss-dsi-dispparam-papermode7-state = "dsi_hs_mode";
        qcom,mdss-dsi-dispparam-level0-command = [15 01 00 00 10 00 02 ff 22 15 01 00 00 10 00 02 56 00 15 01 00 00 10 00 02 ff 10];
        qcom,mdss-dsi-dispparam-level1-command = [15 01 00 00 10 00 02 ff 22 15 01 00 00 10 00 02 58 12 15 01 00 00 10 00 02 59 0e 15 01 00 00 10 00 02 56 01 15 01 00 00 10 00 02 ff 10];
        qcom,mdss-dsi-dispparam-level2-command = [15 01 00 00 10 00 02 ff 22 15 01 00 00 10 00 02 58 14 15 01 00 00 10 00 02 59 0e 15 01 00 00 10 00 02 56 01 15 01 00 00 10 00 02 ff 10];
        qcom,mdss-dsi-dispparam-level3-command = [15 01 00 00 10 00 02 ff 22 15 01 00 00 10 00 02 58 16 15 01 00 00 10 00 02 59 0e 15 01 00 00 10 00 02 56 01 15 01 00 00 10 00 02 ff 10];
        qcom,mdss-dsi-dispparam-level4-command = [15 01 00 00 10 00 02 ff 22 15 01 00 00 10 00 02 58 18 15 01 00 00 10 00 02 59 0e 15 01 00 00 10 00 02 56 01 15 01 00 00 10 00 02 ff 10];
        qcom,mdss-dsi-dispparam-level5-command = [15 01 00 00 10 00 02 ff 22 15 01 00 00 10 00 02 58 1a 15 01 00 00 10 00 02 59 0e 15 01 00 00 10 00 02 56 01 15 01 00 00 10 00 02 ff 10];
        qcom,mdss-dsi-dispparam-level6-command = [15 01 00 00 10 00 02 ff 22 15 01 00 00 10 00 02 58 1c 15 01 00 00 10 00 02 59 0e 15 01 00 00 10 00 02 56 01 15 01 00 00 10 00 02 ff 10];
        qcom,mdss-dsi-dispparam-idleon-command = [15 01 00 00 10 00 02 ff 10 15 01 00 00 10 00 02 39 00];
        qcom,mdss-dsi-dispparam-idleoff-command = [15 01 00 00 10 00 02 ff 10 15 01 00 00 10 00 02 38 00];
        qcom,mdss-dsi-dispparam-test-command = [15 01 00 00 10 00 02 ff 20];
        qcom,mdss-dsi-dispparam-test-command-state = "dsi_hs_mode";
	};
};
