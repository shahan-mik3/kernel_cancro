/* Copyright (c) 2012-2013, The Linux Foundation. All rights reserved.
 *
 * This program is free software; you can redistribute it and/or modify
 * it under the terms of the GNU General Public License version 2 and
 * only version 2 as published by the Free Software Foundation.
 *
 * This program is distributed in the hope that it will be useful,
 * but WITHOUT ANY WARRANTY; without even the implied warranty of
 * MERCHANTABILITY or FITNESS FOR A PARTICULAR PURPOSE.  See the
 * GNU General Public License for more details.
 */

/*---------------------------------------------------------------------------
 * This file is autogenerated file using gcdb parser. Please do not edit it.
 * Update input XML file to add a new entry or update variable in this file
 * VERSION = "1.0"
 *---------------------------------------------------------------------------*/
&soc {
	dsi_jdi_fhd_cmd: qcom,mdss_dsi_jdi_fhd_cmd {
		compatible = "qcom,mdss-dsi-panel";
		status = "okay";
		qcom,mdss-dsi-panel-name = "jdi fhd cmd mode dsi panel";
		qcom,mdss-dsi-panel-id = <2>;
		qcom,mdss-dsi-panel-controller = <&mdss_dsi0>;
		qcom,mdss-dsi-panel-type = "dsi_cmd_mode";
		qcom,mdss-dsi-panel-destination = "display_1";
		qcom,mdss-dsi-panel-framerate = <60>;
		qcom,mdss-dsi-virtual-channel-id = <0>;
		qcom,mdss-dsi-stream = <0>;
		qcom,mdss-dsi-panel-width = <1080>;
		qcom,mdss-dsi-panel-height = <1920>;
		qcom,mdss-dsi-h-front-porch = <80>;
		qcom,mdss-dsi-h-back-porch = <40>;
		qcom,mdss-dsi-h-pulse-width = <10>;
		qcom,mdss-dsi-h-sync-skew = <0>;
		qcom,mdss-dsi-v-back-porch = <4>;
		qcom,mdss-dsi-v-front-porch = <4>;
		qcom,mdss-dsi-v-pulse-width = <2>;
		qcom,mdss-dsi-h-left-border = <0>;
		qcom,mdss-dsi-h-right-border = <0>;
		qcom,mdss-dsi-v-top-border = <0>;
		qcom,mdss-dsi-v-bottom-border = <0>;
		qcom,mdss-dsi-bpp = <24>;
		qcom,mdss-dsi-color-order = <0>;
		qcom,mdss-dsi-underflow-color = <0xff>;
		qcom,mdss-dsi-border-color = <0>;
		qcom,mdss-dsi-on-command = [
				15 01 00 00 01 00 02 FF 10
				15 01 00 00 01 00 02 BB 10
				15 01 00 00 01 00 02 50 00

				15 00 00 00 01 00 02 FF 24
				15 00 00 00 01 00 02 E3 02
				15 00 00 00 01 00 02 C4 69
				15 00 00 00 01 00 02 C9 00
				15 01 00 00 01 00 02 FB 01

				15 00 00 00 01 00 02 FF 22
				15 00 00 00 01 00 02 FB 01
				15 00 00 00 01 00 02 00 28
				15 00 00 00 01 00 02 01 2C
				15 00 00 00 01 00 02 02 30
				15 00 00 00 01 00 02 03 34
				15 00 00 00 01 00 02 04 38
				15 00 00 00 01 00 02 05 3C
				15 00 00 00 01 00 02 06 40
				15 00 00 00 01 00 02 07 48
				15 00 00 00 01 00 02 08 4C
				15 00 00 00 01 00 02 09 50
				15 00 00 00 01 00 02 0A 58
				15 00 00 00 01 00 02 0B 60
				15 00 00 00 01 00 02 0C 60
				15 00 00 00 01 00 02 0D 58
				15 00 00 00 01 00 02 0E 50
				15 00 00 00 01 00 02 0F 48
				15 00 00 00 01 00 02 10 38
				15 00 00 00 01 00 02 11 28
				15 00 00 00 01 00 02 12 28
				15 00 00 00 01 00 02 13 28
				15 00 00 00 01 00 02 1B 00
				15 00 00 00 01 00 02 1C 00
				15 00 00 00 01 00 02 1D 00
				15 00 00 00 01 00 02 1E 00
				15 00 00 00 01 00 02 1F 00
				15 00 00 00 01 00 02 20 00
				15 00 00 00 01 00 02 21 00
				15 00 00 00 01 00 02 22 00
				15 00 00 00 01 00 02 23 00
				15 00 00 00 01 00 02 24 00
				15 00 00 00 01 00 02 25 00
				15 00 00 00 01 00 02 26 00
				15 00 00 00 01 00 02 27 00
				15 00 00 00 01 00 02 28 00
				15 00 00 00 01 00 02 29 00
				15 00 00 00 01 00 02 2A 00
				15 00 00 00 01 00 02 2B 00
				15 00 00 00 01 00 02 2F 00
				15 00 00 00 01 00 02 30 00
				15 00 00 00 01 00 02 31 00
				15 00 00 00 01 00 02 32 80
				15 00 00 00 01 00 02 33 80
				15 00 00 00 01 00 02 34 80
				15 00 00 00 01 00 02 35 82
				15 00 00 00 01 00 02 36 84
				15 00 00 00 01 00 02 37 86
				15 00 00 00 01 00 02 38 88
				15 00 00 00 01 00 02 39 8A
				15 00 00 00 01 00 02 3A 8C
				15 00 00 00 01 00 02 3B 8E
				15 00 00 00 01 00 02 3F 90
				15 00 00 00 01 00 02 40 92
				15 00 00 00 01 00 02 41 94
				15 00 00 00 01 00 02 42 94
				15 00 00 00 01 00 02 43 92
				15 00 00 00 01 00 02 44 90
				15 00 00 00 01 00 02 45 8E
				15 00 00 00 01 00 02 46 8C
				15 00 00 00 01 00 02 47 8A
				15 00 00 00 01 00 02 48 88
				15 00 00 00 01 00 02 49 86
				15 00 00 00 01 00 02 4A 84
				15 00 00 00 01 00 02 4B 82
				15 00 00 00 01 00 02 4C 80
				15 00 00 00 01 00 02 4D 08
				15 00 00 00 01 00 02 1A 00
				15 00 00 00 01 00 02 53 01
				15 00 00 00 01 00 02 54 01
				15 00 00 00 01 00 02 56 00
				15 00 00 00 01 00 02 64 2F
				15 01 00 00 01 00 02 68 00

				15 01 00 00 01 00 02 FF 10
				15 01 00 00 01 00 02 35 00
				39 01 00 00 01 00 05 2A 00 00 04 37
				39 01 00 00 01 00 05 2B 00 00 07 7F
				15 01 00 00 01 00 02 51 de
				15 01 00 00 01 00 02 53 2c
				15 01 00 00 01 00 02 55 80
				05 01 00 00 78 00 02 11 00
				15 01 00 00 01 00 02 FF 10
				05 01 00 00 64 00 02 29 00];
		qcom,mdss-dsi-off-command = [
			15 01 00 00 00 00 02 FF 10
			05 01 00 00 32 00 02 28 00
			05 01 00 00 78 00 02 10 00];
		qcom,mdss-dsi-on-command-state = "dsi_lp_mode";
		qcom,mdss-dsi-off-command-state = "dsi_hs_mode";
		qcom,mdss-dsi-h-sync-pulse = <0>;
		qcom,mdss-dsi-traffic-mode = <1>;
		qcom,mdss-dsi-lane-map = <0>;
		qcom,mdss-dsi-bllp-eof-power-mode;
		qcom,mdss-dsi-bllp-power-mode;
		qcom,mdss-dsi-lane-0-state;
		qcom,mdss-dsi-lane-1-state;
		qcom,mdss-dsi-lane-2-state;
		qcom,mdss-dsi-lane-3-state;
		qcom,mdss-dsi-te-pin-select = <1>;
		qcom,mdss-dsi-te-v-sync-rd-ptr-irq-line = <0x2c>;
		qcom,mdss-dsi-te-v-sync-continues-lines = <0x3c>;
		qcom,mdss-dsi-te-dcs-command = <1>;
		qcom,mdss-dsi-te-check-enable;
		qcom,mdss-dsi-te-using-te-pin;
		qcom,mdss-dsi-panel-timings = [e3 50 36 00 a9 a3 3a 50 3d 03 04 00];
		qcom,mdss-dsi-t-clk-post = <0x20>;
		qcom,mdss-dsi-t-clk-pre = <0x36>;
		qcom,mdss-dsi-bl-min-level = <8>;
		qcom,mdss-dsi-bl-max-level = <4095>;
		qcom,mdss-dsi-dma-trigger = <0x04>;
		qcom,mdss-dsi-mdp-trigger = <0x0>;
		qcom,mdss-dsi-bl-pmic-control-type = "bl_ctrl_wled";
		qcom,mdss-dsi-reset-sequence = <1 20>, <0 20>, <1 20>;
		qcom,mdss-pan-physical-width-dimension = <61>;
        qcom,mdss-pan-physical-height-dimension = <109>;
        qcom,dispparam-enabled;
        qcom,mdss-dsi-dispparam-cabcon-command = [15 00 00 00 01 00 02 ff 10 15 01 00 00 01 00 02 55 82];
        qcom,mdss-dsi-dispparam-cabcguion-command = [15 00 00 00 01 00 02 ff 10 15 01 00 00 01 00 02 55 81];
        qcom,mdss-dsi-dispparam-cabcstillon-command = [15 00 00 00 01 00 02 ff 10 15 01 00 00 01 00 02 55 82];
        qcom,mdss-dsi-dispparam-cabcmovieon-command = [15 00 00 00 01 00 02 ff 10 15 01 00 00 01 00 02 55 83];
        qcom,mdss-dsi-dispparam-cabcon-command-state = "dsi_hs_mode";
        qcom,mdss-dsi-dispparam-cabcoff-command = [15 00 00 00 01 00 02 ff 10 15 01 00 00 01 00 02 55 80];
        qcom,mdss-dsi-dispparam-cabcoff-command-state = "dsi_hs_mode";
        qcom,mdss-dsi-dispparam-warm-command = [15 00 00 00 01 00 02 ff 20 15 00 00 00 01 00 02 75 00 15 00 00 00 01 00 02 76 00 15 00 00 00 01 00 02 77 00 15 00 00 00 01 00 02 78 0f 15 00 00 00 01 00 02 79 00 15 00 00 00 01 00 02 7a 2e 15 00 00 00 01 00 02 7b 00 15 00 00 00 01 00 02 7c 46 15 00 00 00 01 00 02 7d 00 15 00 00 00 01 00 02 7e 5b 15 00 00 00 01 00 02 7f 00 15 00 00 00 01 00 02 80 6e 15 00 00 00 01 00 02 81 00 15 00 00 00 01 00 02 82 80 15 00 00 00 01 00 02 83 00 15 00 00 00 01 00 02 84 8f 15 00 00 00 01 00 02 85 00 15 00 00 00 01 00 02 86 9f 15 00 00 00 01 00 02 87 00 15 00 00 00 01 00 02 88 d1 15 00 00 00 01 00 02 89 00 15 00 00 00 01 00 02 8a fa 15 00 00 00 01 00 02 8b 01 15 00 00 00 01 00 02 8c 3e 15 00 00 00 01 00 02 8d 01 15 00 00 00 01 00 02 8e 71 15 00 00 00 01 00 02 8f 01 15 00 00 00 01 00 02 90 b7 15 00 00 00 01 00 02 91 01 15 00 00 00 01 00 02 92 f1 15 00 00 00 01 00 02 93 01 15 00 00 00 01 00 02 94 f3 15 00 00 00 01 00 02 95 02 15 00 00 00 01 00 02 96 27 15 00 00 00 01 00 02 97 02 15 00 00 00 01 00 02 98 63 15 00 00 00 01 00 02 99 02 15 00 00 00 01 00 02 9a 8a 15 00 00 00 01 00 02 9b 02 15 00 00 00 01 00 02 9c c2 15 00 00 00 01 00 02 9d 02 15 00 00 00 01 00 02 9e ee 15 00 00 00 01 00 02 9f 03 15 00 00 00 01 00 02 a0 2d 15 00 00 00 01 00 02 a2 03 15 00 00 00 01 00 02 a3 41 15 00 00 00 01 00 02 a4 03 15 00 00 00 01 00 02 a5 57 15 00 00 00 01 00 02 a6 03 15 00 00 00 01 00 02 a7 70 15 00 00 00 01 00 02 a9 03 15 00 00 00 01 00 02 aa 8a 15 00 00 00 01 00 02 ab 03 15 00 00 00 01 00 02 ac a8 15 00 00 00 01 00 02 ad 03 15 00 00 00 01 00 02 ae c9 15 00 00 00 01 00 02 af 03 15 00 00 00 01 00 02 b0 ed 15 00 00 00 01 00 02 b1 03 15 00 00 00 01 00 02 b2 ff 15 00 00 00 01 00 02 b3 00 15 00 00 00 01 00 02 b4 4a 15 00 00 00 01 00 02 b5 00 15 00 00 00 01 00 02 b6 58 15 00 00 00 01 00 02 b7 00 15 00 00 00 01 00 02 b8 74 15 00 00 00 01 00 02 b9 00 15 00 00 00 01 00 02 ba 89 15 00 00 00 01 00 02 bb 00 15 00 00 00 01 00 02 bc 9c 15 00 00 00 01 00 02 bd 00 15 00 00 00 01 00 02 be ac 15 00 00 00 01 00 02 bf 00 15 00 00 00 01 00 02 c0 bb 15 00 00 00 01 00 02 c1 00 15 00 00 00 01 00 02 c2 c7 15 00 00 00 01 00 02 c3 00 15 00 00 00 01 00 02 c4 d5 15 00 00 00 01 00 02 c5 00 15 00 00 00 01 00 02 c6 fc 15 00 00 00 01 00 02 c7 01 15 00 00 00 01 00 02 c8 1b 15 00 00 00 01 00 02 c9 01 15 00 00 00 01 00 02 ca 49 15 00 00 00 01 00 02 cb 01 15 00 00 00 01 00 02 cc 71 15 00 00 00 01 00 02 cd 01 15 00 00 00 01 00 02 ce b7 15 00 00 00 01 00 02 cf 01 15 00 00 00 01 00 02 d0 f1 15 00 00 00 01 00 02 d1 01 15 00 00 00 01 00 02 d2 f3 15 00 00 00 01 00 02 d3 02 15 00 00 00 01 00 02 d4 27 15 00 00 00 01 00 02 d5 02 15 00 00 00 01 00 02 d6 63 15 00 00 00 01 00 02 d7 02 15 00 00 00 01 00 02 d8 8a 15 00 00 00 01 00 02 d9 02 15 00 00 00 01 00 02 da c2 15 00 00 00 01 00 02 db 02 15 00 00 00 01 00 02 dc ee 15 00 00 00 01 00 02 dd 03 15 00 00 00 01 00 02 de 2d 15 00 00 00 01 00 02 df 03 15 00 00 00 01 00 02 e0 41 15 00 00 00 01 00 02 e1 03 15 00 00 00 01 00 02 e2 57 15 00 00 00 01 00 02 e3 03 15 00 00 00 01 00 02 e4 70 15 00 00 00 01 00 02 e5 03 15 00 00 00 01 00 02 e6 8a 15 00 00 00 01 00 02 e7 03 15 00 00 00 01 00 02 e8 a8 15 00 00 00 01 00 02 e9 03 15 00 00 00 01 00 02 ea c9 15 00 00 00 01 00 02 eb 03 15 00 00 00 01 00 02 ec ed 15 00 00 00 01 00 02 ed 03 15 00 00 00 01 00 02 ee ff 15 00 00 00 01 00 02 ef 00 15 00 00 00 01 00 02 f0 b5 15 00 00 00 01 00 02 f1 00 15 00 00 00 01 00 02 f2 bb 15 00 00 00 01 00 02 f3 00 15 00 00 00 01 00 02 f4 c5 15 00 00 00 01 00 02 f5 00 15 00 00 00 01 00 02 f6 d0 15 00 00 00 01 00 02 f7 00 15 00 00 00 01 00 02 f8 d9 15 00 00 00 01 00 02 f9 00 15 00 00 00 01 00 02 fa e3 15 00 00 00 01 00 02 fb 01 15 00 00 00 01 00 02 ff 21 15 00 00 00 01 00 02 00 00 15 00 00 00 01 00 02 01 eb 15 00 00 00 01 00 02 02 00 15 00 00 00 01 00 02 03 f5 15 00 00 00 01 00 02 04 00 15 00 00 00 01 00 02 05 fe 15 00 00 00 01 00 02 06 01 15 00 00 00 01 00 02 07 1d 15 00 00 00 01 00 02 08 01 15 00 00 00 01 00 02 09 3a 15 00 00 00 01 00 02 0a 01 15 00 00 00 01 00 02 0b 6c 15 00 00 00 01 00 02 0c 01 15 00 00 00 01 00 02 0d 93 15 00 00 00 01 00 02 0e 01 15 00 00 00 01 00 02 0f ce 15 00 00 00 01 00 02 10 02 15 00 00 00 01 00 02 11 01 15 00 00 00 01 00 02 12 02 15 00 00 00 01 00 02 13 02 15 00 00 00 01 00 02 14 02 15 00 00 00 01 00 02 15 33 15 00 00 00 01 00 02 16 02 15 00 00 00 01 00 02 17 6e 15 00 00 00 01 00 02 18 02 15 00 00 00 01 00 02 19 94 15 00 00 00 01 00 02 1a 02 15 00 00 00 01 00 02 1b cb 15 00 00 00 01 00 02 1c 02 15 00 00 00 01 00 02 1d f7 15 00 00 00 01 00 02 1e 03 15 00 00 00 01 00 02 1f 35 15 00 00 00 01 00 02 20 03 15 00 00 00 01 00 02 21 48 15 00 00 00 01 00 02 22 03 15 00 00 00 01 00 02 23 5e 15 00 00 00 01 00 02 24 03 15 00 00 00 01 00 02 25 75 15 00 00 00 01 00 02 26 03 15 00 00 00 01 00 02 27 8f 15 00 00 00 01 00 02 28 03 15 00 00 00 01 00 02 29 ab 15 00 00 00 01 00 02 2a 03 15 00 00 00 01 00 02 2b cb 15 00 00 00 01 00 02 2d 03 15 00 00 00 01 00 02 2f ee 15 00 00 00 01 00 02 30 03 15 00 00 00 01 00 02 31 ff 15 00 00 00 01 00 02 32 00 15 00 00 00 01 00 02 33 f2 15 00 00 00 01 00 02 34 00 15 00 00 00 01 00 02 35 f8 15 00 00 00 01 00 02 36 00 15 00 00 00 01 00 02 37 ff 15 00 00 00 01 00 02 38 01 15 00 00 00 01 00 02 39 08 15 00 00 00 01 00 02 3a 01 15 00 00 00 01 00 02 3b 0f 15 00 00 00 01 00 02 3d 01 15 00 00 00 01 00 02 3f 17 15 00 00 00 01 00 02 40 01 15 00 00 00 01 00 02 41 1c 15 00 00 00 01 00 02 42 01 15 00 00 00 01 00 02 43 24 15 00 00 00 01 00 02 44 01 15 00 00 00 01 00 02 45 2a 15 00 00 00 01 00 02 46 01 15 00 00 00 01 00 02 47 41 15 00 00 00 01 00 02 48 01 15 00 00 00 01 00 02 49 55 15 00 00 00 01 00 02 4a 01 15 00 00 00 01 00 02 4b 75 15 00 00 00 01 00 02 4c 01 15 00 00 00 01 00 02 4d 93 15 00 00 00 01 00 02 4e 01 15 00 00 00 01 00 02 4f ce 15 00 00 00 01 00 02 50 02 15 00 00 00 01 00 02 51 01 15 00 00 00 01 00 02 52 02 15 00 00 00 01 00 02 53 02 15 00 00 00 01 00 02 54 02 15 00 00 00 01 00 02 55 33 15 00 00 00 01 00 02 56 02 15 00 00 00 01 00 02 58 6e 15 00 00 00 01 00 02 59 02 15 00 00 00 01 00 02 5a 94 15 00 00 00 01 00 02 5b 02 15 00 00 00 01 00 02 5c cb 15 00 00 00 01 00 02 5d 02 15 00 00 00 01 00 02 5e f7 15 00 00 00 01 00 02 5f 03 15 00 00 00 01 00 02 60 35 15 00 00 00 01 00 02 61 03 15 00 00 00 01 00 02 62 48 15 00 00 00 01 00 02 63 03 15 00 00 00 01 00 02 64 5e 15 00 00 00 01 00 02 65 03 15 00 00 00 01 00 02 66 75 15 00 00 00 01 00 02 67 03 15 00 00 00 01 00 02 68 8f 15 00 00 00 01 00 02 69 03 15 00 00 00 01 00 02 6a ab 15 00 00 00 01 00 02 6b 03 15 00 00 00 01 00 02 6c cb 15 00 00 00 01 00 02 6d 03 15 00 00 00 01 00 02 6e ee 15 00 00 00 01 00 02 6f 03 15 00 00 00 01 00 02 70 ff 15 00 00 00 01 00 02 71 00 15 00 00 00 01 00 02 72 e0 15 00 00 00 01 00 02 73 00 15 00 00 00 01 00 02 74 e3 15 00 00 00 01 00 02 75 00 15 00 00 00 01 00 02 76 ec 15 00 00 00 01 00 02 77 00 15 00 00 00 01 00 02 78 f4 15 00 00 00 01 00 02 79 00 15 00 00 00 01 00 02 7a fb 15 00 00 00 01 00 02 7b 01 15 00 00 00 01 00 02 7c 02 15 00 00 00 01 00 02 7d 01 15 00 00 00 01 00 02 7e 0a 15 00 00 00 01 00 02 7f 01 15 00 00 00 01 00 02 80 12 15 00 00 00 01 00 02 81 01 15 00 00 00 01 00 02 82 1a 15 00 00 00 01 00 02 83 01 15 00 00 00 01 00 02 84 35 15 00 00 00 01 00 02 85 01 15 00 00 00 01 00 02 86 4d 15 00 00 00 01 00 02 87 01 15 00 00 00 01 00 02 88 7b 15 00 00 00 01 00 02 89 01 15 00 00 00 01 00 02 8a 9f 15 00 00 00 01 00 02 8b 01 15 00 00 00 01 00 02 8c d6 15 00 00 00 01 00 02 8d 02 15 00 00 00 01 00 02 8e 07 15 00 00 00 01 00 02 8f 02 15 00 00 00 01 00 02 90 08 15 00 00 00 01 00 02 91 02 15 00 00 00 01 00 02 92 38 15 00 00 00 01 00 02 93 02 15 00 00 00 01 00 02 94 72 15 00 00 00 01 00 02 95 02 15 00 00 00 01 00 02 96 99 15 00 00 00 01 00 02 97 02 15 00 00 00 01 00 02 98 d3 15 00 00 00 01 00 02 99 02 15 00 00 00 01 00 02 9a f8 15 00 00 00 01 00 02 9b 03 15 00 00 00 01 00 02 9c 33 15 00 00 00 01 00 02 9d 03 15 00 00 00 01 00 02 9e 46 15 00 00 00 01 00 02 9f 03 15 00 00 00 01 00 02 a0 5c 15 00 00 00 01 00 02 a2 03 15 00 00 00 01 00 02 a3 73 15 00 00 00 01 00 02 a4 03 15 00 00 00 01 00 02 a5 8d 15 00 00 00 01 00 02 a6 03 15 00 00 00 01 00 02 a7 a9 15 00 00 00 01 00 02 a9 03 15 00 00 00 01 00 02 aa ca 15 00 00 00 01 00 02 ab 03 15 00 00 00 01 00 02 ac ee 15 00 00 00 01 00 02 ad 03 15 00 00 00 01 00 02 ae ff 15 00 00 00 01 00 02 af 01 15 00 00 00 01 00 02 b0 18 15 00 00 00 01 00 02 b1 01 15 00 00 00 01 00 02 b2 1b 15 00 00 00 01 00 02 b3 01 15 00 00 00 01 00 02 b4 21 15 00 00 00 01 00 02 b5 01 15 00 00 00 01 00 02 b6 27 15 00 00 00 01 00 02 b7 01 15 00 00 00 01 00 02 b8 2d 15 00 00 00 01 00 02 b9 01 15 00 00 00 01 00 02 ba 31 15 00 00 00 01 00 02 bb 01 15 00 00 00 01 00 02 bc 37 15 00 00 00 01 00 02 bd 01 15 00 00 00 01 00 02 be 3d 15 00 00 00 01 00 02 bf 01 15 00 00 00 01 00 02 c0 43 15 00 00 00 01 00 02 c1 01 15 00 00 00 01 00 02 c2 56 15 00 00 00 01 00 02 c3 01 15 00 00 00 01 00 02 c4 66 15 00 00 00 01 00 02 c5 01 15 00 00 00 01 00 02 c6 83 15 00 00 00 01 00 02 c7 01 15 00 00 00 01 00 02 c8 9f 15 00 00 00 01 00 02 c9 01 15 00 00 00 01 00 02 ca d6 15 00 00 00 01 00 02 cb 02 15 00 00 00 01 00 02 cc 07 15 00 00 00 01 00 02 cd 02 15 00 00 00 01 00 02 ce 08 15 00 00 00 01 00 02 cf 02 15 00 00 00 01 00 02 d0 38 15 00 00 00 01 00 02 d1 02 15 00 00 00 01 00 02 d2 72 15 00 00 00 01 00 02 d3 02 15 00 00 00 01 00 02 d4 99 15 00 00 00 01 00 02 d5 02 15 00 00 00 01 00 02 d6 d3 15 00 00 00 01 00 02 d7 02 15 00 00 00 01 00 02 d8 f8 15 00 00 00 01 00 02 d9 03 15 00 00 00 01 00 02 da 33 15 00 00 00 01 00 02 db 03 15 00 00 00 01 00 02 dc 46 15 00 00 00 01 00 02 dd 03 15 00 00 00 01 00 02 de 5c 15 00 00 00 01 00 02 df 03 15 00 00 00 01 00 02 e0 73 15 00 00 00 01 00 02 e1 03 15 00 00 00 01 00 02 e2 8d 15 00 00 00 01 00 02 e3 03 15 00 00 00 01 00 02 e4 a9 15 00 00 00 01 00 02 e5 03 15 00 00 00 01 00 02 e6 ca 15 00 00 00 01 00 02 e7 03 15 00 00 00 01 00 02 e8 ee 15 00 00 00 01 00 02 e9 03 15 00 00 00 01 00 02 ea ff 15 00 00 00 01 00 02 eb 30 15 00 00 00 01 00 02 ec 17 15 00 00 00 01 00 02 ed 20 15 00 00 00 01 00 02 ee 0f 15 00 00 00 01 00 02 ef 1f 15 00 00 00 01 00 02 f0 0f 15 00 00 00 01 00 02 f1 0f 15 00 00 00 01 00 02 f2 07 15 00 00 00 01 00 02 fb 01 15 01 00 00 01 00 02 ff 10];
        qcom,mdss-dsi-dispparam-warm-command-state = "dsi_hs_mode";
        qcom,mdss-dsi-dispparam-default-command = [15 00 00 00 01 00 02 ff 20 15 00 00 00 01 00 02 fb 00 15 00 00 00 01 00 02 ff 21 15 00 00 00 01 00 02 fb 00 15 00 00 00 01 00 02 ff 10 05 01 00 00 10 00 02 11 00];
        qcom,mdss-dsi-dispparam-default-command-state = "dsi_hs_mode";
        qcom,mdss-dsi-dispparam-cold-command = [15 00 00 00 01 00 02 ff 20 15 00 00 00 01 00 02 75 00 15 00 00 00 01 00 02 76 41 15 00 00 00 01 00 02 77 00 15 00 00 00 01 00 02 78 4c 15 00 00 00 01 00 02 79 00 15 00 00 00 01 00 02 7a 63 15 00 00 00 01 00 02 7b 00 15 00 00 00 01 00 02 7c 76 15 00 00 00 01 00 02 7d 00 15 00 00 00 01 00 02 7e 87 15 00 00 00 01 00 02 7f 00 15 00 00 00 01 00 02 80 96 15 00 00 00 01 00 02 81 00 15 00 00 00 01 00 02 82 a6 15 00 00 00 01 00 02 83 00 15 00 00 00 01 00 02 84 b3 15 00 00 00 01 00 02 85 00 15 00 00 00 01 00 02 86 bf 15 00 00 00 01 00 02 87 00 15 00 00 00 01 00 02 88 ed 15 00 00 00 01 00 02 89 01 15 00 00 00 01 00 02 8a 13 15 00 00 00 01 00 02 8b 01 15 00 00 00 01 00 02 8c 53 15 00 00 00 01 00 02 8d 01 15 00 00 00 01 00 02 8e 84 15 00 00 00 01 00 02 8f 01 15 00 00 00 01 00 02 90 c8 15 00 00 00 01 00 02 91 02 15 00 00 00 01 00 02 92 00 15 00 00 00 01 00 02 93 02 15 00 00 00 01 00 02 94 02 15 00 00 00 01 00 02 95 02 15 00 00 00 01 00 02 96 37 15 00 00 00 01 00 02 97 02 15 00 00 00 01 00 02 98 76 15 00 00 00 01 00 02 99 02 15 00 00 00 01 00 02 9a 9e 15 00 00 00 01 00 02 9b 02 15 00 00 00 01 00 02 9c dc 15 00 00 00 01 00 02 9d 03 15 00 00 00 01 00 02 9e 06 15 00 00 00 01 00 02 9f 03 15 00 00 00 01 00 02 a0 43 15 00 00 00 01 00 02 a2 03 15 00 00 00 01 00 02 a3 55 15 00 00 00 01 00 02 a4 03 15 00 00 00 01 00 02 a5 6a 15 00 00 00 01 00 02 a6 03 15 00 00 00 01 00 02 a7 81 15 00 00 00 01 00 02 a9 03 15 00 00 00 01 00 02 aa 98 15 00 00 00 01 00 02 ab 03 15 00 00 00 01 00 02 ac b3 15 00 00 00 01 00 02 ad 03 15 00 00 00 01 00 02 ae d0 15 00 00 00 01 00 02 af 03 15 00 00 00 01 00 02 b0 f0 15 00 00 00 01 00 02 b1 03 15 00 00 00 01 00 02 b2 ff 15 00 00 00 01 00 02 b3 00 15 00 00 00 01 00 02 b4 88 15 00 00 00 01 00 02 b5 00 15 00 00 00 01 00 02 b6 92 15 00 00 00 01 00 02 b7 00 15 00 00 00 01 00 02 b8 a6 15 00 00 00 01 00 02 b9 00 15 00 00 00 01 00 02 ba b6 15 00 00 00 01 00 02 bb 00 15 00 00 00 01 00 02 bc c5 15 00 00 00 01 00 02 bd 00 15 00 00 00 01 00 02 be d1 15 00 00 00 01 00 02 bf 00 15 00 00 00 01 00 02 c0 df 15 00 00 00 01 00 02 c1 00 15 00 00 00 01 00 02 c2 e9 15 00 00 00 01 00 02 c3 00 15 00 00 00 01 00 02 c4 f3 15 00 00 00 01 00 02 c5 01 15 00 00 00 01 00 02 c6 16 15 00 00 00 01 00 02 c7 01 15 00 00 00 01 00 02 c8 32 15 00 00 00 01 00 02 c9 01 15 00 00 00 01 00 02 ca 5e 15 00 00 00 01 00 02 cb 01 15 00 00 00 01 00 02 cc 84 15 00 00 00 01 00 02 cd 01 15 00 00 00 01 00 02 ce c8 15 00 00 00 01 00 02 cf 02 15 00 00 00 01 00 02 d0 00 15 00 00 00 01 00 02 d1 02 15 00 00 00 01 00 02 d2 02 15 00 00 00 01 00 02 d3 02 15 00 00 00 01 00 02 d4 37 15 00 00 00 01 00 02 d5 02 15 00 00 00 01 00 02 d6 76 15 00 00 00 01 00 02 d7 02 15 00 00 00 01 00 02 d8 9e 15 00 00 00 01 00 02 d9 02 15 00 00 00 01 00 02 da dc 15 00 00 00 01 00 02 db 03 15 00 00 00 01 00 02 dc 06 15 00 00 00 01 00 02 dd 03 15 00 00 00 01 00 02 de 43 15 00 00 00 01 00 02 df 03 15 00 00 00 01 00 02 e0 55 15 00 00 00 01 00 02 e1 03 15 00 00 00 01 00 02 e2 6a 15 00 00 00 01 00 02 e3 03 15 00 00 00 01 00 02 e4 81 15 00 00 00 01 00 02 e5 03 15 00 00 00 01 00 02 e6 98 15 00 00 00 01 00 02 e7 03 15 00 00 00 01 00 02 e8 b3 15 00 00 00 01 00 02 e9 03 15 00 00 00 01 00 02 ea d0 15 00 00 00 01 00 02 eb 03 15 00 00 00 01 00 02 ec f0 15 00 00 00 01 00 02 ed 03 15 00 00 00 01 00 02 ee ff 15 00 00 00 01 00 02 ef 00 15 00 00 00 01 00 02 f0 68 15 00 00 00 01 00 02 f1 00 15 00 00 00 01 00 02 f2 70 15 00 00 00 01 00 02 f3 00 15 00 00 00 01 00 02 f4 82 15 00 00 00 01 00 02 f5 00 15 00 00 00 01 00 02 f6 92 15 00 00 00 01 00 02 f7 00 15 00 00 00 01 00 02 f8 a1 15 00 00 00 01 00 02 f9 00 15 00 00 00 01 00 02 fa ae 15 00 00 00 01 00 02 fb 01 15 00 00 00 01 00 02 ff 21 15 00 00 00 01 00 02 00 00 15 00 00 00 01 00 02 01 bb 15 00 00 00 01 00 02 02 00 15 00 00 00 01 00 02 03 c7 15 00 00 00 01 00 02 04 00 15 00 00 00 01 00 02 05 d3 15 00 00 00 01 00 02 06 00 15 00 00 00 01 00 02 07 fc 15 00 00 00 01 00 02 08 01 15 00 00 00 01 00 02 09 20 15 00 00 00 01 00 02 0a 01 15 00 00 00 01 00 02 0b 5d 15 00 00 00 01 00 02 0c 01 15 00 00 00 01 00 02 0d 8b 15 00 00 00 01 00 02 0e 01 15 00 00 00 01 00 02 0f cd 15 00 00 00 01 00 02 10 02 15 00 00 00 01 00 02 11 04 15 00 00 00 01 00 02 12 02 15 00 00 00 01 00 02 13 05 15 00 00 00 01 00 02 14 02 15 00 00 00 01 00 02 15 3a 15 00 00 00 01 00 02 16 02 15 00 00 00 01 00 02 17 79 15 00 00 00 01 00 02 18 02 15 00 00 00 01 00 02 19 a1 15 00 00 00 01 00 02 1a 02 15 00 00 00 01 00 02 1b e0 15 00 00 00 01 00 02 1c 03 15 00 00 00 01 00 02 1d 0b 15 00 00 00 01 00 02 1e 03 15 00 00 00 01 00 02 1f 47 15 00 00 00 01 00 02 20 03 15 00 00 00 01 00 02 21 59 15 00 00 00 01 00 02 22 03 15 00 00 00 01 00 02 23 6d 15 00 00 00 01 00 02 24 03 15 00 00 00 01 00 02 25 84 15 00 00 00 01 00 02 26 03 15 00 00 00 01 00 02 27 9b 15 00 00 00 01 00 02 28 03 15 00 00 00 01 00 02 29 b5 15 00 00 00 01 00 02 2a 03 15 00 00 00 01 00 02 2b d1 15 00 00 00 01 00 02 2d 03 15 00 00 00 01 00 02 2f f0 15 00 00 00 01 00 02 30 03 15 00 00 00 01 00 02 31 ff 15 00 00 00 01 00 02 32 00 15 00 00 00 01 00 02 33 ac 15 00 00 00 01 00 02 34 00 15 00 00 00 01 00 02 35 b4 15 00 00 00 01 00 02 36 00 15 00 00 00 01 00 02 37 c3 15 00 00 00 01 00 02 38 00 15 00 00 00 01 00 02 39 d0 15 00 00 00 01 00 02 3a 00 15 00 00 00 01 00 02 3b dd 15 00 00 00 01 00 02 3d 00 15 00 00 00 01 00 02 3f e7 15 00 00 00 01 00 02 40 00 15 00 00 00 01 00 02 41 f2 15 00 00 00 01 00 02 42 00 15 00 00 00 01 00 02 43 fb 15 00 00 00 01 00 02 44 01 15 00 00 00 01 00 02 45 04 15 00 00 00 01 00 02 46 01 15 00 00 00 01 00 02 47 24 15 00 00 00 01 00 02 48 01 15 00 00 00 01 00 02 49 3e 15 00 00 00 01 00 02 4a 01 15 00 00 00 01 00 02 4b 67 15 00 00 00 01 00 02 4c 01 15 00 00 00 01 00 02 4d 8b 15 00 00 00 01 00 02 4e 01 15 00 00 00 01 00 02 4f cd 15 00 00 00 01 00 02 50 02 15 00 00 00 01 00 02 51 04 15 00 00 00 01 00 02 52 02 15 00 00 00 01 00 02 53 05 15 00 00 00 01 00 02 54 02 15 00 00 00 01 00 02 55 3a 15 00 00 00 01 00 02 56 02 15 00 00 00 01 00 02 58 79 15 00 00 00 01 00 02 59 02 15 00 00 00 01 00 02 5a a1 15 00 00 00 01 00 02 5b 02 15 00 00 00 01 00 02 5c e0 15 00 00 00 01 00 02 5d 03 15 00 00 00 01 00 02 5e 0b 15 00 00 00 01 00 02 5f 03 15 00 00 00 01 00 02 60 47 15 00 00 00 01 00 02 61 03 15 00 00 00 01 00 02 62 59 15 00 00 00 01 00 02 63 03 15 00 00 00 01 00 02 64 6d 15 00 00 00 01 00 02 65 03 15 00 00 00 01 00 02 66 84 15 00 00 00 01 00 02 67 03 15 00 00 00 01 00 02 68 9b 15 00 00 00 01 00 02 69 03 15 00 00 00 01 00 02 6a b5 15 00 00 00 01 00 02 6b 03 15 00 00 00 01 00 02 6c d1 15 00 00 00 01 00 02 6d 03 15 00 00 00 01 00 02 6e f0 15 00 00 00 01 00 02 6f 03 15 00 00 00 01 00 02 70 ff 15 00 00 00 01 00 02 71 00 15 00 00 00 01 00 02 72 00 15 00 00 00 01 00 02 73 00 15 00 00 00 01 00 02 74 10 15 00 00 00 01 00 02 75 00 15 00 00 00 01 00 02 76 31 15 00 00 00 01 00 02 77 00 15 00 00 00 01 00 02 78 48 15 00 00 00 01 00 02 79 00 15 00 00 00 01 00 02 7a 5f 15 00 00 00 01 00 02 7b 00 15 00 00 00 01 00 02 7c 72 15 00 00 00 01 00 02 7d 00 15 00 00 00 01 00 02 7e 83 15 00 00 00 01 00 02 7f 00 15 00 00 00 01 00 02 80 93 15 00 00 00 01 00 02 81 00 15 00 00 00 01 00 02 82 a2 15 00 00 00 01 00 02 83 00 15 00 00 00 01 00 02 84 d6 15 00 00 00 01 00 02 85 01 15 00 00 00 01 00 02 86 00 15 00 00 00 01 00 02 87 01 15 00 00 00 01 00 02 88 46 15 00 00 00 01 00 02 89 01 15 00 00 00 01 00 02 8a 79 15 00 00 00 01 00 02 8b 01 15 00 00 00 01 00 02 8c c2 15 00 00 00 01 00 02 8d 01 15 00 00 00 01 00 02 8e fc 15 00 00 00 01 00 02 8f 01 15 00 00 00 01 00 02 90 fe 15 00 00 00 01 00 02 91 02 15 00 00 00 01 00 02 92 34 15 00 00 00 01 00 02 93 02 15 00 00 00 01 00 02 94 73 15 00 00 00 01 00 02 95 02 15 00 00 00 01 00 02 96 9c 15 00 00 00 01 00 02 97 02 15 00 00 00 01 00 02 98 da 15 00 00 00 01 00 02 99 03 15 00 00 00 01 00 02 9a 07 15 00 00 00 01 00 02 9b 03 15 00 00 00 01 00 02 9c 46 15 00 00 00 01 00 02 9d 03 15 00 00 00 01 00 02 9e 58 15 00 00 00 01 00 02 9f 03 15 00 00 00 01 00 02 a0 6d 15 00 00 00 01 00 02 a2 03 15 00 00 00 01 00 02 a3 84 15 00 00 00 01 00 02 a4 03 15 00 00 00 01 00 02 a5 9c 15 00 00 00 01 00 02 a6 03 15 00 00 00 01 00 02 a7 b5 15 00 00 00 01 00 02 a9 03 15 00 00 00 01 00 02 aa d2 15 00 00 00 01 00 02 ab 03 15 00 00 00 01 00 02 ac f1 15 00 00 00 01 00 02 ad 03 15 00 00 00 01 00 02 ae ff 15 00 00 00 01 00 02 af 00 15 00 00 00 01 00 02 b0 4a 15 00 00 00 01 00 02 b1 00 15 00 00 00 01 00 02 b2 59 15 00 00 00 01 00 02 b3 00 15 00 00 00 01 00 02 b4 77 15 00 00 00 01 00 02 b5 00 15 00 00 00 01 00 02 b6 8b 15 00 00 00 01 00 02 b7 00 15 00 00 00 01 00 02 b8 a0 15 00 00 00 01 00 02 b9 00 15 00 00 00 01 00 02 ba b0 15 00 00 00 01 00 02 bb 00 15 00 00 00 01 00 02 bc be 15 00 00 00 01 00 02 bd 00 15 00 00 00 01 00 02 be cb 15 00 00 00 01 00 02 bf 00 15 00 00 00 01 00 02 c0 d8 15 00 00 00 01 00 02 c1 01 15 00 00 00 01 00 02 c2 01 15 00 00 00 01 00 02 c3 01 15 00 00 00 01 00 02 c4 20 15 00 00 00 01 00 02 c5 01 15 00 00 00 01 00 02 c6 50 15 00 00 00 01 00 02 c7 01 15 00 00 00 01 00 02 c8 79 15 00 00 00 01 00 02 c9 01 15 00 00 00 01 00 02 ca c2 15 00 00 00 01 00 02 cb 01 15 00 00 00 01 00 02 cc fc 15 00 00 00 01 00 02 cd 01 15 00 00 00 01 00 02 ce fe 15 00 00 00 01 00 02 cf 02 15 00 00 00 01 00 02 d0 34 15 00 00 00 01 00 02 d1 02 15 00 00 00 01 00 02 d2 73 15 00 00 00 01 00 02 d3 02 15 00 00 00 01 00 02 d4 9c 15 00 00 00 01 00 02 d5 02 15 00 00 00 01 00 02 d6 da 15 00 00 00 01 00 02 d7 03 15 00 00 00 01 00 02 d8 07 15 00 00 00 01 00 02 d9 03 15 00 00 00 01 00 02 da 46 15 00 00 00 01 00 02 db 03 15 00 00 00 01 00 02 dc 58 15 00 00 00 01 00 02 dd 03 15 00 00 00 01 00 02 de 6d 15 00 00 00 01 00 02 df 03 15 00 00 00 01 00 02 e0 84 15 00 00 00 01 00 02 e1 03 15 00 00 00 01 00 02 e2 9c 15 00 00 00 01 00 02 e3 03 15 00 00 00 01 00 02 e4 b5 15 00 00 00 01 00 02 e5 03 15 00 00 00 01 00 02 e6 d2 15 00 00 00 01 00 02 e7 03 15 00 00 00 01 00 02 e8 f1 15 00 00 00 01 00 02 e9 03 15 00 00 00 01 00 02 ea ff 15 00 00 00 01 00 02 eb 30 15 00 00 00 01 00 02 ec 17 15 00 00 00 01 00 02 ed 20 15 00 00 00 01 00 02 ee 0f 15 00 00 00 01 00 02 ef 1f 15 00 00 00 01 00 02 f0 0f 15 00 00 00 01 00 02 f1 0f 15 00 00 00 01 00 02 f2 07 15 00 00 00 01 00 02 fb 01 15 01 00 00 01 00 02 ff 10];
        qcom,mdss-dsi-dispparam-cold-command-state = "dsi_hs_mode";
        qcom,mdss-dsi-dispparam-papermode-command = [15 01 00 00 78 00 02 ff 20 15 00 00 00 01 00 02 fb 01 15 00 00 00 01 00 02 75 01 15 00 00 00 01 00 02 76 31 15 00 00 00 01 00 02 77 01 15 00 00 00 01 00 02 78 35 15 00 00 00 01 00 02 79 01 15 00 00 00 01 00 02 7a 3c 15 00 00 00 01 00 02 7b 01 15 00 00 00 01 00 02 7c 43 15 00 00 00 01 00 02 7d 01 15 00 00 00 01 00 02 7e 4a 15 00 00 00 01 00 02 7f 01 15 00 00 00 01 00 02 80 51 15 00 00 00 01 00 02 81 01 15 00 00 00 01 00 02 82 58 15 00 00 00 01 00 02 83 01 15 00 00 00 01 00 02 84 5e 15 00 00 00 01 00 02 85 01 15 00 00 00 01 00 02 86 64 15 00 00 00 01 00 02 87 01 15 00 00 00 01 00 02 88 7a 15 00 00 00 01 00 02 89 01 15 00 00 00 01 00 02 8a 8f 15 00 00 00 01 00 02 8b 01 15 00 00 00 01 00 02 8c b3 15 00 00 00 01 00 02 8d 01 15 00 00 00 01 00 02 8e d2 15 00 00 00 01 00 02 8f 02 15 00 00 00 01 00 02 90 03 15 00 00 00 01 00 02 91 02 15 00 00 00 01 00 02 92 28 15 00 00 00 01 00 02 93 02 15 00 00 00 01 00 02 94 2a 15 00 00 00 01 00 02 95 02 15 00 00 00 01 00 02 96 57 15 00 00 00 01 00 02 97 02 15 00 00 00 01 00 02 98 92 15 00 00 00 01 00 02 99 02 15 00 00 00 01 00 02 9a bb 15 00 00 00 01 00 02 9b 02 15 00 00 00 01 00 02 9c f2 15 00 00 00 01 00 02 9d 03 15 00 00 00 01 00 02 9e 11 15 00 00 00 01 00 02 9f 03 15 00 00 00 01 00 02 a0 4a 15 00 00 00 01 00 02 a2 03 15 00 00 00 01 00 02 a3 5d 15 00 00 00 01 00 02 a4 03 15 00 00 00 01 00 02 a5 70 15 00 00 00 01 00 02 a6 03 15 00 00 00 01 00 02 a7 83 15 00 00 00 01 00 02 a9 03 15 00 00 00 01 00 02 aa 96 15 00 00 00 01 00 02 ab 03 15 00 00 00 01 00 02 ac a6 15 00 00 00 01 00 02 ad 03 15 00 00 00 01 00 02 ae b1 15 00 00 00 01 00 02 af 03 15 00 00 00 01 00 02 b0 b6 15 00 00 00 01 00 02 b1 03 15 00 00 00 01 00 02 b2 ff 15 00 00 00 01 00 02 b3 01 15 00 00 00 01 00 02 b4 31 15 00 00 00 01 00 02 b5 01 15 00 00 00 01 00 02 b6 35 15 00 00 00 01 00 02 b7 01 15 00 00 00 01 00 02 b8 3c 15 00 00 00 01 00 02 b9 01 15 00 00 00 01 00 02 ba 43 15 00 00 00 01 00 02 bb 01 15 00 00 00 01 00 02 bc 4a 15 00 00 00 01 00 02 bd 01 15 00 00 00 01 00 02 be 51 15 00 00 00 01 00 02 bf 01 15 00 00 00 01 00 02 c0 58 15 00 00 00 01 00 02 c1 01 15 00 00 00 01 00 02 c2 5e 15 00 00 00 01 00 02 c3 01 15 00 00 00 01 00 02 c4 64 15 00 00 00 01 00 02 c5 01 15 00 00 00 01 00 02 c6 7a 15 00 00 00 01 00 02 c7 01 15 00 00 00 01 00 02 c8 8f 15 00 00 00 01 00 02 c9 01 15 00 00 00 01 00 02 ca b3 15 00 00 00 01 00 02 cb 01 15 00 00 00 01 00 02 cc d2 15 00 00 00 01 00 02 cd 02 15 00 00 00 01 00 02 ce 03 15 00 00 00 01 00 02 cf 02 15 00 00 00 01 00 02 d0 28 15 00 00 00 01 00 02 d1 02 15 00 00 00 01 00 02 d2 2a 15 00 00 00 01 00 02 d3 02 15 00 00 00 01 00 02 d4 57 15 00 00 00 01 00 02 d5 02 15 00 00 00 01 00 02 d6 92 15 00 00 00 01 00 02 d7 02 15 00 00 00 01 00 02 d8 bb 15 00 00 00 01 00 02 d9 02 15 00 00 00 01 00 02 da f2 15 00 00 00 01 00 02 db 03 15 00 00 00 01 00 02 dc 11 15 00 00 00 01 00 02 dd 03 15 00 00 00 01 00 02 de 4a 15 00 00 00 01 00 02 df 03 15 00 00 00 01 00 02 e0 5d 15 00 00 00 01 00 02 e1 03 15 00 00 00 01 00 02 e2 70 15 00 00 00 01 00 02 e3 03 15 00 00 00 01 00 02 e4 83 15 00 00 00 01 00 02 e5 03 15 00 00 00 01 00 02 e6 96 15 00 00 00 01 00 02 e7 03 15 00 00 00 01 00 02 e8 a6 15 00 00 00 01 00 02 e9 03 15 00 00 00 01 00 02 ea b1 15 00 00 00 01 00 02 eb 03 15 00 00 00 01 00 02 ec b6 15 00 00 00 01 00 02 ed 03 15 00 00 00 01 00 02 ee ff 15 00 00 00 01 00 02 ef 01 15 00 00 00 01 00 02 f0 4a 15 00 00 00 01 00 02 f1 01 15 00 00 00 01 00 02 f2 4d 15 00 00 00 01 00 02 f3 01 15 00 00 00 01 00 02 f4 54 15 00 00 00 01 00 02 f5 01 15 00 00 00 01 00 02 f6 5a 15 00 00 00 01 00 02 f7 01 15 00 00 00 01 00 02 f8 60 15 00 00 00 01 00 02 f9 01 15 00 00 00 01 00 02 fa 66 15 00 00 00 01 00 02 ff 21 15 00 00 00 01 00 02 fb 01 15 00 00 00 01 00 02 00 01 15 00 00 00 01 00 02 01 6b 15 00 00 00 01 00 02 02 01 15 00 00 00 01 00 02 03 71 15 00 00 00 01 00 02 04 01 15 00 00 00 01 00 02 05 76 15 00 00 00 01 00 02 06 01 15 00 00 00 01 00 02 07 8a 15 00 00 00 01 00 02 08 01 15 00 00 00 01 00 02 09 9d 15 00 00 00 01 00 02 0a 01 15 00 00 00 01 00 02 0b be 15 00 00 00 01 00 02 0c 01 15 00 00 00 01 00 02 0d dc 15 00 00 00 01 00 02 0e 02 15 00 00 00 01 00 02 0f 07 15 00 00 00 01 00 02 10 02 15 00 00 00 01 00 02 11 2d 15 00 00 00 01 00 02 12 02 15 00 00 00 01 00 02 13 2e 15 00 00 00 01 00 02 14 02 15 00 00 00 01 00 02 15 5c 15 00 00 00 01 00 02 16 02 15 00 00 00 01 00 02 17 97 15 00 00 00 01 00 02 18 02 15 00 00 00 01 00 02 19 c0 15 00 00 00 01 00 02 1a 02 15 00 00 00 01 00 02 1b f7 15 00 00 00 01 00 02 1c 03 15 00 00 00 01 00 02 1d 14 15 00 00 00 01 00 02 1e 03 15 00 00 00 01 00 02 1f 4b 15 00 00 00 01 00 02 20 03 15 00 00 00 01 00 02 21 5c 15 00 00 00 01 00 02 22 03 15 00 00 00 01 00 02 23 6f 15 00 00 00 01 00 02 24 03 15 00 00 00 01 00 02 25 83 15 00 00 00 01 00 02 26 03 15 00 00 00 01 00 02 27 97 15 00 00 00 01 00 02 28 03 15 00 00 00 01 00 02 29 a6 15 00 00 00 01 00 02 2a 03 15 00 00 00 01 00 02 2b b1 15 00 00 00 01 00 02 2d 03 15 00 00 00 01 00 02 2f b6 15 00 00 00 01 00 02 30 03 15 00 00 00 01 00 02 31 ff 15 00 00 00 01 00 02 32 01 15 00 00 00 01 00 02 33 4a 15 00 00 00 01 00 02 34 01 15 00 00 00 01 00 02 35 4d 15 00 00 00 01 00 02 36 01 15 00 00 00 01 00 02 37 54 15 00 00 00 01 00 02 38 01 15 00 00 00 01 00 02 39 5a 15 00 00 00 01 00 02 3a 01 15 00 00 00 01 00 02 3b 60 15 00 00 00 01 00 02 3d 01 15 00 00 00 01 00 02 3f 66 15 00 00 00 01 00 02 40 01 15 00 00 00 01 00 02 41 6b 15 00 00 00 01 00 02 42 01 15 00 00 00 01 00 02 43 71 15 00 00 00 01 00 02 44 01 15 00 00 00 01 00 02 45 76 15 00 00 00 01 00 02 46 01 15 00 00 00 01 00 02 47 8a 15 00 00 00 01 00 02 48 01 15 00 00 00 01 00 02 49 9d 15 00 00 00 01 00 02 4a 01 15 00 00 00 01 00 02 4b be 15 00 00 00 01 00 02 4c 01 15 00 00 00 01 00 02 4d dc 15 00 00 00 01 00 02 4e 02 15 00 00 00 01 00 02 4f 07 15 00 00 00 01 00 02 50 02 15 00 00 00 01 00 02 51 2d 15 00 00 00 01 00 02 52 02 15 00 00 00 01 00 02 53 2e 15 00 00 00 01 00 02 54 02 15 00 00 00 01 00 02 55 5c 15 00 00 00 01 00 02 56 02 15 00 00 00 01 00 02 58 97 15 00 00 00 01 00 02 59 02 15 00 00 00 01 00 02 5a c0 15 00 00 00 01 00 02 5b 02 15 00 00 00 01 00 02 5c f7 15 00 00 00 01 00 02 5d 03 15 00 00 00 01 00 02 5e 14 15 00 00 00 01 00 02 5f 03 15 00 00 00 01 00 02 60 4b 15 00 00 00 01 00 02 61 03 15 00 00 00 01 00 02 62 5c 15 00 00 00 01 00 02 63 03 15 00 00 00 01 00 02 64 6f 15 00 00 00 01 00 02 65 03 15 00 00 00 01 00 02 66 83 15 00 00 00 01 00 02 67 03 15 00 00 00 01 00 02 68 97 15 00 00 00 01 00 02 69 03 15 00 00 00 01 00 02 6a a6 15 00 00 00 01 00 02 6b 03 15 00 00 00 01 00 02 6c b1 15 00 00 00 01 00 02 6d 03 15 00 00 00 01 00 02 6e b6 15 00 00 00 01 00 02 6f 03 15 00 00 00 01 00 02 70 ff 15 00 00 00 01 00 02 71 02 15 00 00 00 01 00 02 72 15 15 00 00 00 01 00 02 73 02 15 00 00 00 01 00 02 74 16 15 00 00 00 01 00 02 75 02 15 00 00 00 01 00 02 76 17 15 00 00 00 01 00 02 77 02 15 00 00 00 01 00 02 78 18 15 00 00 00 01 00 02 79 02 15 00 00 00 01 00 02 7a 1a 15 00 00 00 01 00 02 7b 02 15 00 00 00 01 00 02 7c 1b 15 00 00 00 01 00 02 7d 02 15 00 00 00 01 00 02 7e 1c 15 00 00 00 01 00 02 7f 02 15 00 00 00 01 00 02 80 1e 15 00 00 00 01 00 02 81 02 15 00 00 00 01 00 02 82 1f 15 00 00 00 01 00 02 83 02 15 00 00 00 01 00 02 84 25 15 00 00 00 01 00 02 85 02 15 00 00 00 01 00 02 86 2b 15 00 00 00 01 00 02 87 02 15 00 00 00 01 00 02 88 37 15 00 00 00 01 00 02 89 02 15 00 00 00 01 00 02 8a 43 15 00 00 00 01 00 02 8b 02 15 00 00 00 01 00 02 8c 5f 15 00 00 00 01 00 02 8d 02 15 00 00 00 01 00 02 8e 80 15 00 00 00 01 00 02 8f 02 15 00 00 00 01 00 02 90 81 15 00 00 00 01 00 02 91 02 15 00 00 00 01 00 02 92 aa 15 00 00 00 01 00 02 93 02 15 00 00 00 01 00 02 94 e2 15 00 00 00 01 00 02 95 03 15 00 00 00 01 00 02 96 05 15 00 00 00 01 00 02 97 03 15 00 00 00 01 00 02 98 33 15 00 00 00 01 00 02 99 03 15 00 00 00 01 00 02 9a 59 15 00 00 00 01 00 02 9b 03 15 00 00 00 01 00 02 9c 86 15 00 00 00 01 00 02 9d 03 15 00 00 00 01 00 02 9e 92 15 00 00 00 01 00 02 9f 03 15 00 00 00 01 00 02 a0 9c 15 00 00 00 01 00 02 a2 03 15 00 00 00 01 00 02 a3 a5 15 00 00 00 01 00 02 a4 03 15 00 00 00 01 00 02 a5 ac 15 00 00 00 01 00 02 a6 03 15 00 00 00 01 00 02 a7 b1 15 00 00 00 01 00 02 a9 03 15 00 00 00 01 00 02 aa b5 15 00 00 00 01 00 02 ab 03 15 00 00 00 01 00 02 ac b6 15 00 00 00 01 00 02 ad 03 15 00 00 00 01 00 02 ae ff 15 00 00 00 01 00 02 af 02 15 00 00 00 01 00 02 b0 15 15 00 00 00 01 00 02 b1 02 15 00 00 00 01 00 02 b2 16 15 00 00 00 01 00 02 b3 02 15 00 00 00 01 00 02 b4 17 15 00 00 00 01 00 02 b5 02 15 00 00 00 01 00 02 b6 18 15 00 00 00 01 00 02 b7 02 15 00 00 00 01 00 02 b8 1a 15 00 00 00 01 00 02 b9 02 15 00 00 00 01 00 02 ba 1b 15 00 00 00 01 00 02 bb 02 15 00 00 00 01 00 02 bc 1c 15 00 00 00 01 00 02 bd 02 15 00 00 00 01 00 02 be 1e 15 00 00 00 01 00 02 bf 02 15 00 00 00 01 00 02 c0 1f 15 00 00 00 01 00 02 c1 02 15 00 00 00 01 00 02 c2 25 15 00 00 00 01 00 02 c3 02 15 00 00 00 01 00 02 c4 2b 15 00 00 00 01 00 02 c5 02 15 00 00 00 01 00 02 c6 37 15 00 00 00 01 00 02 c7 02 15 00 00 00 01 00 02 c8 43 15 00 00 00 01 00 02 c9 02 15 00 00 00 01 00 02 ca 5f 15 00 00 00 01 00 02 cb 02 15 00 00 00 01 00 02 cc 80 15 00 00 00 01 00 02 cd 02 15 00 00 00 01 00 02 ce 81 15 00 00 00 01 00 02 cf 02 15 00 00 00 01 00 02 d0 aa 15 00 00 00 01 00 02 d1 02 15 00 00 00 01 00 02 d2 e2 15 00 00 00 01 00 02 d3 03 15 00 00 00 01 00 02 d4 05 15 00 00 00 01 00 02 d5 03 15 00 00 00 01 00 02 d6 33 15 00 00 00 01 00 02 d7 03 15 00 00 00 01 00 02 d8 59 15 00 00 00 01 00 02 d9 03 15 00 00 00 01 00 02 da 86 15 00 00 00 01 00 02 db 03 15 00 00 00 01 00 02 dc 92 15 00 00 00 01 00 02 dd 03 15 00 00 00 01 00 02 de 9c 15 00 00 00 01 00 02 df 03 15 00 00 00 01 00 02 e0 a5 15 00 00 00 01 00 02 e1 03 15 00 00 00 01 00 02 e2 ac 15 00 00 00 01 00 02 e3 03 15 00 00 00 01 00 02 e4 b1 15 00 00 00 01 00 02 e5 03 15 00 00 00 01 00 02 e6 b5 15 00 00 00 01 00 02 e7 03 15 00 00 00 01 00 02 e8 b6 15 00 00 00 01 00 02 e9 03 15 00 00 00 01 00 02 ea ff 15 00 00 00 01 00 02 fb 01 15 01 00 00 01 00 02 ff 10];
        qcom,mdss-dsi-dispparam-papermode-state = "dsi_hs_mode";
        qcom,mdss-dsi-dispparam-papermode1-command = [15 01 00 00 78 00 02 ff 20 15 00 00 00 01 00 02 fb 01 15 00 00 00 01 00 02 75 01 15 00 00 00 01 00 02 76 31 15 00 00 00 01 00 02 77 01 15 00 00 00 01 00 02 78 35 15 00 00 00 01 00 02 79 01 15 00 00 00 01 00 02 7a 3c 15 00 00 00 01 00 02 7b 01 15 00 00 00 01 00 02 7c 43 15 00 00 00 01 00 02 7d 01 15 00 00 00 01 00 02 7e 4a 15 00 00 00 01 00 02 7f 01 15 00 00 00 01 00 02 80 51 15 00 00 00 01 00 02 81 01 15 00 00 00 01 00 02 82 58 15 00 00 00 01 00 02 83 01 15 00 00 00 01 00 02 84 5e 15 00 00 00 01 00 02 85 01 15 00 00 00 01 00 02 86 64 15 00 00 00 01 00 02 87 01 15 00 00 00 01 00 02 88 7a 15 00 00 00 01 00 02 89 01 15 00 00 00 01 00 02 8a 8f 15 00 00 00 01 00 02 8b 01 15 00 00 00 01 00 02 8c b3 15 00 00 00 01 00 02 8d 01 15 00 00 00 01 00 02 8e d2 15 00 00 00 01 00 02 8f 02 15 00 00 00 01 00 02 90 03 15 00 00 00 01 00 02 91 02 15 00 00 00 01 00 02 92 28 15 00 00 00 01 00 02 93 02 15 00 00 00 01 00 02 94 2a 15 00 00 00 01 00 02 95 02 15 00 00 00 01 00 02 96 57 15 00 00 00 01 00 02 97 02 15 00 00 00 01 00 02 98 92 15 00 00 00 01 00 02 99 02 15 00 00 00 01 00 02 9a bb 15 00 00 00 01 00 02 9b 02 15 00 00 00 01 00 02 9c f2 15 00 00 00 01 00 02 9d 03 15 00 00 00 01 00 02 9e 11 15 00 00 00 01 00 02 9f 03 15 00 00 00 01 00 02 a0 4a 15 00 00 00 01 00 02 a2 03 15 00 00 00 01 00 02 a3 5d 15 00 00 00 01 00 02 a4 03 15 00 00 00 01 00 02 a5 70 15 00 00 00 01 00 02 a6 03 15 00 00 00 01 00 02 a7 83 15 00 00 00 01 00 02 a9 03 15 00 00 00 01 00 02 aa 96 15 00 00 00 01 00 02 ab 03 15 00 00 00 01 00 02 ac a6 15 00 00 00 01 00 02 ad 03 15 00 00 00 01 00 02 ae b1 15 00 00 00 01 00 02 af 03 15 00 00 00 01 00 02 b0 b6 15 00 00 00 01 00 02 b1 03 15 00 00 00 01 00 02 b2 ff 15 00 00 00 01 00 02 b3 01 15 00 00 00 01 00 02 b4 31 15 00 00 00 01 00 02 b5 01 15 00 00 00 01 00 02 b6 35 15 00 00 00 01 00 02 b7 01 15 00 00 00 01 00 02 b8 3c 15 00 00 00 01 00 02 b9 01 15 00 00 00 01 00 02 ba 43 15 00 00 00 01 00 02 bb 01 15 00 00 00 01 00 02 bc 4a 15 00 00 00 01 00 02 bd 01 15 00 00 00 01 00 02 be 51 15 00 00 00 01 00 02 bf 01 15 00 00 00 01 00 02 c0 58 15 00 00 00 01 00 02 c1 01 15 00 00 00 01 00 02 c2 5e 15 00 00 00 01 00 02 c3 01 15 00 00 00 01 00 02 c4 64 15 00 00 00 01 00 02 c5 01 15 00 00 00 01 00 02 c6 7a 15 00 00 00 01 00 02 c7 01 15 00 00 00 01 00 02 c8 8f 15 00 00 00 01 00 02 c9 01 15 00 00 00 01 00 02 ca b3 15 00 00 00 01 00 02 cb 01 15 00 00 00 01 00 02 cc d2 15 00 00 00 01 00 02 cd 02 15 00 00 00 01 00 02 ce 03 15 00 00 00 01 00 02 cf 02 15 00 00 00 01 00 02 d0 28 15 00 00 00 01 00 02 d1 02 15 00 00 00 01 00 02 d2 2a 15 00 00 00 01 00 02 d3 02 15 00 00 00 01 00 02 d4 57 15 00 00 00 01 00 02 d5 02 15 00 00 00 01 00 02 d6 92 15 00 00 00 01 00 02 d7 02 15 00 00 00 01 00 02 d8 bb 15 00 00 00 01 00 02 d9 02 15 00 00 00 01 00 02 da f2 15 00 00 00 01 00 02 db 03 15 00 00 00 01 00 02 dc 11 15 00 00 00 01 00 02 dd 03 15 00 00 00 01 00 02 de 4a 15 00 00 00 01 00 02 df 03 15 00 00 00 01 00 02 e0 5d 15 00 00 00 01 00 02 e1 03 15 00 00 00 01 00 02 e2 70 15 00 00 00 01 00 02 e3 03 15 00 00 00 01 00 02 e4 83 15 00 00 00 01 00 02 e5 03 15 00 00 00 01 00 02 e6 96 15 00 00 00 01 00 02 e7 03 15 00 00 00 01 00 02 e8 a6 15 00 00 00 01 00 02 e9 03 15 00 00 00 01 00 02 ea b1 15 00 00 00 01 00 02 eb 03 15 00 00 00 01 00 02 ec b6 15 00 00 00 01 00 02 ed 03 15 00 00 00 01 00 02 ee ff 15 00 00 00 01 00 02 ef 01 15 00 00 00 01 00 02 f0 4a 15 00 00 00 01 00 02 f1 01 15 00 00 00 01 00 02 f2 4d 15 00 00 00 01 00 02 f3 01 15 00 00 00 01 00 02 f4 54 15 00 00 00 01 00 02 f5 01 15 00 00 00 01 00 02 f6 5a 15 00 00 00 01 00 02 f7 01 15 00 00 00 01 00 02 f8 60 15 00 00 00 01 00 02 f9 01 15 00 00 00 01 00 02 fa 66 15 00 00 00 01 00 02 ff 21 15 00 00 00 01 00 02 fb 01 15 00 00 00 01 00 02 00 01 15 00 00 00 01 00 02 01 6b 15 00 00 00 01 00 02 02 01 15 00 00 00 01 00 02 03 71 15 00 00 00 01 00 02 04 01 15 00 00 00 01 00 02 05 76 15 00 00 00 01 00 02 06 01 15 00 00 00 01 00 02 07 8a 15 00 00 00 01 00 02 08 01 15 00 00 00 01 00 02 09 9d 15 00 00 00 01 00 02 0a 01 15 00 00 00 01 00 02 0b be 15 00 00 00 01 00 02 0c 01 15 00 00 00 01 00 02 0d dc 15 00 00 00 01 00 02 0e 02 15 00 00 00 01 00 02 0f 07 15 00 00 00 01 00 02 10 02 15 00 00 00 01 00 02 11 2d 15 00 00 00 01 00 02 12 02 15 00 00 00 01 00 02 13 2e 15 00 00 00 01 00 02 14 02 15 00 00 00 01 00 02 15 5c 15 00 00 00 01 00 02 16 02 15 00 00 00 01 00 02 17 97 15 00 00 00 01 00 02 18 02 15 00 00 00 01 00 02 19 c0 15 00 00 00 01 00 02 1a 02 15 00 00 00 01 00 02 1b f7 15 00 00 00 01 00 02 1c 03 15 00 00 00 01 00 02 1d 14 15 00 00 00 01 00 02 1e 03 15 00 00 00 01 00 02 1f 4b 15 00 00 00 01 00 02 20 03 15 00 00 00 01 00 02 21 5c 15 00 00 00 01 00 02 22 03 15 00 00 00 01 00 02 23 6f 15 00 00 00 01 00 02 24 03 15 00 00 00 01 00 02 25 83 15 00 00 00 01 00 02 26 03 15 00 00 00 01 00 02 27 97 15 00 00 00 01 00 02 28 03 15 00 00 00 01 00 02 29 a6 15 00 00 00 01 00 02 2a 03 15 00 00 00 01 00 02 2b b1 15 00 00 00 01 00 02 2d 03 15 00 00 00 01 00 02 2f b6 15 00 00 00 01 00 02 30 03 15 00 00 00 01 00 02 31 ff 15 00 00 00 01 00 02 32 01 15 00 00 00 01 00 02 33 4a 15 00 00 00 01 00 02 34 01 15 00 00 00 01 00 02 35 4d 15 00 00 00 01 00 02 36 01 15 00 00 00 01 00 02 37 54 15 00 00 00 01 00 02 38 01 15 00 00 00 01 00 02 39 5a 15 00 00 00 01 00 02 3a 01 15 00 00 00 01 00 02 3b 60 15 00 00 00 01 00 02 3d 01 15 00 00 00 01 00 02 3f 66 15 00 00 00 01 00 02 40 01 15 00 00 00 01 00 02 41 6b 15 00 00 00 01 00 02 42 01 15 00 00 00 01 00 02 43 71 15 00 00 00 01 00 02 44 01 15 00 00 00 01 00 02 45 76 15 00 00 00 01 00 02 46 01 15 00 00 00 01 00 02 47 8a 15 00 00 00 01 00 02 48 01 15 00 00 00 01 00 02 49 9d 15 00 00 00 01 00 02 4a 01 15 00 00 00 01 00 02 4b be 15 00 00 00 01 00 02 4c 01 15 00 00 00 01 00 02 4d dc 15 00 00 00 01 00 02 4e 02 15 00 00 00 01 00 02 4f 07 15 00 00 00 01 00 02 50 02 15 00 00 00 01 00 02 51 2d 15 00 00 00 01 00 02 52 02 15 00 00 00 01 00 02 53 2e 15 00 00 00 01 00 02 54 02 15 00 00 00 01 00 02 55 5c 15 00 00 00 01 00 02 56 02 15 00 00 00 01 00 02 58 97 15 00 00 00 01 00 02 59 02 15 00 00 00 01 00 02 5a c0 15 00 00 00 01 00 02 5b 02 15 00 00 00 01 00 02 5c f7 15 00 00 00 01 00 02 5d 03 15 00 00 00 01 00 02 5e 14 15 00 00 00 01 00 02 5f 03 15 00 00 00 01 00 02 60 4b 15 00 00 00 01 00 02 61 03 15 00 00 00 01 00 02 62 5c 15 00 00 00 01 00 02 63 03 15 00 00 00 01 00 02 64 6f 15 00 00 00 01 00 02 65 03 15 00 00 00 01 00 02 66 83 15 00 00 00 01 00 02 67 03 15 00 00 00 01 00 02 68 97 15 00 00 00 01 00 02 69 03 15 00 00 00 01 00 02 6a a6 15 00 00 00 01 00 02 6b 03 15 00 00 00 01 00 02 6c b1 15 00 00 00 01 00 02 6d 03 15 00 00 00 01 00 02 6e b6 15 00 00 00 01 00 02 6f 03 15 00 00 00 01 00 02 70 ff 15 00 00 00 01 00 02 71 01 15 00 00 00 01 00 02 72 7a 15 00 00 00 01 00 02 73 01 15 00 00 00 01 00 02 74 7c 15 00 00 00 01 00 02 75 01 15 00 00 00 01 00 02 76 81 15 00 00 00 01 00 02 77 01 15 00 00 00 01 00 02 78 86 15 00 00 00 01 00 02 79 01 15 00 00 00 01 00 02 7a 8a 15 00 00 00 01 00 02 7b 01 15 00 00 00 01 00 02 7c 8f 15 00 00 00 01 00 02 7d 01 15 00 00 00 01 00 02 7e 93 15 00 00 00 01 00 02 7f 01 15 00 00 00 01 00 02 80 97 15 00 00 00 01 00 02 81 01 15 00 00 00 01 00 02 82 9c 15 00 00 00 01 00 02 83 01 15 00 00 00 01 00 02 84 ac 15 00 00 00 01 00 02 85 01 15 00 00 00 01 00 02 86 bb 15 00 00 00 01 00 02 87 01 15 00 00 00 01 00 02 88 d7 15 00 00 00 01 00 02 89 01 15 00 00 00 01 00 02 8a f2 15 00 00 00 01 00 02 8b 02 15 00 00 00 01 00 02 8c 13 15 00 00 00 01 00 02 8d 02 15 00 00 00 01 00 02 8e 38 15 00 00 00 01 00 02 8f 02 15 00 00 00 01 00 02 90 39 15 00 00 00 01 00 02 91 02 15 00 00 00 01 00 02 92 65 15 00 00 00 01 00 02 93 02 15 00 00 00 01 00 02 94 a1 15 00 00 00 01 00 02 95 02 15 00 00 00 01 00 02 96 ca 15 00 00 00 01 00 02 97 02 15 00 00 00 01 00 02 98 fe 15 00 00 00 01 00 02 99 03 15 00 00 00 01 00 02 9a 1a 15 00 00 00 01 00 02 9b 03 15 00 00 00 01 00 02 9c 53 15 00 00 00 01 00 02 9d 03 15 00 00 00 01 00 02 9e 64 15 00 00 00 01 00 02 9f 03 15 00 00 00 01 00 02 a0 77 15 00 00 00 01 00 02 a2 03 15 00 00 00 01 00 02 a3 89 15 00 00 00 01 00 02 a4 03 15 00 00 00 01 00 02 a5 9a 15 00 00 00 01 00 02 a6 03 15 00 00 00 01 00 02 a7 a8 15 00 00 00 01 00 02 a9 03 15 00 00 00 01 00 02 aa b2 15 00 00 00 01 00 02 ab 03 15 00 00 00 01 00 02 ac b6 15 00 00 00 01 00 02 ad 03 15 00 00 00 01 00 02 ae ff 15 00 00 00 01 00 02 af 01 15 00 00 00 01 00 02 b0 7a 15 00 00 00 01 00 02 b1 01 15 00 00 00 01 00 02 b2 7c 15 00 00 00 01 00 02 b3 01 15 00 00 00 01 00 02 b4 81 15 00 00 00 01 00 02 b5 01 15 00 00 00 01 00 02 b6 86 15 00 00 00 01 00 02 b7 01 15 00 00 00 01 00 02 b8 8a 15 00 00 00 01 00 02 b9 01 15 00 00 00 01 00 02 ba 8f 15 00 00 00 01 00 02 bb 01 15 00 00 00 01 00 02 bc 93 15 00 00 00 01 00 02 bd 01 15 00 00 00 01 00 02 be 97 15 00 00 00 01 00 02 bf 01 15 00 00 00 01 00 02 c0 9c 15 00 00 00 01 00 02 c1 01 15 00 00 00 01 00 02 c2 ac 15 00 00 00 01 00 02 c3 01 15 00 00 00 01 00 02 c4 bb 15 00 00 00 01 00 02 c5 01 15 00 00 00 01 00 02 c6 d7 15 00 00 00 01 00 02 c7 01 15 00 00 00 01 00 02 c8 f2 15 00 00 00 01 00 02 c9 02 15 00 00 00 01 00 02 ca 13 15 00 00 00 01 00 02 cb 02 15 00 00 00 01 00 02 cc 38 15 00 00 00 01 00 02 cd 02 15 00 00 00 01 00 02 ce 39 15 00 00 00 01 00 02 cf 02 15 00 00 00 01 00 02 d0 65 15 00 00 00 01 00 02 d1 02 15 00 00 00 01 00 02 d2 a1 15 00 00 00 01 00 02 d3 02 15 00 00 00 01 00 02 d4 ca 15 00 00 00 01 00 02 d5 02 15 00 00 00 01 00 02 d6 fe 15 00 00 00 01 00 02 d7 03 15 00 00 00 01 00 02 d8 1a 15 00 00 00 01 00 02 d9 03 15 00 00 00 01 00 02 da 53 15 00 00 00 01 00 02 db 03 15 00 00 00 01 00 02 dc 64 15 00 00 00 01 00 02 dd 03 15 00 00 00 01 00 02 de 77 15 00 00 00 01 00 02 df 03 15 00 00 00 01 00 02 e0 89 15 00 00 00 01 00 02 e1 03 15 00 00 00 01 00 02 e2 9a 15 00 00 00 01 00 02 e3 03 15 00 00 00 01 00 02 e4 a8 15 00 00 00 01 00 02 e5 03 15 00 00 00 01 00 02 e6 b2 15 00 00 00 01 00 02 e7 03 15 00 00 00 01 00 02 e8 b6 15 00 00 00 01 00 02 e9 03 15 00 00 00 01 00 02 ea ff 15 00 00 00 01 00 02 fb 01 15 01 00 00 01 00 02 ff 10];
        qcom,mdss-dsi-dispparam-papermode1-state = "dsi_hs_mode";
        qcom,mdss-dsi-dispparam-papermode2-command = [15 01 00 00 78 00 02 ff 20 15 00 00 00 01 00 02 fb 01 15 00 00 00 01 00 02 75 01 15 00 00 00 01 00 02 76 31 15 00 00 00 01 00 02 77 01 15 00 00 00 01 00 02 78 35 15 00 00 00 01 00 02 79 01 15 00 00 00 01 00 02 7a 3c 15 00 00 00 01 00 02 7b 01 15 00 00 00 01 00 02 7c 43 15 00 00 00 01 00 02 7d 01 15 00 00 00 01 00 02 7e 4a 15 00 00 00 01 00 02 7f 01 15 00 00 00 01 00 02 80 51 15 00 00 00 01 00 02 81 01 15 00 00 00 01 00 02 82 58 15 00 00 00 01 00 02 83 01 15 00 00 00 01 00 02 84 5e 15 00 00 00 01 00 02 85 01 15 00 00 00 01 00 02 86 64 15 00 00 00 01 00 02 87 01 15 00 00 00 01 00 02 88 7a 15 00 00 00 01 00 02 89 01 15 00 00 00 01 00 02 8a 8f 15 00 00 00 01 00 02 8b 01 15 00 00 00 01 00 02 8c b3 15 00 00 00 01 00 02 8d 01 15 00 00 00 01 00 02 8e d2 15 00 00 00 01 00 02 8f 02 15 00 00 00 01 00 02 90 03 15 00 00 00 01 00 02 91 02 15 00 00 00 01 00 02 92 28 15 00 00 00 01 00 02 93 02 15 00 00 00 01 00 02 94 2a 15 00 00 00 01 00 02 95 02 15 00 00 00 01 00 02 96 57 15 00 00 00 01 00 02 97 02 15 00 00 00 01 00 02 98 92 15 00 00 00 01 00 02 99 02 15 00 00 00 01 00 02 9a bb 15 00 00 00 01 00 02 9b 02 15 00 00 00 01 00 02 9c f2 15 00 00 00 01 00 02 9d 03 15 00 00 00 01 00 02 9e 11 15 00 00 00 01 00 02 9f 03 15 00 00 00 01 00 02 a0 4a 15 00 00 00 01 00 02 a2 03 15 00 00 00 01 00 02 a3 5d 15 00 00 00 01 00 02 a4 03 15 00 00 00 01 00 02 a5 70 15 00 00 00 01 00 02 a6 03 15 00 00 00 01 00 02 a7 83 15 00 00 00 01 00 02 a9 03 15 00 00 00 01 00 02 aa 96 15 00 00 00 01 00 02 ab 03 15 00 00 00 01 00 02 ac a6 15 00 00 00 01 00 02 ad 03 15 00 00 00 01 00 02 ae b1 15 00 00 00 01 00 02 af 03 15 00 00 00 01 00 02 b0 b6 15 00 00 00 01 00 02 b1 03 15 00 00 00 01 00 02 b2 ff 15 00 00 00 01 00 02 b3 01 15 00 00 00 01 00 02 b4 31 15 00 00 00 01 00 02 b5 01 15 00 00 00 01 00 02 b6 35 15 00 00 00 01 00 02 b7 01 15 00 00 00 01 00 02 b8 3c 15 00 00 00 01 00 02 b9 01 15 00 00 00 01 00 02 ba 43 15 00 00 00 01 00 02 bb 01 15 00 00 00 01 00 02 bc 4a 15 00 00 00 01 00 02 bd 01 15 00 00 00 01 00 02 be 51 15 00 00 00 01 00 02 bf 01 15 00 00 00 01 00 02 c0 58 15 00 00 00 01 00 02 c1 01 15 00 00 00 01 00 02 c2 5e 15 00 00 00 01 00 02 c3 01 15 00 00 00 01 00 02 c4 64 15 00 00 00 01 00 02 c5 01 15 00 00 00 01 00 02 c6 7a 15 00 00 00 01 00 02 c7 01 15 00 00 00 01 00 02 c8 8f 15 00 00 00 01 00 02 c9 01 15 00 00 00 01 00 02 ca b3 15 00 00 00 01 00 02 cb 01 15 00 00 00 01 00 02 cc d2 15 00 00 00 01 00 02 cd 02 15 00 00 00 01 00 02 ce 03 15 00 00 00 01 00 02 cf 02 15 00 00 00 01 00 02 d0 28 15 00 00 00 01 00 02 d1 02 15 00 00 00 01 00 02 d2 2a 15 00 00 00 01 00 02 d3 02 15 00 00 00 01 00 02 d4 57 15 00 00 00 01 00 02 d5 02 15 00 00 00 01 00 02 d6 92 15 00 00 00 01 00 02 d7 02 15 00 00 00 01 00 02 d8 bb 15 00 00 00 01 00 02 d9 02 15 00 00 00 01 00 02 da f2 15 00 00 00 01 00 02 db 03 15 00 00 00 01 00 02 dc 11 15 00 00 00 01 00 02 dd 03 15 00 00 00 01 00 02 de 4a 15 00 00 00 01 00 02 df 03 15 00 00 00 01 00 02 e0 5d 15 00 00 00 01 00 02 e1 03 15 00 00 00 01 00 02 e2 70 15 00 00 00 01 00 02 e3 03 15 00 00 00 01 00 02 e4 83 15 00 00 00 01 00 02 e5 03 15 00 00 00 01 00 02 e6 96 15 00 00 00 01 00 02 e7 03 15 00 00 00 01 00 02 e8 a6 15 00 00 00 01 00 02 e9 03 15 00 00 00 01 00 02 ea b1 15 00 00 00 01 00 02 eb 03 15 00 00 00 01 00 02 ec b6 15 00 00 00 01 00 02 ed 03 15 00 00 00 01 00 02 ee ff 15 00 00 00 01 00 02 ef 01 15 00 00 00 01 00 02 f0 4a 15 00 00 00 01 00 02 f1 01 15 00 00 00 01 00 02 f2 4d 15 00 00 00 01 00 02 f3 01 15 00 00 00 01 00 02 f4 54 15 00 00 00 01 00 02 f5 01 15 00 00 00 01 00 02 f6 5a 15 00 00 00 01 00 02 f7 01 15 00 00 00 01 00 02 f8 60 15 00 00 00 01 00 02 f9 01 15 00 00 00 01 00 02 fa 66 15 00 00 00 01 00 02 ff 21 15 00 00 00 01 00 02 fb 01 15 00 00 00 01 00 02 00 01 15 00 00 00 01 00 02 01 6b 15 00 00 00 01 00 02 02 01 15 00 00 00 01 00 02 03 71 15 00 00 00 01 00 02 04 01 15 00 00 00 01 00 02 05 76 15 00 00 00 01 00 02 06 01 15 00 00 00 01 00 02 07 8a 15 00 00 00 01 00 02 08 01 15 00 00 00 01 00 02 09 9d 15 00 00 00 01 00 02 0a 01 15 00 00 00 01 00 02 0b be 15 00 00 00 01 00 02 0c 01 15 00 00 00 01 00 02 0d dc 15 00 00 00 01 00 02 0e 02 15 00 00 00 01 00 02 0f 07 15 00 00 00 01 00 02 10 02 15 00 00 00 01 00 02 11 2d 15 00 00 00 01 00 02 12 02 15 00 00 00 01 00 02 13 2e 15 00 00 00 01 00 02 14 02 15 00 00 00 01 00 02 15 5c 15 00 00 00 01 00 02 16 02 15 00 00 00 01 00 02 17 97 15 00 00 00 01 00 02 18 02 15 00 00 00 01 00 02 19 c0 15 00 00 00 01 00 02 1a 02 15 00 00 00 01 00 02 1b f7 15 00 00 00 01 00 02 1c 03 15 00 00 00 01 00 02 1d 14 15 00 00 00 01 00 02 1e 03 15 00 00 00 01 00 02 1f 4b 15 00 00 00 01 00 02 20 03 15 00 00 00 01 00 02 21 5c 15 00 00 00 01 00 02 22 03 15 00 00 00 01 00 02 23 6f 15 00 00 00 01 00 02 24 03 15 00 00 00 01 00 02 25 83 15 00 00 00 01 00 02 26 03 15 00 00 00 01 00 02 27 97 15 00 00 00 01 00 02 28 03 15 00 00 00 01 00 02 29 a6 15 00 00 00 01 00 02 2a 03 15 00 00 00 01 00 02 2b b1 15 00 00 00 01 00 02 2d 03 15 00 00 00 01 00 02 2f b6 15 00 00 00 01 00 02 30 03 15 00 00 00 01 00 02 31 ff 15 00 00 00 01 00 02 32 01 15 00 00 00 01 00 02 33 4a 15 00 00 00 01 00 02 34 01 15 00 00 00 01 00 02 35 4d 15 00 00 00 01 00 02 36 01 15 00 00 00 01 00 02 37 54 15 00 00 00 01 00 02 38 01 15 00 00 00 01 00 02 39 5a 15 00 00 00 01 00 02 3a 01 15 00 00 00 01 00 02 3b 60 15 00 00 00 01 00 02 3d 01 15 00 00 00 01 00 02 3f 66 15 00 00 00 01 00 02 40 01 15 00 00 00 01 00 02 41 6b 15 00 00 00 01 00 02 42 01 15 00 00 00 01 00 02 43 71 15 00 00 00 01 00 02 44 01 15 00 00 00 01 00 02 45 76 15 00 00 00 01 00 02 46 01 15 00 00 00 01 00 02 47 8a 15 00 00 00 01 00 02 48 01 15 00 00 00 01 00 02 49 9d 15 00 00 00 01 00 02 4a 01 15 00 00 00 01 00 02 4b be 15 00 00 00 01 00 02 4c 01 15 00 00 00 01 00 02 4d dc 15 00 00 00 01 00 02 4e 02 15 00 00 00 01 00 02 4f 07 15 00 00 00 01 00 02 50 02 15 00 00 00 01 00 02 51 2d 15 00 00 00 01 00 02 52 02 15 00 00 00 01 00 02 53 2e 15 00 00 00 01 00 02 54 02 15 00 00 00 01 00 02 55 5c 15 00 00 00 01 00 02 56 02 15 00 00 00 01 00 02 58 97 15 00 00 00 01 00 02 59 02 15 00 00 00 01 00 02 5a c0 15 00 00 00 01 00 02 5b 02 15 00 00 00 01 00 02 5c f7 15 00 00 00 01 00 02 5d 03 15 00 00 00 01 00 02 5e 14 15 00 00 00 01 00 02 5f 03 15 00 00 00 01 00 02 60 4b 15 00 00 00 01 00 02 61 03 15 00 00 00 01 00 02 62 5c 15 00 00 00 01 00 02 63 03 15 00 00 00 01 00 02 64 6f 15 00 00 00 01 00 02 65 03 15 00 00 00 01 00 02 66 83 15 00 00 00 01 00 02 67 03 15 00 00 00 01 00 02 68 97 15 00 00 00 01 00 02 69 03 15 00 00 00 01 00 02 6a a6 15 00 00 00 01 00 02 6b 03 15 00 00 00 01 00 02 6c b1 15 00 00 00 01 00 02 6d 03 15 00 00 00 01 00 02 6e b6 15 00 00 00 01 00 02 6f 03 15 00 00 00 01 00 02 70 ff 15 00 00 00 01 00 02 71 01 15 00 00 00 01 00 02 72 92 15 00 00 00 01 00 02 73 01 15 00 00 00 01 00 02 74 94 15 00 00 00 01 00 02 75 01 15 00 00 00 01 00 02 76 98 15 00 00 00 01 00 02 77 01 15 00 00 00 01 00 02 78 9c 15 00 00 00 01 00 02 79 01 15 00 00 00 01 00 02 7a a0 15 00 00 00 01 00 02 7b 01 15 00 00 00 01 00 02 7c a4 15 00 00 00 01 00 02 7d 01 15 00 00 00 01 00 02 7e a8 15 00 00 00 01 00 02 7f 01 15 00 00 00 01 00 02 80 ac 15 00 00 00 01 00 02 81 01 15 00 00 00 01 00 02 82 af 15 00 00 00 01 00 02 83 01 15 00 00 00 01 00 02 84 be 15 00 00 00 01 00 02 85 01 15 00 00 00 01 00 02 86 cb 15 00 00 00 01 00 02 87 01 15 00 00 00 01 00 02 88 e5 15 00 00 00 01 00 02 89 01 15 00 00 00 01 00 02 8a fa 15 00 00 00 01 00 02 8b 02 15 00 00 00 01 00 02 8c 1a 15 00 00 00 01 00 02 8d 02 15 00 00 00 01 00 02 8e 3e 15 00 00 00 01 00 02 8f 02 15 00 00 00 01 00 02 90 40 15 00 00 00 01 00 02 91 02 15 00 00 00 01 00 02 92 6c 15 00 00 00 01 00 02 93 02 15 00 00 00 01 00 02 94 a7 15 00 00 00 01 00 02 95 02 15 00 00 00 01 00 02 96 cf 15 00 00 00 01 00 02 97 03 15 00 00 00 01 00 02 98 02 15 00 00 00 01 00 02 99 03 15 00 00 00 01 00 02 9a 21 15 00 00 00 01 00 02 9b 03 15 00 00 00 01 00 02 9c 58 15 00 00 00 01 00 02 9d 03 15 00 00 00 01 00 02 9e 69 15 00 00 00 01 00 02 9f 03 15 00 00 00 01 00 02 a0 7b 15 00 00 00 01 00 02 a2 03 15 00 00 00 01 00 02 a3 8d 15 00 00 00 01 00 02 a4 03 15 00 00 00 01 00 02 a5 9d 15 00 00 00 01 00 02 a6 03 15 00 00 00 01 00 02 a7 aa 15 00 00 00 01 00 02 a9 03 15 00 00 00 01 00 02 aa b2 15 00 00 00 01 00 02 ab 03 15 00 00 00 01 00 02 ac b6 15 00 00 00 01 00 02 ad 03 15 00 00 00 01 00 02 ae ff 15 00 00 00 01 00 02 af 01 15 00 00 00 01 00 02 b0 92 15 00 00 00 01 00 02 b1 01 15 00 00 00 01 00 02 b2 94 15 00 00 00 01 00 02 b3 01 15 00 00 00 01 00 02 b4 98 15 00 00 00 01 00 02 b5 01 15 00 00 00 01 00 02 b6 9c 15 00 00 00 01 00 02 b7 01 15 00 00 00 01 00 02 b8 a0 15 00 00 00 01 00 02 b9 01 15 00 00 00 01 00 02 ba a4 15 00 00 00 01 00 02 bb 01 15 00 00 00 01 00 02 bc a8 15 00 00 00 01 00 02 bd 01 15 00 00 00 01 00 02 be ac 15 00 00 00 01 00 02 bf 01 15 00 00 00 01 00 02 c0 af 15 00 00 00 01 00 02 c1 01 15 00 00 00 01 00 02 c2 be 15 00 00 00 01 00 02 c3 01 15 00 00 00 01 00 02 c4 cb 15 00 00 00 01 00 02 c5 01 15 00 00 00 01 00 02 c6 e5 15 00 00 00 01 00 02 c7 01 15 00 00 00 01 00 02 c8 fa 15 00 00 00 01 00 02 c9 02 15 00 00 00 01 00 02 ca 1a 15 00 00 00 01 00 02 cb 02 15 00 00 00 01 00 02 cc 3e 15 00 00 00 01 00 02 cd 02 15 00 00 00 01 00 02 ce 40 15 00 00 00 01 00 02 cf 02 15 00 00 00 01 00 02 d0 6c 15 00 00 00 01 00 02 d1 02 15 00 00 00 01 00 02 d2 a7 15 00 00 00 01 00 02 d3 02 15 00 00 00 01 00 02 d4 cf 15 00 00 00 01 00 02 d5 03 15 00 00 00 01 00 02 d6 02 15 00 00 00 01 00 02 d7 03 15 00 00 00 01 00 02 d8 21 15 00 00 00 01 00 02 d9 03 15 00 00 00 01 00 02 da 58 15 00 00 00 01 00 02 db 03 15 00 00 00 01 00 02 dc 69 15 00 00 00 01 00 02 dd 03 15 00 00 00 01 00 02 de 7b 15 00 00 00 01 00 02 df 03 15 00 00 00 01 00 02 e0 8d 15 00 00 00 01 00 02 e1 03 15 00 00 00 01 00 02 e2 9d 15 00 00 00 01 00 02 e3 03 15 00 00 00 01 00 02 e4 aa 15 00 00 00 01 00 02 e5 03 15 00 00 00 01 00 02 e6 b2 15 00 00 00 01 00 02 e7 03 15 00 00 00 01 00 02 e8 b6 15 00 00 00 01 00 02 e9 03 15 00 00 00 01 00 02 ea ff 15 00 00 00 01 00 02 fb 01 15 01 00 00 01 00 02 ff 10];
        qcom,mdss-dsi-dispparam-papermode2-state = "dsi_hs_mode";
        qcom,mdss-dsi-dispparam-papermode3-command = [15 01 00 00 78 00 02 ff 20 15 00 00 00 01 00 02 fb 01 15 00 00 00 01 00 02 75 01 15 00 00 00 01 00 02 76 31 15 00 00 00 01 00 02 77 01 15 00 00 00 01 00 02 78 35 15 00 00 00 01 00 02 79 01 15 00 00 00 01 00 02 7a 3c 15 00 00 00 01 00 02 7b 01 15 00 00 00 01 00 02 7c 43 15 00 00 00 01 00 02 7d 01 15 00 00 00 01 00 02 7e 4a 15 00 00 00 01 00 02 7f 01 15 00 00 00 01 00 02 80 51 15 00 00 00 01 00 02 81 01 15 00 00 00 01 00 02 82 58 15 00 00 00 01 00 02 83 01 15 00 00 00 01 00 02 84 5e 15 00 00 00 01 00 02 85 01 15 00 00 00 01 00 02 86 64 15 00 00 00 01 00 02 87 01 15 00 00 00 01 00 02 88 7a 15 00 00 00 01 00 02 89 01 15 00 00 00 01 00 02 8a 8f 15 00 00 00 01 00 02 8b 01 15 00 00 00 01 00 02 8c b3 15 00 00 00 01 00 02 8d 01 15 00 00 00 01 00 02 8e d2 15 00 00 00 01 00 02 8f 02 15 00 00 00 01 00 02 90 03 15 00 00 00 01 00 02 91 02 15 00 00 00 01 00 02 92 28 15 00 00 00 01 00 02 93 02 15 00 00 00 01 00 02 94 2a 15 00 00 00 01 00 02 95 02 15 00 00 00 01 00 02 96 57 15 00 00 00 01 00 02 97 02 15 00 00 00 01 00 02 98 92 15 00 00 00 01 00 02 99 02 15 00 00 00 01 00 02 9a bb 15 00 00 00 01 00 02 9b 02 15 00 00 00 01 00 02 9c f2 15 00 00 00 01 00 02 9d 03 15 00 00 00 01 00 02 9e 11 15 00 00 00 01 00 02 9f 03 15 00 00 00 01 00 02 a0 4a 15 00 00 00 01 00 02 a2 03 15 00 00 00 01 00 02 a3 5d 15 00 00 00 01 00 02 a4 03 15 00 00 00 01 00 02 a5 70 15 00 00 00 01 00 02 a6 03 15 00 00 00 01 00 02 a7 83 15 00 00 00 01 00 02 a9 03 15 00 00 00 01 00 02 aa 96 15 00 00 00 01 00 02 ab 03 15 00 00 00 01 00 02 ac a6 15 00 00 00 01 00 02 ad 03 15 00 00 00 01 00 02 ae b1 15 00 00 00 01 00 02 af 03 15 00 00 00 01 00 02 b0 b6 15 00 00 00 01 00 02 b1 03 15 00 00 00 01 00 02 b2 ff 15 00 00 00 01 00 02 b3 01 15 00 00 00 01 00 02 b4 31 15 00 00 00 01 00 02 b5 01 15 00 00 00 01 00 02 b6 35 15 00 00 00 01 00 02 b7 01 15 00 00 00 01 00 02 b8 3c 15 00 00 00 01 00 02 b9 01 15 00 00 00 01 00 02 ba 43 15 00 00 00 01 00 02 bb 01 15 00 00 00 01 00 02 bc 4a 15 00 00 00 01 00 02 bd 01 15 00 00 00 01 00 02 be 51 15 00 00 00 01 00 02 bf 01 15 00 00 00 01 00 02 c0 58 15 00 00 00 01 00 02 c1 01 15 00 00 00 01 00 02 c2 5e 15 00 00 00 01 00 02 c3 01 15 00 00 00 01 00 02 c4 64 15 00 00 00 01 00 02 c5 01 15 00 00 00 01 00 02 c6 7a 15 00 00 00 01 00 02 c7 01 15 00 00 00 01 00 02 c8 8f 15 00 00 00 01 00 02 c9 01 15 00 00 00 01 00 02 ca b3 15 00 00 00 01 00 02 cb 01 15 00 00 00 01 00 02 cc d2 15 00 00 00 01 00 02 cd 02 15 00 00 00 01 00 02 ce 03 15 00 00 00 01 00 02 cf 02 15 00 00 00 01 00 02 d0 28 15 00 00 00 01 00 02 d1 02 15 00 00 00 01 00 02 d2 2a 15 00 00 00 01 00 02 d3 02 15 00 00 00 01 00 02 d4 57 15 00 00 00 01 00 02 d5 02 15 00 00 00 01 00 02 d6 92 15 00 00 00 01 00 02 d7 02 15 00 00 00 01 00 02 d8 bb 15 00 00 00 01 00 02 d9 02 15 00 00 00 01 00 02 da f2 15 00 00 00 01 00 02 db 03 15 00 00 00 01 00 02 dc 11 15 00 00 00 01 00 02 dd 03 15 00 00 00 01 00 02 de 4a 15 00 00 00 01 00 02 df 03 15 00 00 00 01 00 02 e0 5d 15 00 00 00 01 00 02 e1 03 15 00 00 00 01 00 02 e2 70 15 00 00 00 01 00 02 e3 03 15 00 00 00 01 00 02 e4 83 15 00 00 00 01 00 02 e5 03 15 00 00 00 01 00 02 e6 96 15 00 00 00 01 00 02 e7 03 15 00 00 00 01 00 02 e8 a6 15 00 00 00 01 00 02 e9 03 15 00 00 00 01 00 02 ea b1 15 00 00 00 01 00 02 eb 03 15 00 00 00 01 00 02 ec b6 15 00 00 00 01 00 02 ed 03 15 00 00 00 01 00 02 ee ff 15 00 00 00 01 00 02 ef 01 15 00 00 00 01 00 02 f0 4a 15 00 00 00 01 00 02 f1 01 15 00 00 00 01 00 02 f2 4d 15 00 00 00 01 00 02 f3 01 15 00 00 00 01 00 02 f4 54 15 00 00 00 01 00 02 f5 01 15 00 00 00 01 00 02 f6 5a 15 00 00 00 01 00 02 f7 01 15 00 00 00 01 00 02 f8 60 15 00 00 00 01 00 02 f9 01 15 00 00 00 01 00 02 fa 66 15 00 00 00 01 00 02 ff 21 15 00 00 00 01 00 02 fb 01 15 00 00 00 01 00 02 00 01 15 00 00 00 01 00 02 01 6b 15 00 00 00 01 00 02 02 01 15 00 00 00 01 00 02 03 71 15 00 00 00 01 00 02 04 01 15 00 00 00 01 00 02 05 76 15 00 00 00 01 00 02 06 01 15 00 00 00 01 00 02 07 8a 15 00 00 00 01 00 02 08 01 15 00 00 00 01 00 02 09 9d 15 00 00 00 01 00 02 0a 01 15 00 00 00 01 00 02 0b be 15 00 00 00 01 00 02 0c 01 15 00 00 00 01 00 02 0d dc 15 00 00 00 01 00 02 0e 02 15 00 00 00 01 00 02 0f 07 15 00 00 00 01 00 02 10 02 15 00 00 00 01 00 02 11 2d 15 00 00 00 01 00 02 12 02 15 00 00 00 01 00 02 13 2e 15 00 00 00 01 00 02 14 02 15 00 00 00 01 00 02 15 5c 15 00 00 00 01 00 02 16 02 15 00 00 00 01 00 02 17 97 15 00 00 00 01 00 02 18 02 15 00 00 00 01 00 02 19 c0 15 00 00 00 01 00 02 1a 02 15 00 00 00 01 00 02 1b f7 15 00 00 00 01 00 02 1c 03 15 00 00 00 01 00 02 1d 14 15 00 00 00 01 00 02 1e 03 15 00 00 00 01 00 02 1f 4b 15 00 00 00 01 00 02 20 03 15 00 00 00 01 00 02 21 5c 15 00 00 00 01 00 02 22 03 15 00 00 00 01 00 02 23 6f 15 00 00 00 01 00 02 24 03 15 00 00 00 01 00 02 25 83 15 00 00 00 01 00 02 26 03 15 00 00 00 01 00 02 27 97 15 00 00 00 01 00 02 28 03 15 00 00 00 01 00 02 29 a6 15 00 00 00 01 00 02 2a 03 15 00 00 00 01 00 02 2b b1 15 00 00 00 01 00 02 2d 03 15 00 00 00 01 00 02 2f b6 15 00 00 00 01 00 02 30 03 15 00 00 00 01 00 02 31 ff 15 00 00 00 01 00 02 32 01 15 00 00 00 01 00 02 33 4a 15 00 00 00 01 00 02 34 01 15 00 00 00 01 00 02 35 4d 15 00 00 00 01 00 02 36 01 15 00 00 00 01 00 02 37 54 15 00 00 00 01 00 02 38 01 15 00 00 00 01 00 02 39 5a 15 00 00 00 01 00 02 3a 01 15 00 00 00 01 00 02 3b 60 15 00 00 00 01 00 02 3d 01 15 00 00 00 01 00 02 3f 66 15 00 00 00 01 00 02 40 01 15 00 00 00 01 00 02 41 6b 15 00 00 00 01 00 02 42 01 15 00 00 00 01 00 02 43 71 15 00 00 00 01 00 02 44 01 15 00 00 00 01 00 02 45 76 15 00 00 00 01 00 02 46 01 15 00 00 00 01 00 02 47 8a 15 00 00 00 01 00 02 48 01 15 00 00 00 01 00 02 49 9d 15 00 00 00 01 00 02 4a 01 15 00 00 00 01 00 02 4b be 15 00 00 00 01 00 02 4c 01 15 00 00 00 01 00 02 4d dc 15 00 00 00 01 00 02 4e 02 15 00 00 00 01 00 02 4f 07 15 00 00 00 01 00 02 50 02 15 00 00 00 01 00 02 51 2d 15 00 00 00 01 00 02 52 02 15 00 00 00 01 00 02 53 2e 15 00 00 00 01 00 02 54 02 15 00 00 00 01 00 02 55 5c 15 00 00 00 01 00 02 56 02 15 00 00 00 01 00 02 58 97 15 00 00 00 01 00 02 59 02 15 00 00 00 01 00 02 5a c0 15 00 00 00 01 00 02 5b 02 15 00 00 00 01 00 02 5c f7 15 00 00 00 01 00 02 5d 03 15 00 00 00 01 00 02 5e 14 15 00 00 00 01 00 02 5f 03 15 00 00 00 01 00 02 60 4b 15 00 00 00 01 00 02 61 03 15 00 00 00 01 00 02 62 5c 15 00 00 00 01 00 02 63 03 15 00 00 00 01 00 02 64 6f 15 00 00 00 01 00 02 65 03 15 00 00 00 01 00 02 66 83 15 00 00 00 01 00 02 67 03 15 00 00 00 01 00 02 68 97 15 00 00 00 01 00 02 69 03 15 00 00 00 01 00 02 6a a6 15 00 00 00 01 00 02 6b 03 15 00 00 00 01 00 02 6c b1 15 00 00 00 01 00 02 6d 03 15 00 00 00 01 00 02 6e b6 15 00 00 00 01 00 02 6f 03 15 00 00 00 01 00 02 70 ff 15 00 00 00 01 00 02 71 01 15 00 00 00 01 00 02 72 b1 15 00 00 00 01 00 02 73 01 15 00 00 00 01 00 02 74 b3 15 00 00 00 01 00 02 75 01 15 00 00 00 01 00 02 76 b6 15 00 00 00 01 00 02 77 01 15 00 00 00 01 00 02 78 b9 15 00 00 00 01 00 02 79 01 15 00 00 00 01 00 02 7a bd 15 00 00 00 01 00 02 7b 01 15 00 00 00 01 00 02 7c c0 15 00 00 00 01 00 02 7d 01 15 00 00 00 01 00 02 7e c3 15 00 00 00 01 00 02 7f 01 15 00 00 00 01 00 02 80 c6 15 00 00 00 01 00 02 81 01 15 00 00 00 01 00 02 82 ca 15 00 00 00 01 00 02 83 01 15 00 00 00 01 00 02 84 d6 15 00 00 00 01 00 02 85 01 15 00 00 00 01 00 02 86 e2 15 00 00 00 01 00 02 87 01 15 00 00 00 01 00 02 88 f7 15 00 00 00 01 00 02 89 02 15 00 00 00 01 00 02 8a 06 15 00 00 00 01 00 02 8b 02 15 00 00 00 01 00 02 8c 25 15 00 00 00 01 00 02 8d 02 15 00 00 00 01 00 02 8e 48 15 00 00 00 01 00 02 8f 02 15 00 00 00 01 00 02 90 4a 15 00 00 00 01 00 02 91 02 15 00 00 00 01 00 02 92 75 15 00 00 00 01 00 02 93 02 15 00 00 00 01 00 02 94 b0 15 00 00 00 01 00 02 95 02 15 00 00 00 01 00 02 96 d8 15 00 00 00 01 00 02 97 03 15 00 00 00 01 00 02 98 09 15 00 00 00 01 00 02 99 03 15 00 00 00 01 00 02 9a 29 15 00 00 00 01 00 02 9b 03 15 00 00 00 01 00 02 9c 60 15 00 00 00 01 00 02 9d 03 15 00 00 00 01 00 02 9e 70 15 00 00 00 01 00 02 9f 03 15 00 00 00 01 00 02 a0 81 15 00 00 00 01 00 02 a2 03 15 00 00 00 01 00 02 a3 91 15 00 00 00 01 00 02 a4 03 15 00 00 00 01 00 02 a5 a0 15 00 00 00 01 00 02 a6 03 15 00 00 00 01 00 02 a7 ab 15 00 00 00 01 00 02 a9 03 15 00 00 00 01 00 02 aa b3 15 00 00 00 01 00 02 ab 03 15 00 00 00 01 00 02 ac b6 15 00 00 00 01 00 02 ad 03 15 00 00 00 01 00 02 ae ff 15 00 00 00 01 00 02 af 01 15 00 00 00 01 00 02 b0 b1 15 00 00 00 01 00 02 b1 01 15 00 00 00 01 00 02 b2 b3 15 00 00 00 01 00 02 b3 01 15 00 00 00 01 00 02 b4 b6 15 00 00 00 01 00 02 b5 01 15 00 00 00 01 00 02 b6 b9 15 00 00 00 01 00 02 b7 01 15 00 00 00 01 00 02 b8 bd 15 00 00 00 01 00 02 b9 01 15 00 00 00 01 00 02 ba c0 15 00 00 00 01 00 02 bb 01 15 00 00 00 01 00 02 bc c3 15 00 00 00 01 00 02 bd 01 15 00 00 00 01 00 02 be c6 15 00 00 00 01 00 02 bf 01 15 00 00 00 01 00 02 c0 ca 15 00 00 00 01 00 02 c1 01 15 00 00 00 01 00 02 c2 d6 15 00 00 00 01 00 02 c3 01 15 00 00 00 01 00 02 c4 e2 15 00 00 00 01 00 02 c5 01 15 00 00 00 01 00 02 c6 f7 15 00 00 00 01 00 02 c7 02 15 00 00 00 01 00 02 c8 06 15 00 00 00 01 00 02 c9 02 15 00 00 00 01 00 02 ca 25 15 00 00 00 01 00 02 cb 02 15 00 00 00 01 00 02 cc 48 15 00 00 00 01 00 02 cd 02 15 00 00 00 01 00 02 ce 4a 15 00 00 00 01 00 02 cf 02 15 00 00 00 01 00 02 d0 75 15 00 00 00 01 00 02 d1 02 15 00 00 00 01 00 02 d2 b0 15 00 00 00 01 00 02 d3 02 15 00 00 00 01 00 02 d4 d8 15 00 00 00 01 00 02 d5 03 15 00 00 00 01 00 02 d6 09 15 00 00 00 01 00 02 d7 03 15 00 00 00 01 00 02 d8 29 15 00 00 00 01 00 02 d9 03 15 00 00 00 01 00 02 da 60 15 00 00 00 01 00 02 db 03 15 00 00 00 01 00 02 dc 70 15 00 00 00 01 00 02 dd 03 15 00 00 00 01 00 02 de 81 15 00 00 00 01 00 02 df 03 15 00 00 00 01 00 02 e0 91 15 00 00 00 01 00 02 e1 03 15 00 00 00 01 00 02 e2 a0 15 00 00 00 01 00 02 e3 03 15 00 00 00 01 00 02 e4 ab 15 00 00 00 01 00 02 e5 03 15 00 00 00 01 00 02 e6 b3 15 00 00 00 01 00 02 e7 03 15 00 00 00 01 00 02 e8 b6 15 00 00 00 01 00 02 e9 03 15 00 00 00 01 00 02 ea ff 15 00 00 00 01 00 02 fb 01 15 01 00 00 01 00 02 ff 10];
        qcom,mdss-dsi-dispparam-papermode3-state = "dsi_hs_mode";
        qcom,mdss-dsi-dispparam-papermode4-command = [15 01 00 00 78 00 02 ff 20 15 00 00 00 01 00 02 fb 01 15 00 00 00 01 00 02 75 01 15 00 00 00 01 00 02 76 31 15 00 00 00 01 00 02 77 01 15 00 00 00 01 00 02 78 35 15 00 00 00 01 00 02 79 01 15 00 00 00 01 00 02 7a 3c 15 00 00 00 01 00 02 7b 01 15 00 00 00 01 00 02 7c 43 15 00 00 00 01 00 02 7d 01 15 00 00 00 01 00 02 7e 4a 15 00 00 00 01 00 02 7f 01 15 00 00 00 01 00 02 80 51 15 00 00 00 01 00 02 81 01 15 00 00 00 01 00 02 82 58 15 00 00 00 01 00 02 83 01 15 00 00 00 01 00 02 84 5e 15 00 00 00 01 00 02 85 01 15 00 00 00 01 00 02 86 64 15 00 00 00 01 00 02 87 01 15 00 00 00 01 00 02 88 7a 15 00 00 00 01 00 02 89 01 15 00 00 00 01 00 02 8a 8f 15 00 00 00 01 00 02 8b 01 15 00 00 00 01 00 02 8c b3 15 00 00 00 01 00 02 8d 01 15 00 00 00 01 00 02 8e d2 15 00 00 00 01 00 02 8f 02 15 00 00 00 01 00 02 90 03 15 00 00 00 01 00 02 91 02 15 00 00 00 01 00 02 92 28 15 00 00 00 01 00 02 93 02 15 00 00 00 01 00 02 94 2a 15 00 00 00 01 00 02 95 02 15 00 00 00 01 00 02 96 57 15 00 00 00 01 00 02 97 02 15 00 00 00 01 00 02 98 92 15 00 00 00 01 00 02 99 02 15 00 00 00 01 00 02 9a bb 15 00 00 00 01 00 02 9b 02 15 00 00 00 01 00 02 9c f2 15 00 00 00 01 00 02 9d 03 15 00 00 00 01 00 02 9e 11 15 00 00 00 01 00 02 9f 03 15 00 00 00 01 00 02 a0 4a 15 00 00 00 01 00 02 a2 03 15 00 00 00 01 00 02 a3 5d 15 00 00 00 01 00 02 a4 03 15 00 00 00 01 00 02 a5 70 15 00 00 00 01 00 02 a6 03 15 00 00 00 01 00 02 a7 83 15 00 00 00 01 00 02 a9 03 15 00 00 00 01 00 02 aa 96 15 00 00 00 01 00 02 ab 03 15 00 00 00 01 00 02 ac a6 15 00 00 00 01 00 02 ad 03 15 00 00 00 01 00 02 ae b1 15 00 00 00 01 00 02 af 03 15 00 00 00 01 00 02 b0 b6 15 00 00 00 01 00 02 b1 03 15 00 00 00 01 00 02 b2 ff 15 00 00 00 01 00 02 b3 01 15 00 00 00 01 00 02 b4 31 15 00 00 00 01 00 02 b5 01 15 00 00 00 01 00 02 b6 35 15 00 00 00 01 00 02 b7 01 15 00 00 00 01 00 02 b8 3c 15 00 00 00 01 00 02 b9 01 15 00 00 00 01 00 02 ba 43 15 00 00 00 01 00 02 bb 01 15 00 00 00 01 00 02 bc 4a 15 00 00 00 01 00 02 bd 01 15 00 00 00 01 00 02 be 51 15 00 00 00 01 00 02 bf 01 15 00 00 00 01 00 02 c0 58 15 00 00 00 01 00 02 c1 01 15 00 00 00 01 00 02 c2 5e 15 00 00 00 01 00 02 c3 01 15 00 00 00 01 00 02 c4 64 15 00 00 00 01 00 02 c5 01 15 00 00 00 01 00 02 c6 7a 15 00 00 00 01 00 02 c7 01 15 00 00 00 01 00 02 c8 8f 15 00 00 00 01 00 02 c9 01 15 00 00 00 01 00 02 ca b3 15 00 00 00 01 00 02 cb 01 15 00 00 00 01 00 02 cc d2 15 00 00 00 01 00 02 cd 02 15 00 00 00 01 00 02 ce 03 15 00 00 00 01 00 02 cf 02 15 00 00 00 01 00 02 d0 28 15 00 00 00 01 00 02 d1 02 15 00 00 00 01 00 02 d2 2a 15 00 00 00 01 00 02 d3 02 15 00 00 00 01 00 02 d4 57 15 00 00 00 01 00 02 d5 02 15 00 00 00 01 00 02 d6 92 15 00 00 00 01 00 02 d7 02 15 00 00 00 01 00 02 d8 bb 15 00 00 00 01 00 02 d9 02 15 00 00 00 01 00 02 da f2 15 00 00 00 01 00 02 db 03 15 00 00 00 01 00 02 dc 11 15 00 00 00 01 00 02 dd 03 15 00 00 00 01 00 02 de 4a 15 00 00 00 01 00 02 df 03 15 00 00 00 01 00 02 e0 5d 15 00 00 00 01 00 02 e1 03 15 00 00 00 01 00 02 e2 70 15 00 00 00 01 00 02 e3 03 15 00 00 00 01 00 02 e4 83 15 00 00 00 01 00 02 e5 03 15 00 00 00 01 00 02 e6 96 15 00 00 00 01 00 02 e7 03 15 00 00 00 01 00 02 e8 a6 15 00 00 00 01 00 02 e9 03 15 00 00 00 01 00 02 ea b1 15 00 00 00 01 00 02 eb 03 15 00 00 00 01 00 02 ec b6 15 00 00 00 01 00 02 ed 03 15 00 00 00 01 00 02 ee ff 15 00 00 00 01 00 02 ef 01 15 00 00 00 01 00 02 f0 4a 15 00 00 00 01 00 02 f1 01 15 00 00 00 01 00 02 f2 4d 15 00 00 00 01 00 02 f3 01 15 00 00 00 01 00 02 f4 54 15 00 00 00 01 00 02 f5 01 15 00 00 00 01 00 02 f6 5a 15 00 00 00 01 00 02 f7 01 15 00 00 00 01 00 02 f8 60 15 00 00 00 01 00 02 f9 01 15 00 00 00 01 00 02 fa 66 15 00 00 00 01 00 02 ff 21 15 00 00 00 01 00 02 fb 01 15 00 00 00 01 00 02 00 01 15 00 00 00 01 00 02 01 6b 15 00 00 00 01 00 02 02 01 15 00 00 00 01 00 02 03 71 15 00 00 00 01 00 02 04 01 15 00 00 00 01 00 02 05 76 15 00 00 00 01 00 02 06 01 15 00 00 00 01 00 02 07 8a 15 00 00 00 01 00 02 08 01 15 00 00 00 01 00 02 09 9d 15 00 00 00 01 00 02 0a 01 15 00 00 00 01 00 02 0b be 15 00 00 00 01 00 02 0c 01 15 00 00 00 01 00 02 0d dc 15 00 00 00 01 00 02 0e 02 15 00 00 00 01 00 02 0f 07 15 00 00 00 01 00 02 10 02 15 00 00 00 01 00 02 11 2d 15 00 00 00 01 00 02 12 02 15 00 00 00 01 00 02 13 2e 15 00 00 00 01 00 02 14 02 15 00 00 00 01 00 02 15 5c 15 00 00 00 01 00 02 16 02 15 00 00 00 01 00 02 17 97 15 00 00 00 01 00 02 18 02 15 00 00 00 01 00 02 19 c0 15 00 00 00 01 00 02 1a 02 15 00 00 00 01 00 02 1b f7 15 00 00 00 01 00 02 1c 03 15 00 00 00 01 00 02 1d 14 15 00 00 00 01 00 02 1e 03 15 00 00 00 01 00 02 1f 4b 15 00 00 00 01 00 02 20 03 15 00 00 00 01 00 02 21 5c 15 00 00 00 01 00 02 22 03 15 00 00 00 01 00 02 23 6f 15 00 00 00 01 00 02 24 03 15 00 00 00 01 00 02 25 83 15 00 00 00 01 00 02 26 03 15 00 00 00 01 00 02 27 97 15 00 00 00 01 00 02 28 03 15 00 00 00 01 00 02 29 a6 15 00 00 00 01 00 02 2a 03 15 00 00 00 01 00 02 2b b1 15 00 00 00 01 00 02 2d 03 15 00 00 00 01 00 02 2f b6 15 00 00 00 01 00 02 30 03 15 00 00 00 01 00 02 31 ff 15 00 00 00 01 00 02 32 01 15 00 00 00 01 00 02 33 4a 15 00 00 00 01 00 02 34 01 15 00 00 00 01 00 02 35 4d 15 00 00 00 01 00 02 36 01 15 00 00 00 01 00 02 37 54 15 00 00 00 01 00 02 38 01 15 00 00 00 01 00 02 39 5a 15 00 00 00 01 00 02 3a 01 15 00 00 00 01 00 02 3b 60 15 00 00 00 01 00 02 3d 01 15 00 00 00 01 00 02 3f 66 15 00 00 00 01 00 02 40 01 15 00 00 00 01 00 02 41 6b 15 00 00 00 01 00 02 42 01 15 00 00 00 01 00 02 43 71 15 00 00 00 01 00 02 44 01 15 00 00 00 01 00 02 45 76 15 00 00 00 01 00 02 46 01 15 00 00 00 01 00 02 47 8a 15 00 00 00 01 00 02 48 01 15 00 00 00 01 00 02 49 9d 15 00 00 00 01 00 02 4a 01 15 00 00 00 01 00 02 4b be 15 00 00 00 01 00 02 4c 01 15 00 00 00 01 00 02 4d dc 15 00 00 00 01 00 02 4e 02 15 00 00 00 01 00 02 4f 07 15 00 00 00 01 00 02 50 02 15 00 00 00 01 00 02 51 2d 15 00 00 00 01 00 02 52 02 15 00 00 00 01 00 02 53 2e 15 00 00 00 01 00 02 54 02 15 00 00 00 01 00 02 55 5c 15 00 00 00 01 00 02 56 02 15 00 00 00 01 00 02 58 97 15 00 00 00 01 00 02 59 02 15 00 00 00 01 00 02 5a c0 15 00 00 00 01 00 02 5b 02 15 00 00 00 01 00 02 5c f7 15 00 00 00 01 00 02 5d 03 15 00 00 00 01 00 02 5e 14 15 00 00 00 01 00 02 5f 03 15 00 00 00 01 00 02 60 4b 15 00 00 00 01 00 02 61 03 15 00 00 00 01 00 02 62 5c 15 00 00 00 01 00 02 63 03 15 00 00 00 01 00 02 64 6f 15 00 00 00 01 00 02 65 03 15 00 00 00 01 00 02 66 83 15 00 00 00 01 00 02 67 03 15 00 00 00 01 00 02 68 97 15 00 00 00 01 00 02 69 03 15 00 00 00 01 00 02 6a a6 15 00 00 00 01 00 02 6b 03 15 00 00 00 01 00 02 6c b1 15 00 00 00 01 00 02 6d 03 15 00 00 00 01 00 02 6e b6 15 00 00 00 01 00 02 6f 03 15 00 00 00 01 00 02 70 ff 15 00 00 00 01 00 02 71 01 15 00 00 00 01 00 02 72 c7 15 00 00 00 01 00 02 73 01 15 00 00 00 01 00 02 74 c9 15 00 00 00 01 00 02 75 01 15 00 00 00 01 00 02 76 cb 15 00 00 00 01 00 02 77 01 15 00 00 00 01 00 02 78 ce 15 00 00 00 01 00 02 79 01 15 00 00 00 01 00 02 7a d1 15 00 00 00 01 00 02 7b 01 15 00 00 00 01 00 02 7c d4 15 00 00 00 01 00 02 7d 01 15 00 00 00 01 00 02 7e d7 15 00 00 00 01 00 02 7f 01 15 00 00 00 01 00 02 80 da 15 00 00 00 01 00 02 81 01 15 00 00 00 01 00 02 82 dd 15 00 00 00 01 00 02 83 01 15 00 00 00 01 00 02 84 e8 15 00 00 00 01 00 02 85 01 15 00 00 00 01 00 02 86 f4 15 00 00 00 01 00 02 87 02 15 00 00 00 01 00 02 88 01 15 00 00 00 01 00 02 89 02 15 00 00 00 01 00 02 8a 0f 15 00 00 00 01 00 02 8b 02 15 00 00 00 01 00 02 8c 2d 15 00 00 00 01 00 02 8d 02 15 00 00 00 01 00 02 8e 50 15 00 00 00 01 00 02 8f 02 15 00 00 00 01 00 02 90 52 15 00 00 00 01 00 02 91 02 15 00 00 00 01 00 02 92 7c 15 00 00 00 01 00 02 93 02 15 00 00 00 01 00 02 94 b6 15 00 00 00 01 00 02 95 02 15 00 00 00 01 00 02 96 dd 15 00 00 00 01 00 02 97 03 15 00 00 00 01 00 02 98 0d 15 00 00 00 01 00 02 99 03 15 00 00 00 01 00 02 9a 32 15 00 00 00 01 00 02 9b 03 15 00 00 00 01 00 02 9c 6a 15 00 00 00 01 00 02 9d 03 15 00 00 00 01 00 02 9e 79 15 00 00 00 01 00 02 9f 03 15 00 00 00 01 00 02 a0 88 15 00 00 00 01 00 02 a2 03 15 00 00 00 01 00 02 a3 96 15 00 00 00 01 00 02 a4 03 15 00 00 00 01 00 02 a5 a3 15 00 00 00 01 00 02 a6 03 15 00 00 00 01 00 02 a7 ad 15 00 00 00 01 00 02 a9 03 15 00 00 00 01 00 02 aa b3 15 00 00 00 01 00 02 ab 03 15 00 00 00 01 00 02 ac b6 15 00 00 00 01 00 02 ad 03 15 00 00 00 01 00 02 ae ff 15 00 00 00 01 00 02 af 01 15 00 00 00 01 00 02 b0 c7 15 00 00 00 01 00 02 b1 01 15 00 00 00 01 00 02 b2 c9 15 00 00 00 01 00 02 b3 01 15 00 00 00 01 00 02 b4 cb 15 00 00 00 01 00 02 b5 01 15 00 00 00 01 00 02 b6 ce 15 00 00 00 01 00 02 b7 01 15 00 00 00 01 00 02 b8 d1 15 00 00 00 01 00 02 b9 01 15 00 00 00 01 00 02 ba d4 15 00 00 00 01 00 02 bb 01 15 00 00 00 01 00 02 bc d7 15 00 00 00 01 00 02 bd 01 15 00 00 00 01 00 02 be da 15 00 00 00 01 00 02 bf 01 15 00 00 00 01 00 02 c0 dd 15 00 00 00 01 00 02 c1 01 15 00 00 00 01 00 02 c2 e8 15 00 00 00 01 00 02 c3 01 15 00 00 00 01 00 02 c4 f4 15 00 00 00 01 00 02 c5 02 15 00 00 00 01 00 02 c6 01 15 00 00 00 01 00 02 c7 02 15 00 00 00 01 00 02 c8 0f 15 00 00 00 01 00 02 c9 02 15 00 00 00 01 00 02 ca 2d 15 00 00 00 01 00 02 cb 02 15 00 00 00 01 00 02 cc 50 15 00 00 00 01 00 02 cd 02 15 00 00 00 01 00 02 ce 52 15 00 00 00 01 00 02 cf 02 15 00 00 00 01 00 02 d0 7c 15 00 00 00 01 00 02 d1 02 15 00 00 00 01 00 02 d2 b6 15 00 00 00 01 00 02 d3 02 15 00 00 00 01 00 02 d4 dd 15 00 00 00 01 00 02 d5 03 15 00 00 00 01 00 02 d6 0d 15 00 00 00 01 00 02 d7 03 15 00 00 00 01 00 02 d8 32 15 00 00 00 01 00 02 d9 03 15 00 00 00 01 00 02 da 6a 15 00 00 00 01 00 02 db 03 15 00 00 00 01 00 02 dc 79 15 00 00 00 01 00 02 dd 03 15 00 00 00 01 00 02 de 88 15 00 00 00 01 00 02 df 03 15 00 00 00 01 00 02 e0 96 15 00 00 00 01 00 02 e1 03 15 00 00 00 01 00 02 e2 a3 15 00 00 00 01 00 02 e3 03 15 00 00 00 01 00 02 e4 ad 15 00 00 00 01 00 02 e5 03 15 00 00 00 01 00 02 e6 b3 15 00 00 00 01 00 02 e7 03 15 00 00 00 01 00 02 e8 b6 15 00 00 00 01 00 02 e9 03 15 00 00 00 01 00 02 ea ff 15 00 00 00 01 00 02 fb 01 15 01 00 00 01 00 02 ff 10];
        qcom,mdss-dsi-dispparam-papermode4-state = "dsi_hs_mode";
        qcom,mdss-dsi-dispparam-papermode5-command = [15 01 00 00 78 00 02 ff 20 15 00 00 00 01 00 02 fb 01 15 00 00 00 01 00 02 75 01 15 00 00 00 01 00 02 76 31 15 00 00 00 01 00 02 77 01 15 00 00 00 01 00 02 78 35 15 00 00 00 01 00 02 79 01 15 00 00 00 01 00 02 7a 3c 15 00 00 00 01 00 02 7b 01 15 00 00 00 01 00 02 7c 43 15 00 00 00 01 00 02 7d 01 15 00 00 00 01 00 02 7e 4a 15 00 00 00 01 00 02 7f 01 15 00 00 00 01 00 02 80 51 15 00 00 00 01 00 02 81 01 15 00 00 00 01 00 02 82 58 15 00 00 00 01 00 02 83 01 15 00 00 00 01 00 02 84 5e 15 00 00 00 01 00 02 85 01 15 00 00 00 01 00 02 86 64 15 00 00 00 01 00 02 87 01 15 00 00 00 01 00 02 88 7a 15 00 00 00 01 00 02 89 01 15 00 00 00 01 00 02 8a 8f 15 00 00 00 01 00 02 8b 01 15 00 00 00 01 00 02 8c b3 15 00 00 00 01 00 02 8d 01 15 00 00 00 01 00 02 8e d2 15 00 00 00 01 00 02 8f 02 15 00 00 00 01 00 02 90 03 15 00 00 00 01 00 02 91 02 15 00 00 00 01 00 02 92 28 15 00 00 00 01 00 02 93 02 15 00 00 00 01 00 02 94 2a 15 00 00 00 01 00 02 95 02 15 00 00 00 01 00 02 96 57 15 00 00 00 01 00 02 97 02 15 00 00 00 01 00 02 98 92 15 00 00 00 01 00 02 99 02 15 00 00 00 01 00 02 9a bb 15 00 00 00 01 00 02 9b 02 15 00 00 00 01 00 02 9c f2 15 00 00 00 01 00 02 9d 03 15 00 00 00 01 00 02 9e 11 15 00 00 00 01 00 02 9f 03 15 00 00 00 01 00 02 a0 4a 15 00 00 00 01 00 02 a2 03 15 00 00 00 01 00 02 a3 5d 15 00 00 00 01 00 02 a4 03 15 00 00 00 01 00 02 a5 70 15 00 00 00 01 00 02 a6 03 15 00 00 00 01 00 02 a7 83 15 00 00 00 01 00 02 a9 03 15 00 00 00 01 00 02 aa 96 15 00 00 00 01 00 02 ab 03 15 00 00 00 01 00 02 ac a6 15 00 00 00 01 00 02 ad 03 15 00 00 00 01 00 02 ae b1 15 00 00 00 01 00 02 af 03 15 00 00 00 01 00 02 b0 b6 15 00 00 00 01 00 02 b1 03 15 00 00 00 01 00 02 b2 ff 15 00 00 00 01 00 02 b3 01 15 00 00 00 01 00 02 b4 31 15 00 00 00 01 00 02 b5 01 15 00 00 00 01 00 02 b6 35 15 00 00 00 01 00 02 b7 01 15 00 00 00 01 00 02 b8 3c 15 00 00 00 01 00 02 b9 01 15 00 00 00 01 00 02 ba 43 15 00 00 00 01 00 02 bb 01 15 00 00 00 01 00 02 bc 4a 15 00 00 00 01 00 02 bd 01 15 00 00 00 01 00 02 be 51 15 00 00 00 01 00 02 bf 01 15 00 00 00 01 00 02 c0 58 15 00 00 00 01 00 02 c1 01 15 00 00 00 01 00 02 c2 5e 15 00 00 00 01 00 02 c3 01 15 00 00 00 01 00 02 c4 64 15 00 00 00 01 00 02 c5 01 15 00 00 00 01 00 02 c6 7a 15 00 00 00 01 00 02 c7 01 15 00 00 00 01 00 02 c8 8f 15 00 00 00 01 00 02 c9 01 15 00 00 00 01 00 02 ca b3 15 00 00 00 01 00 02 cb 01 15 00 00 00 01 00 02 cc d2 15 00 00 00 01 00 02 cd 02 15 00 00 00 01 00 02 ce 03 15 00 00 00 01 00 02 cf 02 15 00 00 00 01 00 02 d0 28 15 00 00 00 01 00 02 d1 02 15 00 00 00 01 00 02 d2 2a 15 00 00 00 01 00 02 d3 02 15 00 00 00 01 00 02 d4 57 15 00 00 00 01 00 02 d5 02 15 00 00 00 01 00 02 d6 92 15 00 00 00 01 00 02 d7 02 15 00 00 00 01 00 02 d8 bb 15 00 00 00 01 00 02 d9 02 15 00 00 00 01 00 02 da f2 15 00 00 00 01 00 02 db 03 15 00 00 00 01 00 02 dc 11 15 00 00 00 01 00 02 dd 03 15 00 00 00 01 00 02 de 4a 15 00 00 00 01 00 02 df 03 15 00 00 00 01 00 02 e0 5d 15 00 00 00 01 00 02 e1 03 15 00 00 00 01 00 02 e2 70 15 00 00 00 01 00 02 e3 03 15 00 00 00 01 00 02 e4 83 15 00 00 00 01 00 02 e5 03 15 00 00 00 01 00 02 e6 96 15 00 00 00 01 00 02 e7 03 15 00 00 00 01 00 02 e8 a6 15 00 00 00 01 00 02 e9 03 15 00 00 00 01 00 02 ea b1 15 00 00 00 01 00 02 eb 03 15 00 00 00 01 00 02 ec b6 15 00 00 00 01 00 02 ed 03 15 00 00 00 01 00 02 ee ff 15 00 00 00 01 00 02 ef 01 15 00 00 00 01 00 02 f0 4a 15 00 00 00 01 00 02 f1 01 15 00 00 00 01 00 02 f2 4d 15 00 00 00 01 00 02 f3 01 15 00 00 00 01 00 02 f4 54 15 00 00 00 01 00 02 f5 01 15 00 00 00 01 00 02 f6 5a 15 00 00 00 01 00 02 f7 01 15 00 00 00 01 00 02 f8 60 15 00 00 00 01 00 02 f9 01 15 00 00 00 01 00 02 fa 66 15 00 00 00 01 00 02 ff 21 15 00 00 00 01 00 02 fb 01 15 00 00 00 01 00 02 00 01 15 00 00 00 01 00 02 01 6b 15 00 00 00 01 00 02 02 01 15 00 00 00 01 00 02 03 71 15 00 00 00 01 00 02 04 01 15 00 00 00 01 00 02 05 76 15 00 00 00 01 00 02 06 01 15 00 00 00 01 00 02 07 8a 15 00 00 00 01 00 02 08 01 15 00 00 00 01 00 02 09 9d 15 00 00 00 01 00 02 0a 01 15 00 00 00 01 00 02 0b be 15 00 00 00 01 00 02 0c 01 15 00 00 00 01 00 02 0d dc 15 00 00 00 01 00 02 0e 02 15 00 00 00 01 00 02 0f 07 15 00 00 00 01 00 02 10 02 15 00 00 00 01 00 02 11 2d 15 00 00 00 01 00 02 12 02 15 00 00 00 01 00 02 13 2e 15 00 00 00 01 00 02 14 02 15 00 00 00 01 00 02 15 5c 15 00 00 00 01 00 02 16 02 15 00 00 00 01 00 02 17 97 15 00 00 00 01 00 02 18 02 15 00 00 00 01 00 02 19 c0 15 00 00 00 01 00 02 1a 02 15 00 00 00 01 00 02 1b f7 15 00 00 00 01 00 02 1c 03 15 00 00 00 01 00 02 1d 14 15 00 00 00 01 00 02 1e 03 15 00 00 00 01 00 02 1f 4b 15 00 00 00 01 00 02 20 03 15 00 00 00 01 00 02 21 5c 15 00 00 00 01 00 02 22 03 15 00 00 00 01 00 02 23 6f 15 00 00 00 01 00 02 24 03 15 00 00 00 01 00 02 25 83 15 00 00 00 01 00 02 26 03 15 00 00 00 01 00 02 27 97 15 00 00 00 01 00 02 28 03 15 00 00 00 01 00 02 29 a6 15 00 00 00 01 00 02 2a 03 15 00 00 00 01 00 02 2b b1 15 00 00 00 01 00 02 2d 03 15 00 00 00 01 00 02 2f b6 15 00 00 00 01 00 02 30 03 15 00 00 00 01 00 02 31 ff 15 00 00 00 01 00 02 32 01 15 00 00 00 01 00 02 33 4a 15 00 00 00 01 00 02 34 01 15 00 00 00 01 00 02 35 4d 15 00 00 00 01 00 02 36 01 15 00 00 00 01 00 02 37 54 15 00 00 00 01 00 02 38 01 15 00 00 00 01 00 02 39 5a 15 00 00 00 01 00 02 3a 01 15 00 00 00 01 00 02 3b 60 15 00 00 00 01 00 02 3d 01 15 00 00 00 01 00 02 3f 66 15 00 00 00 01 00 02 40 01 15 00 00 00 01 00 02 41 6b 15 00 00 00 01 00 02 42 01 15 00 00 00 01 00 02 43 71 15 00 00 00 01 00 02 44 01 15 00 00 00 01 00 02 45 76 15 00 00 00 01 00 02 46 01 15 00 00 00 01 00 02 47 8a 15 00 00 00 01 00 02 48 01 15 00 00 00 01 00 02 49 9d 15 00 00 00 01 00 02 4a 01 15 00 00 00 01 00 02 4b be 15 00 00 00 01 00 02 4c 01 15 00 00 00 01 00 02 4d dc 15 00 00 00 01 00 02 4e 02 15 00 00 00 01 00 02 4f 07 15 00 00 00 01 00 02 50 02 15 00 00 00 01 00 02 51 2d 15 00 00 00 01 00 02 52 02 15 00 00 00 01 00 02 53 2e 15 00 00 00 01 00 02 54 02 15 00 00 00 01 00 02 55 5c 15 00 00 00 01 00 02 56 02 15 00 00 00 01 00 02 58 97 15 00 00 00 01 00 02 59 02 15 00 00 00 01 00 02 5a c0 15 00 00 00 01 00 02 5b 02 15 00 00 00 01 00 02 5c f7 15 00 00 00 01 00 02 5d 03 15 00 00 00 01 00 02 5e 14 15 00 00 00 01 00 02 5f 03 15 00 00 00 01 00 02 60 4b 15 00 00 00 01 00 02 61 03 15 00 00 00 01 00 02 62 5c 15 00 00 00 01 00 02 63 03 15 00 00 00 01 00 02 64 6f 15 00 00 00 01 00 02 65 03 15 00 00 00 01 00 02 66 83 15 00 00 00 01 00 02 67 03 15 00 00 00 01 00 02 68 97 15 00 00 00 01 00 02 69 03 15 00 00 00 01 00 02 6a a6 15 00 00 00 01 00 02 6b 03 15 00 00 00 01 00 02 6c b1 15 00 00 00 01 00 02 6d 03 15 00 00 00 01 00 02 6e b6 15 00 00 00 01 00 02 6f 03 15 00 00 00 01 00 02 70 ff 15 00 00 00 01 00 02 71 01 15 00 00 00 01 00 02 72 d7 15 00 00 00 01 00 02 73 01 15 00 00 00 01 00 02 74 d8 15 00 00 00 01 00 02 75 01 15 00 00 00 01 00 02 76 db 15 00 00 00 01 00 02 77 01 15 00 00 00 01 00 02 78 de 15 00 00 00 01 00 02 79 01 15 00 00 00 01 00 02 7a e1 15 00 00 00 01 00 02 7b 01 15 00 00 00 01 00 02 7c e3 15 00 00 00 01 00 02 7d 01 15 00 00 00 01 00 02 7e e6 15 00 00 00 01 00 02 7f 01 15 00 00 00 01 00 02 80 e9 15 00 00 00 01 00 02 81 01 15 00 00 00 01 00 02 82 ec 15 00 00 00 01 00 02 83 01 15 00 00 00 01 00 02 84 f5 15 00 00 00 01 00 02 85 01 15 00 00 00 01 00 02 86 fc 15 00 00 00 01 00 02 87 02 15 00 00 00 01 00 02 88 09 15 00 00 00 01 00 02 89 02 15 00 00 00 01 00 02 8a 17 15 00 00 00 01 00 02 8b 02 15 00 00 00 01 00 02 8c 35 15 00 00 00 01 00 02 8d 02 15 00 00 00 01 00 02 8e 58 15 00 00 00 01 00 02 8f 02 15 00 00 00 01 00 02 90 59 15 00 00 00 01 00 02 91 02 15 00 00 00 01 00 02 92 84 15 00 00 00 01 00 02 93 02 15 00 00 00 01 00 02 94 be 15 00 00 00 01 00 02 95 02 15 00 00 00 01 00 02 96 e4 15 00 00 00 01 00 02 97 03 15 00 00 00 01 00 02 98 10 15 00 00 00 01 00 02 99 03 15 00 00 00 01 00 02 9a 32 15 00 00 00 01 00 02 9b 03 15 00 00 00 01 00 02 9c 60 15 00 00 00 01 00 02 9d 03 15 00 00 00 01 00 02 9e 6e 15 00 00 00 01 00 02 9f 03 15 00 00 00 01 00 02 a0 7d 15 00 00 00 01 00 02 a2 03 15 00 00 00 01 00 02 a3 8f 15 00 00 00 01 00 02 a4 03 15 00 00 00 01 00 02 a5 a2 15 00 00 00 01 00 02 a6 03 15 00 00 00 01 00 02 a7 b5 15 00 00 00 01 00 02 a9 03 15 00 00 00 01 00 02 aa c4 15 00 00 00 01 00 02 ab 03 15 00 00 00 01 00 02 ac cc 15 00 00 00 01 00 02 ad 03 15 00 00 00 01 00 02 ae ff 15 00 00 00 01 00 02 af 01 15 00 00 00 01 00 02 b0 d7 15 00 00 00 01 00 02 b1 01 15 00 00 00 01 00 02 b2 d8 15 00 00 00 01 00 02 b3 01 15 00 00 00 01 00 02 b4 db 15 00 00 00 01 00 02 b5 01 15 00 00 00 01 00 02 b6 de 15 00 00 00 01 00 02 b7 01 15 00 00 00 01 00 02 b8 e1 15 00 00 00 01 00 02 b9 01 15 00 00 00 01 00 02 ba e3 15 00 00 00 01 00 02 bb 01 15 00 00 00 01 00 02 bc e6 15 00 00 00 01 00 02 bd 01 15 00 00 00 01 00 02 be e9 15 00 00 00 01 00 02 bf 01 15 00 00 00 01 00 02 c0 ec 15 00 00 00 01 00 02 c1 01 15 00 00 00 01 00 02 c2 f5 15 00 00 00 01 00 02 c3 01 15 00 00 00 01 00 02 c4 fc 15 00 00 00 01 00 02 c5 02 15 00 00 00 01 00 02 c6 09 15 00 00 00 01 00 02 c7 02 15 00 00 00 01 00 02 c8 17 15 00 00 00 01 00 02 c9 02 15 00 00 00 01 00 02 ca 35 15 00 00 00 01 00 02 cb 02 15 00 00 00 01 00 02 cc 58 15 00 00 00 01 00 02 cd 02 15 00 00 00 01 00 02 ce 59 15 00 00 00 01 00 02 cf 02 15 00 00 00 01 00 02 d0 84 15 00 00 00 01 00 02 d1 02 15 00 00 00 01 00 02 d2 be 15 00 00 00 01 00 02 d3 02 15 00 00 00 01 00 02 d4 e4 15 00 00 00 01 00 02 d5 03 15 00 00 00 01 00 02 d6 10 15 00 00 00 01 00 02 d7 03 15 00 00 00 01 00 02 d8 32 15 00 00 00 01 00 02 d9 03 15 00 00 00 01 00 02 da 60 15 00 00 00 01 00 02 db 03 15 00 00 00 01 00 02 dc 6e 15 00 00 00 01 00 02 dd 03 15 00 00 00 01 00 02 de 7d 15 00 00 00 01 00 02 df 03 15 00 00 00 01 00 02 e0 8f 15 00 00 00 01 00 02 e1 03 15 00 00 00 01 00 02 e2 a2 15 00 00 00 01 00 02 e3 03 15 00 00 00 01 00 02 e4 b5 15 00 00 00 01 00 02 e5 03 15 00 00 00 01 00 02 e6 c4 15 00 00 00 01 00 02 e7 03 15 00 00 00 01 00 02 e8 cc 15 00 00 00 01 00 02 e9 03 15 00 00 00 01 00 02 ea ff 15 00 00 00 01 00 02 fb 01 15 01 00 00 01 00 02 ff 10];
        qcom,mdss-dsi-dispparam-papermode5-state = "dsi_hs_mode";
        qcom,mdss-dsi-dispparam-papermode6-command = [15 01 00 00 78 00 02 ff 20 15 00 00 00 01 00 02 fb 01 15 00 00 00 01 00 02 75 01 15 00 00 00 01 00 02 76 31 15 00 00 00 01 00 02 77 01 15 00 00 00 01 00 02 78 35 15 00 00 00 01 00 02 79 01 15 00 00 00 01 00 02 7a 3c 15 00 00 00 01 00 02 7b 01 15 00 00 00 01 00 02 7c 43 15 00 00 00 01 00 02 7d 01 15 00 00 00 01 00 02 7e 4a 15 00 00 00 01 00 02 7f 01 15 00 00 00 01 00 02 80 51 15 00 00 00 01 00 02 81 01 15 00 00 00 01 00 02 82 58 15 00 00 00 01 00 02 83 01 15 00 00 00 01 00 02 84 5e 15 00 00 00 01 00 02 85 01 15 00 00 00 01 00 02 86 64 15 00 00 00 01 00 02 87 01 15 00 00 00 01 00 02 88 7a 15 00 00 00 01 00 02 89 01 15 00 00 00 01 00 02 8a 8f 15 00 00 00 01 00 02 8b 01 15 00 00 00 01 00 02 8c b3 15 00 00 00 01 00 02 8d 01 15 00 00 00 01 00 02 8e d2 15 00 00 00 01 00 02 8f 02 15 00 00 00 01 00 02 90 03 15 00 00 00 01 00 02 91 02 15 00 00 00 01 00 02 92 28 15 00 00 00 01 00 02 93 02 15 00 00 00 01 00 02 94 2a 15 00 00 00 01 00 02 95 02 15 00 00 00 01 00 02 96 57 15 00 00 00 01 00 02 97 02 15 00 00 00 01 00 02 98 92 15 00 00 00 01 00 02 99 02 15 00 00 00 01 00 02 9a bb 15 00 00 00 01 00 02 9b 02 15 00 00 00 01 00 02 9c f2 15 00 00 00 01 00 02 9d 03 15 00 00 00 01 00 02 9e 11 15 00 00 00 01 00 02 9f 03 15 00 00 00 01 00 02 a0 4a 15 00 00 00 01 00 02 a2 03 15 00 00 00 01 00 02 a3 5d 15 00 00 00 01 00 02 a4 03 15 00 00 00 01 00 02 a5 70 15 00 00 00 01 00 02 a6 03 15 00 00 00 01 00 02 a7 83 15 00 00 00 01 00 02 a9 03 15 00 00 00 01 00 02 aa 96 15 00 00 00 01 00 02 ab 03 15 00 00 00 01 00 02 ac a6 15 00 00 00 01 00 02 ad 03 15 00 00 00 01 00 02 ae b1 15 00 00 00 01 00 02 af 03 15 00 00 00 01 00 02 b0 b6 15 00 00 00 01 00 02 b1 03 15 00 00 00 01 00 02 b2 ff 15 00 00 00 01 00 02 b3 01 15 00 00 00 01 00 02 b4 31 15 00 00 00 01 00 02 b5 01 15 00 00 00 01 00 02 b6 35 15 00 00 00 01 00 02 b7 01 15 00 00 00 01 00 02 b8 3c 15 00 00 00 01 00 02 b9 01 15 00 00 00 01 00 02 ba 43 15 00 00 00 01 00 02 bb 01 15 00 00 00 01 00 02 bc 4a 15 00 00 00 01 00 02 bd 01 15 00 00 00 01 00 02 be 51 15 00 00 00 01 00 02 bf 01 15 00 00 00 01 00 02 c0 58 15 00 00 00 01 00 02 c1 01 15 00 00 00 01 00 02 c2 5e 15 00 00 00 01 00 02 c3 01 15 00 00 00 01 00 02 c4 64 15 00 00 00 01 00 02 c5 01 15 00 00 00 01 00 02 c6 7a 15 00 00 00 01 00 02 c7 01 15 00 00 00 01 00 02 c8 8f 15 00 00 00 01 00 02 c9 01 15 00 00 00 01 00 02 ca b3 15 00 00 00 01 00 02 cb 01 15 00 00 00 01 00 02 cc d2 15 00 00 00 01 00 02 cd 02 15 00 00 00 01 00 02 ce 03 15 00 00 00 01 00 02 cf 02 15 00 00 00 01 00 02 d0 28 15 00 00 00 01 00 02 d1 02 15 00 00 00 01 00 02 d2 2a 15 00 00 00 01 00 02 d3 02 15 00 00 00 01 00 02 d4 57 15 00 00 00 01 00 02 d5 02 15 00 00 00 01 00 02 d6 92 15 00 00 00 01 00 02 d7 02 15 00 00 00 01 00 02 d8 bb 15 00 00 00 01 00 02 d9 02 15 00 00 00 01 00 02 da f2 15 00 00 00 01 00 02 db 03 15 00 00 00 01 00 02 dc 11 15 00 00 00 01 00 02 dd 03 15 00 00 00 01 00 02 de 4a 15 00 00 00 01 00 02 df 03 15 00 00 00 01 00 02 e0 5d 15 00 00 00 01 00 02 e1 03 15 00 00 00 01 00 02 e2 70 15 00 00 00 01 00 02 e3 03 15 00 00 00 01 00 02 e4 83 15 00 00 00 01 00 02 e5 03 15 00 00 00 01 00 02 e6 96 15 00 00 00 01 00 02 e7 03 15 00 00 00 01 00 02 e8 a6 15 00 00 00 01 00 02 e9 03 15 00 00 00 01 00 02 ea b1 15 00 00 00 01 00 02 eb 03 15 00 00 00 01 00 02 ec b6 15 00 00 00 01 00 02 ed 03 15 00 00 00 01 00 02 ee ff 15 00 00 00 01 00 02 ef 01 15 00 00 00 01 00 02 f0 4a 15 00 00 00 01 00 02 f1 01 15 00 00 00 01 00 02 f2 4d 15 00 00 00 01 00 02 f3 01 15 00 00 00 01 00 02 f4 54 15 00 00 00 01 00 02 f5 01 15 00 00 00 01 00 02 f6 5a 15 00 00 00 01 00 02 f7 01 15 00 00 00 01 00 02 f8 60 15 00 00 00 01 00 02 f9 01 15 00 00 00 01 00 02 fa 66 15 00 00 00 01 00 02 ff 21 15 00 00 00 01 00 02 fb 01 15 00 00 00 01 00 02 00 01 15 00 00 00 01 00 02 01 6b 15 00 00 00 01 00 02 02 01 15 00 00 00 01 00 02 03 71 15 00 00 00 01 00 02 04 01 15 00 00 00 01 00 02 05 76 15 00 00 00 01 00 02 06 01 15 00 00 00 01 00 02 07 8a 15 00 00 00 01 00 02 08 01 15 00 00 00 01 00 02 09 9d 15 00 00 00 01 00 02 0a 01 15 00 00 00 01 00 02 0b be 15 00 00 00 01 00 02 0c 01 15 00 00 00 01 00 02 0d dc 15 00 00 00 01 00 02 0e 02 15 00 00 00 01 00 02 0f 07 15 00 00 00 01 00 02 10 02 15 00 00 00 01 00 02 11 2d 15 00 00 00 01 00 02 12 02 15 00 00 00 01 00 02 13 2e 15 00 00 00 01 00 02 14 02 15 00 00 00 01 00 02 15 5c 15 00 00 00 01 00 02 16 02 15 00 00 00 01 00 02 17 97 15 00 00 00 01 00 02 18 02 15 00 00 00 01 00 02 19 c0 15 00 00 00 01 00 02 1a 02 15 00 00 00 01 00 02 1b f7 15 00 00 00 01 00 02 1c 03 15 00 00 00 01 00 02 1d 14 15 00 00 00 01 00 02 1e 03 15 00 00 00 01 00 02 1f 4b 15 00 00 00 01 00 02 20 03 15 00 00 00 01 00 02 21 5c 15 00 00 00 01 00 02 22 03 15 00 00 00 01 00 02 23 6f 15 00 00 00 01 00 02 24 03 15 00 00 00 01 00 02 25 83 15 00 00 00 01 00 02 26 03 15 00 00 00 01 00 02 27 97 15 00 00 00 01 00 02 28 03 15 00 00 00 01 00 02 29 a6 15 00 00 00 01 00 02 2a 03 15 00 00 00 01 00 02 2b b1 15 00 00 00 01 00 02 2d 03 15 00 00 00 01 00 02 2f b6 15 00 00 00 01 00 02 30 03 15 00 00 00 01 00 02 31 ff 15 00 00 00 01 00 02 32 01 15 00 00 00 01 00 02 33 4a 15 00 00 00 01 00 02 34 01 15 00 00 00 01 00 02 35 4d 15 00 00 00 01 00 02 36 01 15 00 00 00 01 00 02 37 54 15 00 00 00 01 00 02 38 01 15 00 00 00 01 00 02 39 5a 15 00 00 00 01 00 02 3a 01 15 00 00 00 01 00 02 3b 60 15 00 00 00 01 00 02 3d 01 15 00 00 00 01 00 02 3f 66 15 00 00 00 01 00 02 40 01 15 00 00 00 01 00 02 41 6b 15 00 00 00 01 00 02 42 01 15 00 00 00 01 00 02 43 71 15 00 00 00 01 00 02 44 01 15 00 00 00 01 00 02 45 76 15 00 00 00 01 00 02 46 01 15 00 00 00 01 00 02 47 8a 15 00 00 00 01 00 02 48 01 15 00 00 00 01 00 02 49 9d 15 00 00 00 01 00 02 4a 01 15 00 00 00 01 00 02 4b be 15 00 00 00 01 00 02 4c 01 15 00 00 00 01 00 02 4d dc 15 00 00 00 01 00 02 4e 02 15 00 00 00 01 00 02 4f 07 15 00 00 00 01 00 02 50 02 15 00 00 00 01 00 02 51 2d 15 00 00 00 01 00 02 52 02 15 00 00 00 01 00 02 53 2e 15 00 00 00 01 00 02 54 02 15 00 00 00 01 00 02 55 5c 15 00 00 00 01 00 02 56 02 15 00 00 00 01 00 02 58 97 15 00 00 00 01 00 02 59 02 15 00 00 00 01 00 02 5a c0 15 00 00 00 01 00 02 5b 02 15 00 00 00 01 00 02 5c f7 15 00 00 00 01 00 02 5d 03 15 00 00 00 01 00 02 5e 14 15 00 00 00 01 00 02 5f 03 15 00 00 00 01 00 02 60 4b 15 00 00 00 01 00 02 61 03 15 00 00 00 01 00 02 62 5c 15 00 00 00 01 00 02 63 03 15 00 00 00 01 00 02 64 6f 15 00 00 00 01 00 02 65 03 15 00 00 00 01 00 02 66 83 15 00 00 00 01 00 02 67 03 15 00 00 00 01 00 02 68 97 15 00 00 00 01 00 02 69 03 15 00 00 00 01 00 02 6a a6 15 00 00 00 01 00 02 6b 03 15 00 00 00 01 00 02 6c b1 15 00 00 00 01 00 02 6d 03 15 00 00 00 01 00 02 6e b6 15 00 00 00 01 00 02 6f 03 15 00 00 00 01 00 02 70 ff 15 00 00 00 01 00 02 71 01 15 00 00 00 01 00 02 72 ef 15 00 00 00 01 00 02 73 01 15 00 00 00 01 00 02 74 f0 15 00 00 00 01 00 02 75 01 15 00 00 00 01 00 02 76 f3 15 00 00 00 01 00 02 77 01 15 00 00 00 01 00 02 78 f5 15 00 00 00 01 00 02 79 01 15 00 00 00 01 00 02 7a f6 15 00 00 00 01 00 02 7b 01 15 00 00 00 01 00 02 7c f7 15 00 00 00 01 00 02 7d 01 15 00 00 00 01 00 02 7e f9 15 00 00 00 01 00 02 7f 01 15 00 00 00 01 00 02 80 fa 15 00 00 00 01 00 02 81 01 15 00 00 00 01 00 02 82 fc 15 00 00 00 01 00 02 83 02 15 00 00 00 01 00 02 84 02 15 00 00 00 01 00 02 85 02 15 00 00 00 01 00 02 86 08 15 00 00 00 01 00 02 87 02 15 00 00 00 01 00 02 88 15 15 00 00 00 01 00 02 89 02 15 00 00 00 01 00 02 8a 22 15 00 00 00 01 00 02 8b 02 15 00 00 00 01 00 02 8c 40 15 00 00 00 01 00 02 8d 02 15 00 00 00 01 00 02 8e 62 15 00 00 00 01 00 02 8f 02 15 00 00 00 01 00 02 90 63 15 00 00 00 01 00 02 91 02 15 00 00 00 01 00 02 92 8d 15 00 00 00 01 00 02 93 02 15 00 00 00 01 00 02 94 c7 15 00 00 00 01 00 02 95 02 15 00 00 00 01 00 02 96 ee 15 00 00 00 01 00 02 97 03 15 00 00 00 01 00 02 98 18 15 00 00 00 01 00 02 99 03 15 00 00 00 01 00 02 9a 40 15 00 00 00 01 00 02 9b 03 15 00 00 00 01 00 02 9c 73 15 00 00 00 01 00 02 9d 03 15 00 00 00 01 00 02 9e 81 15 00 00 00 01 00 02 9f 03 15 00 00 00 01 00 02 a0 8f 15 00 00 00 01 00 02 a2 03 15 00 00 00 01 00 02 a3 9c 15 00 00 00 01 00 02 a4 03 15 00 00 00 01 00 02 a5 a7 15 00 00 00 01 00 02 a6 03 15 00 00 00 01 00 02 a7 af 15 00 00 00 01 00 02 a9 03 15 00 00 00 01 00 02 aa b4 15 00 00 00 01 00 02 ab 03 15 00 00 00 01 00 02 ac b6 15 00 00 00 01 00 02 ad 03 15 00 00 00 01 00 02 ae ff 15 00 00 00 01 00 02 af 01 15 00 00 00 01 00 02 b0 ef 15 00 00 00 01 00 02 b1 01 15 00 00 00 01 00 02 b2 f0 15 00 00 00 01 00 02 b3 01 15 00 00 00 01 00 02 b4 f3 15 00 00 00 01 00 02 b5 01 15 00 00 00 01 00 02 b6 f5 15 00 00 00 01 00 02 b7 01 15 00 00 00 01 00 02 b8 f6 15 00 00 00 01 00 02 b9 01 15 00 00 00 01 00 02 ba f7 15 00 00 00 01 00 02 bb 01 15 00 00 00 01 00 02 bc f9 15 00 00 00 01 00 02 bd 01 15 00 00 00 01 00 02 be fa 15 00 00 00 01 00 02 bf 01 15 00 00 00 01 00 02 c0 fc 15 00 00 00 01 00 02 c1 02 15 00 00 00 01 00 02 c2 02 15 00 00 00 01 00 02 c3 02 15 00 00 00 01 00 02 c4 08 15 00 00 00 01 00 02 c5 02 15 00 00 00 01 00 02 c6 15 15 00 00 00 01 00 02 c7 02 15 00 00 00 01 00 02 c8 22 15 00 00 00 01 00 02 c9 02 15 00 00 00 01 00 02 ca 40 15 00 00 00 01 00 02 cb 02 15 00 00 00 01 00 02 cc 62 15 00 00 00 01 00 02 cd 02 15 00 00 00 01 00 02 ce 63 15 00 00 00 01 00 02 cf 02 15 00 00 00 01 00 02 d0 8d 15 00 00 00 01 00 02 d1 02 15 00 00 00 01 00 02 d2 c7 15 00 00 00 01 00 02 d3 02 15 00 00 00 01 00 02 d4 ee 15 00 00 00 01 00 02 d5 03 15 00 00 00 01 00 02 d6 18 15 00 00 00 01 00 02 d7 03 15 00 00 00 01 00 02 d8 40 15 00 00 00 01 00 02 d9 03 15 00 00 00 01 00 02 da 73 15 00 00 00 01 00 02 db 03 15 00 00 00 01 00 02 dc 81 15 00 00 00 01 00 02 dd 03 15 00 00 00 01 00 02 de 8f 15 00 00 00 01 00 02 df 03 15 00 00 00 01 00 02 e0 9c 15 00 00 00 01 00 02 e1 03 15 00 00 00 01 00 02 e2 a7 15 00 00 00 01 00 02 e3 03 15 00 00 00 01 00 02 e4 af 15 00 00 00 01 00 02 e5 03 15 00 00 00 01 00 02 e6 b4 15 00 00 00 01 00 02 e7 03 15 00 00 00 01 00 02 e8 b6 15 00 00 00 01 00 02 e9 03 15 00 00 00 01 00 02 ea ff 15 00 00 00 01 00 02 fb 01 15 01 00 00 01 00 02 ff 10];
        qcom,mdss-dsi-dispparam-papermode6-state = "dsi_hs_mode";
        qcom,mdss-dsi-dispparam-papermode7-command = [15 01 00 00 78 00 02 ff 20 15 00 00 00 01 00 02 fb 01 15 00 00 00 01 00 02 75 01 15 00 00 00 01 00 02 76 31 15 00 00 00 01 00 02 77 01 15 00 00 00 01 00 02 78 35 15 00 00 00 01 00 02 79 01 15 00 00 00 01 00 02 7a 3c 15 00 00 00 01 00 02 7b 01 15 00 00 00 01 00 02 7c 43 15 00 00 00 01 00 02 7d 01 15 00 00 00 01 00 02 7e 4a 15 00 00 00 01 00 02 7f 01 15 00 00 00 01 00 02 80 51 15 00 00 00 01 00 02 81 01 15 00 00 00 01 00 02 82 58 15 00 00 00 01 00 02 83 01 15 00 00 00 01 00 02 84 5e 15 00 00 00 01 00 02 85 01 15 00 00 00 01 00 02 86 64 15 00 00 00 01 00 02 87 01 15 00 00 00 01 00 02 88 7a 15 00 00 00 01 00 02 89 01 15 00 00 00 01 00 02 8a 8f 15 00 00 00 01 00 02 8b 01 15 00 00 00 01 00 02 8c b3 15 00 00 00 01 00 02 8d 01 15 00 00 00 01 00 02 8e d2 15 00 00 00 01 00 02 8f 02 15 00 00 00 01 00 02 90 03 15 00 00 00 01 00 02 91 02 15 00 00 00 01 00 02 92 28 15 00 00 00 01 00 02 93 02 15 00 00 00 01 00 02 94 2a 15 00 00 00 01 00 02 95 02 15 00 00 00 01 00 02 96 57 15 00 00 00 01 00 02 97 02 15 00 00 00 01 00 02 98 92 15 00 00 00 01 00 02 99 02 15 00 00 00 01 00 02 9a bb 15 00 00 00 01 00 02 9b 02 15 00 00 00 01 00 02 9c f2 15 00 00 00 01 00 02 9d 03 15 00 00 00 01 00 02 9e 11 15 00 00 00 01 00 02 9f 03 15 00 00 00 01 00 02 a0 4a 15 00 00 00 01 00 02 a2 03 15 00 00 00 01 00 02 a3 5d 15 00 00 00 01 00 02 a4 03 15 00 00 00 01 00 02 a5 70 15 00 00 00 01 00 02 a6 03 15 00 00 00 01 00 02 a7 83 15 00 00 00 01 00 02 a9 03 15 00 00 00 01 00 02 aa 96 15 00 00 00 01 00 02 ab 03 15 00 00 00 01 00 02 ac a6 15 00 00 00 01 00 02 ad 03 15 00 00 00 01 00 02 ae b1 15 00 00 00 01 00 02 af 03 15 00 00 00 01 00 02 b0 b6 15 00 00 00 01 00 02 b1 03 15 00 00 00 01 00 02 b2 ff 15 00 00 00 01 00 02 b3 01 15 00 00 00 01 00 02 b4 31 15 00 00 00 01 00 02 b5 01 15 00 00 00 01 00 02 b6 35 15 00 00 00 01 00 02 b7 01 15 00 00 00 01 00 02 b8 3c 15 00 00 00 01 00 02 b9 01 15 00 00 00 01 00 02 ba 43 15 00 00 00 01 00 02 bb 01 15 00 00 00 01 00 02 bc 4a 15 00 00 00 01 00 02 bd 01 15 00 00 00 01 00 02 be 51 15 00 00 00 01 00 02 bf 01 15 00 00 00 01 00 02 c0 58 15 00 00 00 01 00 02 c1 01 15 00 00 00 01 00 02 c2 5e 15 00 00 00 01 00 02 c3 01 15 00 00 00 01 00 02 c4 64 15 00 00 00 01 00 02 c5 01 15 00 00 00 01 00 02 c6 7a 15 00 00 00 01 00 02 c7 01 15 00 00 00 01 00 02 c8 8f 15 00 00 00 01 00 02 c9 01 15 00 00 00 01 00 02 ca b3 15 00 00 00 01 00 02 cb 01 15 00 00 00 01 00 02 cc d2 15 00 00 00 01 00 02 cd 02 15 00 00 00 01 00 02 ce 03 15 00 00 00 01 00 02 cf 02 15 00 00 00 01 00 02 d0 28 15 00 00 00 01 00 02 d1 02 15 00 00 00 01 00 02 d2 2a 15 00 00 00 01 00 02 d3 02 15 00 00 00 01 00 02 d4 57 15 00 00 00 01 00 02 d5 02 15 00 00 00 01 00 02 d6 92 15 00 00 00 01 00 02 d7 02 15 00 00 00 01 00 02 d8 bb 15 00 00 00 01 00 02 d9 02 15 00 00 00 01 00 02 da f2 15 00 00 00 01 00 02 db 03 15 00 00 00 01 00 02 dc 11 15 00 00 00 01 00 02 dd 03 15 00 00 00 01 00 02 de 4a 15 00 00 00 01 00 02 df 03 15 00 00 00 01 00 02 e0 5d 15 00 00 00 01 00 02 e1 03 15 00 00 00 01 00 02 e2 70 15 00 00 00 01 00 02 e3 03 15 00 00 00 01 00 02 e4 83 15 00 00 00 01 00 02 e5 03 15 00 00 00 01 00 02 e6 96 15 00 00 00 01 00 02 e7 03 15 00 00 00 01 00 02 e8 a6 15 00 00 00 01 00 02 e9 03 15 00 00 00 01 00 02 ea b1 15 00 00 00 01 00 02 eb 03 15 00 00 00 01 00 02 ec b6 15 00 00 00 01 00 02 ed 03 15 00 00 00 01 00 02 ee ff 15 00 00 00 01 00 02 ef 01 15 00 00 00 01 00 02 f0 4a 15 00 00 00 01 00 02 f1 01 15 00 00 00 01 00 02 f2 4d 15 00 00 00 01 00 02 f3 01 15 00 00 00 01 00 02 f4 54 15 00 00 00 01 00 02 f5 01 15 00 00 00 01 00 02 f6 5a 15 00 00 00 01 00 02 f7 01 15 00 00 00 01 00 02 f8 60 15 00 00 00 01 00 02 f9 01 15 00 00 00 01 00 02 fa 66 15 00 00 00 01 00 02 ff 21 15 00 00 00 01 00 02 fb 01 15 00 00 00 01 00 02 00 01 15 00 00 00 01 00 02 01 6b 15 00 00 00 01 00 02 02 01 15 00 00 00 01 00 02 03 71 15 00 00 00 01 00 02 04 01 15 00 00 00 01 00 02 05 76 15 00 00 00 01 00 02 06 01 15 00 00 00 01 00 02 07 8a 15 00 00 00 01 00 02 08 01 15 00 00 00 01 00 02 09 9d 15 00 00 00 01 00 02 0a 01 15 00 00 00 01 00 02 0b be 15 00 00 00 01 00 02 0c 01 15 00 00 00 01 00 02 0d dc 15 00 00 00 01 00 02 0e 02 15 00 00 00 01 00 02 0f 07 15 00 00 00 01 00 02 10 02 15 00 00 00 01 00 02 11 2d 15 00 00 00 01 00 02 12 02 15 00 00 00 01 00 02 13 2e 15 00 00 00 01 00 02 14 02 15 00 00 00 01 00 02 15 5c 15 00 00 00 01 00 02 16 02 15 00 00 00 01 00 02 17 97 15 00 00 00 01 00 02 18 02 15 00 00 00 01 00 02 19 c0 15 00 00 00 01 00 02 1a 02 15 00 00 00 01 00 02 1b f7 15 00 00 00 01 00 02 1c 03 15 00 00 00 01 00 02 1d 14 15 00 00 00 01 00 02 1e 03 15 00 00 00 01 00 02 1f 4b 15 00 00 00 01 00 02 20 03 15 00 00 00 01 00 02 21 5c 15 00 00 00 01 00 02 22 03 15 00 00 00 01 00 02 23 6f 15 00 00 00 01 00 02 24 03 15 00 00 00 01 00 02 25 83 15 00 00 00 01 00 02 26 03 15 00 00 00 01 00 02 27 97 15 00 00 00 01 00 02 28 03 15 00 00 00 01 00 02 29 a6 15 00 00 00 01 00 02 2a 03 15 00 00 00 01 00 02 2b b1 15 00 00 00 01 00 02 2d 03 15 00 00 00 01 00 02 2f b6 15 00 00 00 01 00 02 30 03 15 00 00 00 01 00 02 31 ff 15 00 00 00 01 00 02 32 01 15 00 00 00 01 00 02 33 4a 15 00 00 00 01 00 02 34 01 15 00 00 00 01 00 02 35 4d 15 00 00 00 01 00 02 36 01 15 00 00 00 01 00 02 37 54 15 00 00 00 01 00 02 38 01 15 00 00 00 01 00 02 39 5a 15 00 00 00 01 00 02 3a 01 15 00 00 00 01 00 02 3b 60 15 00 00 00 01 00 02 3d 01 15 00 00 00 01 00 02 3f 66 15 00 00 00 01 00 02 40 01 15 00 00 00 01 00 02 41 6b 15 00 00 00 01 00 02 42 01 15 00 00 00 01 00 02 43 71 15 00 00 00 01 00 02 44 01 15 00 00 00 01 00 02 45 76 15 00 00 00 01 00 02 46 01 15 00 00 00 01 00 02 47 8a 15 00 00 00 01 00 02 48 01 15 00 00 00 01 00 02 49 9d 15 00 00 00 01 00 02 4a 01 15 00 00 00 01 00 02 4b be 15 00 00 00 01 00 02 4c 01 15 00 00 00 01 00 02 4d dc 15 00 00 00 01 00 02 4e 02 15 00 00 00 01 00 02 4f 07 15 00 00 00 01 00 02 50 02 15 00 00 00 01 00 02 51 2d 15 00 00 00 01 00 02 52 02 15 00 00 00 01 00 02 53 2e 15 00 00 00 01 00 02 54 02 15 00 00 00 01 00 02 55 5c 15 00 00 00 01 00 02 56 02 15 00 00 00 01 00 02 58 97 15 00 00 00 01 00 02 59 02 15 00 00 00 01 00 02 5a c0 15 00 00 00 01 00 02 5b 02 15 00 00 00 01 00 02 5c f7 15 00 00 00 01 00 02 5d 03 15 00 00 00 01 00 02 5e 14 15 00 00 00 01 00 02 5f 03 15 00 00 00 01 00 02 60 4b 15 00 00 00 01 00 02 61 03 15 00 00 00 01 00 02 62 5c 15 00 00 00 01 00 02 63 03 15 00 00 00 01 00 02 64 6f 15 00 00 00 01 00 02 65 03 15 00 00 00 01 00 02 66 83 15 00 00 00 01 00 02 67 03 15 00 00 00 01 00 02 68 97 15 00 00 00 01 00 02 69 03 15 00 00 00 01 00 02 6a a6 15 00 00 00 01 00 02 6b 03 15 00 00 00 01 00 02 6c b1 15 00 00 00 01 00 02 6d 03 15 00 00 00 01 00 02 6e b6 15 00 00 00 01 00 02 6f 03 15 00 00 00 01 00 02 70 ff 15 00 00 00 01 00 02 71 01 15 00 00 00 01 00 02 72 ff 15 00 00 00 01 00 02 73 02 15 00 00 00 01 00 02 74 00 15 00 00 00 01 00 02 75 02 15 00 00 00 01 00 02 76 01 15 00 00 00 01 00 02 77 02 15 00 00 00 01 00 02 78 03 15 00 00 00 01 00 02 79 02 15 00 00 00 01 00 02 7a 04 15 00 00 00 01 00 02 7b 02 15 00 00 00 01 00 02 7c 05 15 00 00 00 01 00 02 7d 02 15 00 00 00 01 00 02 7e 07 15 00 00 00 01 00 02 7f 02 15 00 00 00 01 00 02 80 08 15 00 00 00 01 00 02 81 02 15 00 00 00 01 00 02 82 0a 15 00 00 00 01 00 02 83 02 15 00 00 00 01 00 02 84 10 15 00 00 00 01 00 02 85 02 15 00 00 00 01 00 02 86 16 15 00 00 00 01 00 02 87 02 15 00 00 00 01 00 02 88 22 15 00 00 00 01 00 02 89 02 15 00 00 00 01 00 02 8a 2f 15 00 00 00 01 00 02 8b 02 15 00 00 00 01 00 02 8c 4c 15 00 00 00 01 00 02 8d 02 15 00 00 00 01 00 02 8e 6d 15 00 00 00 01 00 02 8f 02 15 00 00 00 01 00 02 90 6f 15 00 00 00 01 00 02 91 02 15 00 00 00 01 00 02 92 98 15 00 00 00 01 00 02 93 02 15 00 00 00 01 00 02 94 d2 15 00 00 00 01 00 02 95 02 15 00 00 00 01 00 02 96 f7 15 00 00 00 01 00 02 97 03 15 00 00 00 01 00 02 98 22 15 00 00 00 01 00 02 99 03 15 00 00 00 01 00 02 9a 4a 15 00 00 00 01 00 02 9b 03 15 00 00 00 01 00 02 9c 7b 15 00 00 00 01 00 02 9d 03 15 00 00 00 01 00 02 9e 88 15 00 00 00 01 00 02 9f 03 15 00 00 00 01 00 02 a0 94 15 00 00 00 01 00 02 a2 03 15 00 00 00 01 00 02 a3 a0 15 00 00 00 01 00 02 a4 03 15 00 00 00 01 00 02 a5 a9 15 00 00 00 01 00 02 a6 03 15 00 00 00 01 00 02 a7 b0 15 00 00 00 01 00 02 a9 03 15 00 00 00 01 00 02 aa b4 15 00 00 00 01 00 02 ab 03 15 00 00 00 01 00 02 ac b6 15 00 00 00 01 00 02 ad 03 15 00 00 00 01 00 02 ae ff 15 00 00 00 01 00 02 af 01 15 00 00 00 01 00 02 b0 ff 15 00 00 00 01 00 02 b1 02 15 00 00 00 01 00 02 b2 00 15 00 00 00 01 00 02 b3 02 15 00 00 00 01 00 02 b4 01 15 00 00 00 01 00 02 b5 02 15 00 00 00 01 00 02 b6 03 15 00 00 00 01 00 02 b7 02 15 00 00 00 01 00 02 b8 04 15 00 00 00 01 00 02 b9 02 15 00 00 00 01 00 02 ba 05 15 00 00 00 01 00 02 bb 02 15 00 00 00 01 00 02 bc 07 15 00 00 00 01 00 02 bd 02 15 00 00 00 01 00 02 be 08 15 00 00 00 01 00 02 bf 02 15 00 00 00 01 00 02 c0 0a 15 00 00 00 01 00 02 c1 02 15 00 00 00 01 00 02 c2 10 15 00 00 00 01 00 02 c3 02 15 00 00 00 01 00 02 c4 16 15 00 00 00 01 00 02 c5 02 15 00 00 00 01 00 02 c6 22 15 00 00 00 01 00 02 c7 02 15 00 00 00 01 00 02 c8 2f 15 00 00 00 01 00 02 c9 02 15 00 00 00 01 00 02 ca 4c 15 00 00 00 01 00 02 cb 02 15 00 00 00 01 00 02 cc 6d 15 00 00 00 01 00 02 cd 02 15 00 00 00 01 00 02 ce 6f 15 00 00 00 01 00 02 cf 02 15 00 00 00 01 00 02 d0 98 15 00 00 00 01 00 02 d1 02 15 00 00 00 01 00 02 d2 d2 15 00 00 00 01 00 02 d3 02 15 00 00 00 01 00 02 d4 f7 15 00 00 00 01 00 02 d5 03 15 00 00 00 01 00 02 d6 22 15 00 00 00 01 00 02 d7 03 15 00 00 00 01 00 02 d8 4a 15 00 00 00 01 00 02 d9 03 15 00 00 00 01 00 02 da 7b 15 00 00 00 01 00 02 db 03 15 00 00 00 01 00 02 dc 88 15 00 00 00 01 00 02 dd 03 15 00 00 00 01 00 02 de 94 15 00 00 00 01 00 02 df 03 15 00 00 00 01 00 02 e0 a0 15 00 00 00 01 00 02 e1 03 15 00 00 00 01 00 02 e2 a9 15 00 00 00 01 00 02 e3 03 15 00 00 00 01 00 02 e4 b0 15 00 00 00 01 00 02 e5 03 15 00 00 00 01 00 02 e6 b4 15 00 00 00 01 00 02 e7 03 15 00 00 00 01 00 02 e8 b6 15 00 00 00 01 00 02 e9 03 15 00 00 00 01 00 02 ea ff 15 00 00 00 01 00 02 fb 01 15 01 00 00 01 00 02 ff 10];
        qcom,mdss-dsi-dispparam-papermode7-state = "dsi_hs_mode";
        qcom,mdss-dsi-dispparam-level0-command = [15 01 00 00 10 00 02 ff 22 15 01 00 00 10 00 02 56 00 15 01 00 00 10 00 02 ff 10];
        qcom,mdss-dsi-dispparam-level1-command = [15 01 00 00 10 00 02 ff 22 15 01 00 00 10 00 02 58 12 15 01 00 00 10 00 02 59 0e 15 01 00 00 10 00 02 56 01 15 01 00 00 10 00 02 ff 10];
        qcom,mdss-dsi-dispparam-level2-command = [15 01 00 00 10 00 02 ff 22 15 01 00 00 10 00 02 58 14 15 01 00 00 10 00 02 59 0e 15 01 00 00 10 00 02 56 01 15 01 00 00 10 00 02 ff 10];
        qcom,mdss-dsi-dispparam-level3-command = [15 01 00 00 10 00 02 ff 22 15 01 00 00 10 00 02 58 16 15 01 00 00 10 00 02 59 0e 15 01 00 00 10 00 02 56 01 15 01 00 00 10 00 02 ff 10];
        qcom,mdss-dsi-dispparam-level4-command = [15 01 00 00 10 00 02 ff 22 15 01 00 00 10 00 02 58 18 15 01 00 00 10 00 02 59 0e 15 01 00 00 10 00 02 56 01 15 01 00 00 10 00 02 ff 10];
        qcom,mdss-dsi-dispparam-level5-command = [15 01 00 00 10 00 02 ff 22 15 01 00 00 10 00 02 58 1a 15 01 00 00 10 00 02 59 0e 15 01 00 00 10 00 02 56 01 15 01 00 00 10 00 02 ff 10];
        qcom,mdss-dsi-dispparam-level6-command = [15 01 00 00 10 00 02 ff 22 15 01 00 00 10 00 02 58 1c 15 01 00 00 10 00 02 59 0e 15 01 00 00 10 00 02 56 01 15 01 00 00 10 00 02 ff 10];
        qcom,mdss-dsi-dispparam-idleon-command = [15 01 00 00 10 00 02 ff 10 15 01 00 00 10 00 02 39 00];
        qcom,mdss-dsi-dispparam-idleoff-command = [15 01 00 00 10 00 02 ff 10 15 01 00 00 10 00 02 38 00];
        qcom,mdss-dsi-dispparam-test-command = [15 01 00 00 10 00 02 ff 20];
        qcom,mdss-dsi-dispparam-test-command-state = "dsi_hs_mode";
	};
};
