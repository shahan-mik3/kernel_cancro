/* Copyright (c) 2012-2013, The Linux Foundation. All rights reserved.
 *
 * This program is free software; you can redistribute it and/or modify
 * it under the terms of the GNU General Public License version 2 and
 * only version 2 as published by the Free Software Foundation.
 *
 * This program is distributed in the hope that it will be useful,
 * but WITHOUT ANY WARRANTY; without even the implied warranty of
 * MERCHANTABILITY or FITNESS FOR A PARTICULAR PURPOSE.  See the
 * GNU General Public License for more details.
 */

/*---------------------------------------------------------------------------
 * This file is autogenerated file using gcdb parser. Please do not edit it.
 * Update input XML file to add a new entry or update variable in this file
 * VERSION = "1.0"
 *---------------------------------------------------------------------------*/
&soc {
	dsi_sharp_fhd_cmd_95: qcom,mdss_dsi_sharp_fhd_cmd_95 {
		compatible = "qcom,mdss-dsi-panel";
		status = "okay";
		qcom,mdss-dsi-panel-name = "sharp fhd cmd mode dsi panel";
		qcom,mdss-dsi-panel-id = <4>;
		qcom,mdss-dsi-panel-controller = <&mdss_dsi0>;
		qcom,mdss-dsi-panel-type = "dsi_cmd_mode";
		qcom,mdss-dsi-panel-destination = "display_1";
		qcom,mdss-dsi-panel-framerate = <60>;
		qcom,mdss-dsi-virtual-channel-id = <0>;
		qcom,mdss-dsi-stream = <0>;
		qcom,mdss-dsi-panel-width = <1080>;
		qcom,mdss-dsi-panel-height = <1920>;
		qcom,mdss-dsi-h-front-porch = <80>;
		qcom,mdss-dsi-h-back-porch = <40>;
		qcom,mdss-dsi-h-pulse-width = <10>;
		qcom,mdss-dsi-h-sync-skew = <0>;
		qcom,mdss-dsi-v-back-porch = <4>;
		qcom,mdss-dsi-v-front-porch = <4>;
		qcom,mdss-dsi-v-pulse-width = <2>;
		qcom,mdss-dsi-h-left-border = <0>;
		qcom,mdss-dsi-h-right-border = <0>;
		qcom,mdss-dsi-v-top-border = <0>;
		qcom,mdss-dsi-v-bottom-border = <0>;
		qcom,mdss-dsi-bpp = <24>;
		qcom,mdss-dsi-color-order = <0>;
		qcom,mdss-dsi-underflow-color = <0xff>;
		qcom,mdss-dsi-border-color = <0>;
		qcom,mdss-dsi-on-command = [
			15 01 00 00 01 00 02 FF 10
			15 01 00 00 01 00 02 BB 10
			15 01 00 00 01 00 02 B0 03

			15 00 00 00 01 00 02 FF 24
			15 00 00 00 01 00 02 C4 69
			15 00 00 00 01 00 02 C9 00
			15 01 00 00 01 00 02 FB 01

			15 01 00 00 01 00 02 FF 22
			15 01 00 00 01 00 02 FB 01
			15 01 00 00 01 00 02 00 28
			15 01 00 00 01 00 02 01 2C
			15 01 00 00 01 00 02 02 30
			15 01 00 00 01 00 02 03 34
			15 01 00 00 01 00 02 04 38
			15 01 00 00 01 00 02 05 3C
			15 01 00 00 01 00 02 06 40
			15 01 00 00 01 00 02 07 48
			15 01 00 00 01 00 02 08 4C
			15 01 00 00 01 00 02 09 50
			15 01 00 00 01 00 02 0A 58
			15 01 00 00 01 00 02 0B 60
			15 01 00 00 01 00 02 0C 60
			15 01 00 00 01 00 02 0D 58
			15 01 00 00 01 00 02 0E 50
			15 01 00 00 01 00 02 0F 48
			15 01 00 00 01 00 02 10 38
			15 01 00 00 01 00 02 11 28
			15 01 00 00 01 00 02 12 28
			15 01 00 00 01 00 02 13 28
			15 01 00 00 01 00 02 1B 00
			15 01 00 00 01 00 02 1C 00
			15 01 00 00 01 00 02 1D 00
			15 01 00 00 01 00 02 1E 00
			15 01 00 00 01 00 02 1F 00
			15 01 00 00 01 00 02 20 00
			15 01 00 00 01 00 02 21 00
			15 01 00 00 01 00 02 22 00
			15 01 00 00 01 00 02 23 00
			15 01 00 00 01 00 02 24 00
			15 01 00 00 01 00 02 25 00
			15 01 00 00 01 00 02 26 00
			15 01 00 00 01 00 02 27 00
			15 01 00 00 01 00 02 28 00
			15 01 00 00 01 00 02 29 00
			15 01 00 00 01 00 02 2A 00
			15 01 00 00 01 00 02 2B 00
			15 01 00 00 01 00 02 2F 00
			15 01 00 00 01 00 02 30 00
			15 01 00 00 01 00 02 31 00
			15 01 00 00 01 00 02 32 80
			15 01 00 00 01 00 02 33 80
			15 01 00 00 01 00 02 34 80
			15 01 00 00 01 00 02 35 82
			15 01 00 00 01 00 02 36 84
			15 01 00 00 01 00 02 37 86
			15 01 00 00 01 00 02 38 88
			15 01 00 00 01 00 02 39 8A
			15 01 00 00 01 00 02 3A 8C
			15 01 00 00 01 00 02 3B 8E
			15 01 00 00 01 00 02 3F 90
			15 01 00 00 01 00 02 40 92
			15 01 00 00 01 00 02 41 94
			15 01 00 00 01 00 02 42 94
			15 01 00 00 01 00 02 43 92
			15 01 00 00 01 00 02 44 90
			15 01 00 00 01 00 02 45 8E
			15 01 00 00 01 00 02 46 8C
			15 01 00 00 01 00 02 47 8A
			15 01 00 00 01 00 02 48 88
			15 01 00 00 01 00 02 49 86
			15 01 00 00 01 00 02 4A 84
			15 01 00 00 01 00 02 4B 82
			15 01 00 00 01 00 02 4C 80
			15 01 00 00 01 00 02 4D 08
			15 01 00 00 01 00 02 1A 00
			15 01 00 00 01 00 02 53 01
			15 01 00 00 01 00 02 54 01
			15 01 00 00 01 00 02 56 00
			15 01 00 00 01 00 02 64 2F
			15 01 00 00 01 00 02 68 00

			15 01 00 00 01 00 02 FF 10
			15 01 00 00 01 00 02 35 00
			05 01 00 00 78 00 02 11 00
			15 01 00 00 01 00 02 51 de
			15 01 00 00 01 00 02 53 2c
			15 01 00 00 01 00 02 55 80
			15 01 00 00 01 00 02 FF F0
			15 01 00 00 01 00 02 92 01
			15 01 00 00 01 00 02 13 01
			15 01 00 00 01 00 02 FF 10
			05 01 00 00 28 00 02 29 00
			];
		qcom,mdss-dsi-off-command = [
			15 01 00 00 00 00 02 FF 10
			39 01 00 00 11 00 02 28 00
			39 01 00 00 44 00 02 10 00
			];
		qcom,mdss-dsi-on-command-state = "dsi_lp_mode";
		qcom,mdss-dsi-off-command-state = "dsi_hs_mode";
		qcom,mdss-dsi-h-sync-pulse = <0>;
		qcom,mdss-dsi-traffic-mode = <1>;
		qcom,mdss-dsi-lane-map = <0>;
		qcom,mdss-dsi-bllp-eof-power-mode;
		qcom,mdss-dsi-bllp-power-mode;
		qcom,mdss-dsi-lane-0-state;
		qcom,mdss-dsi-lane-1-state;
		qcom,mdss-dsi-lane-2-state;
		qcom,mdss-dsi-lane-3-state;
		qcom,mdss-dsi-te-pin-select = <1>;
		qcom,mdss-dsi-te-v-sync-rd-ptr-irq-line = <0x2c>;
		qcom,mdss-dsi-te-v-sync-continues-lines = <0x3c>;
		qcom,mdss-dsi-te-dcs-command = <1>;
		qcom,mdss-dsi-te-check-enable;
		qcom,mdss-dsi-te-using-te-pin;
		qcom,mdss-dsi-panel-timings = [e3 50 36 00 a9 a3 3a 50 3d 03 04 00];
		qcom,mdss-dsi-t-clk-post = <0x20>;
		qcom,mdss-dsi-t-clk-pre = <0x36>;
		qcom,mdss-dsi-bl-min-level = <8>;
		qcom,mdss-dsi-bl-max-level = <4095>;
		qcom,mdss-dsi-dma-trigger = <0x04>;
		qcom,mdss-dsi-mdp-trigger = <0x0>;
		qcom,mdss-dsi-bl-pmic-control-type = "bl_ctrl_wled";
		qcom,mdss-dsi-reset-sequence = <1 20>, <0 20>, <1 20>;
		qcom,mdss-pan-physical-width-dimension = <61>;
		qcom,mdss-pan-physical-height-dimension = <109>;
        qcom,dispparam-enabled;
        qcom,mdss-dsi-dispparam-cabcon-command = [15 00 00 00 01 00 02 ff 10 15 01 00 00 10 00 02 55 82];
        qcom,mdss-dsi-dispparam-cabcguion-command = [15 00 00 00 01 00 02 ff 10 15 01 00 00 10 00 02 55 81];
        qcom,mdss-dsi-dispparam-cabcstillon-command = [15 00 00 00 01 00 02 ff 10 15 01 00 00 10 00 02 55 82];
        qcom,mdss-dsi-dispparam-cabcmovieon-command = [15 00 00 00 01 00 02 ff 10 15 01 00 00 10 00 02 55 83];
        qcom,mdss-dsi-dispparam-cabcon-command-state = "dsi_hs_mode";
        qcom,mdss-dsi-dispparam-cabcoff-command = [15 00 00 00 01 00 02 ff 10 15 01 00 00 10 00 02 55 80];
        qcom,mdss-dsi-dispparam-cabcoff-command-state = "dsi_hs_mode";
        qcom,mdss-dsi-dispparam-gammareload-command = [15 00 00 00 01 00 02 ff 20 15 00 00 00 01 00 02 fb 00 15 00 00 00 01 00 02 ff 21 15 00 00 00 01 00 02 fb 00 15 00 00 00 01 00 02 ff 10 05 01 00 00 10 00 02 11 00];
        qcom,mdss-dsi-dispparam-gammareload-command-state = "dsi_hs_mode";
        qcom,mdss-dsi-dispparam-warm-command = [15 00 00 00 01 00 02 ff 20 15 00 00 00 01 00 02 75 00 15 00 00 00 01 00 02 76 9c 15 00 00 00 01 00 02 77 00 15 00 00 00 01 00 02 78 a9 15 00 00 00 01 00 02 79 00 15 00 00 00 01 00 02 7a c4 15 00 00 00 01 00 02 7b 00 15 00 00 00 01 00 02 7c d8 15 00 00 00 01 00 02 7d 00 15 00 00 00 01 00 02 7e eb 15 00 00 00 01 00 02 7f 00 15 00 00 00 01 00 02 80 fb 15 00 00 00 01 00 02 81 01 15 00 00 00 01 00 02 82 09 15 00 00 00 01 00 02 83 01 15 00 00 00 01 00 02 84 15 15 00 00 00 01 00 02 85 01 15 00 00 00 01 00 02 86 21 15 00 00 00 01 00 02 87 01 15 00 00 00 01 00 02 88 4b 15 00 00 00 01 00 02 89 01 15 00 00 00 01 00 02 8a 6d 15 00 00 00 01 00 02 8b 01 15 00 00 00 01 00 02 8c a6 15 00 00 00 01 00 02 8d 01 15 00 00 00 01 00 02 8e d5 15 00 00 00 01 00 02 8f 02 15 00 00 00 01 00 02 90 1c 15 00 00 00 01 00 02 91 02 15 00 00 00 01 00 02 92 4f 15 00 00 00 01 00 02 93 02 15 00 00 00 01 00 02 94 50 15 00 00 00 01 00 02 95 02 15 00 00 00 01 00 02 96 7f 15 00 00 00 01 00 02 97 02 15 00 00 00 01 00 02 98 b4 15 00 00 00 01 00 02 99 02 15 00 00 00 01 00 02 9a d5 15 00 00 00 01 00 02 9b 03 15 00 00 00 01 00 02 9c 08 15 00 00 00 01 00 02 9d 03 15 00 00 00 01 00 02 9e 27 15 00 00 00 01 00 02 9f 03 15 00 00 00 01 00 02 a0 50 15 00 00 00 01 00 02 a2 03 15 00 00 00 01 00 02 a3 5c 15 00 00 00 01 00 02 a4 03 15 00 00 00 01 00 02 a5 69 15 00 00 00 01 00 02 a6 03 15 00 00 00 01 00 02 a7 77 15 00 00 00 01 00 02 a9 03 15 00 00 00 01 00 02 aa 88 15 00 00 00 01 00 02 ab 03 15 00 00 00 01 00 02 ac 99 15 00 00 00 01 00 02 ad 03 15 00 00 00 01 00 02 ae af 15 00 00 00 01 00 02 af 03 15 00 00 00 01 00 02 b0 c2 15 00 00 00 01 00 02 b1 03 15 00 00 00 01 00 02 b2 c6 15 00 00 00 01 00 02 b3 00 15 00 00 00 01 00 02 b4 df 15 00 00 00 01 00 02 b5 00 15 00 00 00 01 00 02 b6 ec 15 00 00 00 01 00 02 b7 01 15 00 00 00 01 00 02 b8 05 15 00 00 00 01 00 02 b9 01 15 00 00 00 01 00 02 ba 17 15 00 00 00 01 00 02 bb 01 15 00 00 00 01 00 02 bc 28 15 00 00 00 01 00 02 bd 01 15 00 00 00 01 00 02 be 36 15 00 00 00 01 00 02 bf 01 15 00 00 00 01 00 02 c0 42 15 00 00 00 01 00 02 c1 01 15 00 00 00 01 00 02 c2 4d 15 00 00 00 01 00 02 c3 01 15 00 00 00 01 00 02 c4 58 15 00 00 00 01 00 02 c5 01 15 00 00 00 01 00 02 c6 7a 15 00 00 00 01 00 02 c7 01 15 00 00 00 01 00 02 c8 96 15 00 00 00 01 00 02 c9 01 15 00 00 00 01 00 02 ca c1 15 00 00 00 01 00 02 cb 01 15 00 00 00 01 00 02 cc e2 15 00 00 00 01 00 02 cd 02 15 00 00 00 01 00 02 ce 17 15 00 00 00 01 00 02 cf 02 15 00 00 00 01 00 02 d0 4a 15 00 00 00 01 00 02 d1 02 15 00 00 00 01 00 02 d2 4b 15 00 00 00 01 00 02 d3 02 15 00 00 00 01 00 02 d4 7a 15 00 00 00 01 00 02 d5 02 15 00 00 00 01 00 02 d6 b1 15 00 00 00 01 00 02 d7 02 15 00 00 00 01 00 02 d8 d4 15 00 00 00 01 00 02 d9 03 15 00 00 00 01 00 02 da 03 15 00 00 00 01 00 02 db 03 15 00 00 00 01 00 02 dc 23 15 00 00 00 01 00 02 dd 03 15 00 00 00 01 00 02 de 4d 15 00 00 00 01 00 02 df 03 15 00 00 00 01 00 02 e0 5a 15 00 00 00 01 00 02 e1 03 15 00 00 00 01 00 02 e2 68 15 00 00 00 01 00 02 e3 03 15 00 00 00 01 00 02 e4 76 15 00 00 00 01 00 02 e5 03 15 00 00 00 01 00 02 e6 87 15 00 00 00 01 00 02 e7 03 15 00 00 00 01 00 02 e8 98 15 00 00 00 01 00 02 e9 03 15 00 00 00 01 00 02 ea ae 15 00 00 00 01 00 02 eb 03 15 00 00 00 01 00 02 ec c1 15 00 00 00 01 00 02 ed 03 15 00 00 00 01 00 02 ee c6 15 00 00 00 01 00 02 ef 00 15 00 00 00 01 00 02 f0 37 15 00 00 00 01 00 02 f1 00 15 00 00 00 01 00 02 f2 73 15 00 00 00 01 00 02 f3 00 15 00 00 00 01 00 02 f4 9d 15 00 00 00 01 00 02 f5 00 15 00 00 00 01 00 02 f6 b9 15 00 00 00 01 00 02 f7 00 15 00 00 00 01 00 02 f8 cf 15 00 00 00 01 00 02 f9 00 15 00 00 00 01 00 02 fa e2 15 00 00 00 01 00 02 ff 21 15 00 00 00 01 00 02 00 00 15 00 00 00 01 00 02 01 f3 15 00 00 00 01 00 02 02 01 15 00 00 00 01 00 02 03 02 15 00 00 00 01 00 02 04 01 15 00 00 00 01 00 02 05 0f 15 00 00 00 01 00 02 06 01 15 00 00 00 01 00 02 07 3d 15 00 00 00 01 00 02 08 01 15 00 00 00 01 00 02 09 62 15 00 00 00 01 00 02 0a 01 15 00 00 00 01 00 02 0b 9f 15 00 00 00 01 00 02 0c 01 15 00 00 00 01 00 02 0d d0 15 00 00 00 01 00 02 0e 02 15 00 00 00 01 00 02 0f 1a 15 00 00 00 01 00 02 10 02 15 00 00 00 01 00 02 11 4d 15 00 00 00 01 00 02 12 02 15 00 00 00 01 00 02 13 4f 15 00 00 00 01 00 02 14 02 15 00 00 00 01 00 02 15 7e 15 00 00 00 01 00 02 16 02 15 00 00 00 01 00 02 17 b2 15 00 00 00 01 00 02 18 02 15 00 00 00 01 00 02 19 d5 15 00 00 00 01 00 02 1a 03 15 00 00 00 01 00 02 1b 07 15 00 00 00 01 00 02 1c 03 15 00 00 00 01 00 02 1d 2a 15 00 00 00 01 00 02 1e 03 15 00 00 00 01 00 02 1f 4f 15 00 00 00 01 00 02 20 03 15 00 00 00 01 00 02 21 59 15 00 00 00 01 00 02 22 03 15 00 00 00 01 00 02 23 66 15 00 00 00 01 00 02 24 03 15 00 00 00 01 00 02 25 74 15 00 00 00 01 00 02 26 03 15 00 00 00 01 00 02 27 85 15 00 00 00 01 00 02 28 03 15 00 00 00 01 00 02 29 95 15 00 00 00 01 00 02 2a 03 15 00 00 00 01 00 02 2b aa 15 00 00 00 01 00 02 2d 03 15 00 00 00 01 00 02 2f c1 15 00 00 00 01 00 02 30 03 15 00 00 00 01 00 02 31 c6 15 00 00 00 01 00 02 32 00 15 00 00 00 01 00 02 33 84 15 00 00 00 01 00 02 34 00 15 00 00 00 01 00 02 35 be 15 00 00 00 01 00 02 36 00 15 00 00 00 01 00 02 37 e6 15 00 00 00 01 00 02 38 01 15 00 00 00 01 00 02 39 01 15 00 00 00 01 00 02 3a 01 15 00 00 00 01 00 02 3b 15 15 00 00 00 01 00 02 3d 01 15 00 00 00 01 00 02 3f 26 15 00 00 00 01 00 02 40 01 15 00 00 00 01 00 02 41 34 15 00 00 00 01 00 02 42 01 15 00 00 00 01 00 02 43 42 15 00 00 00 01 00 02 44 01 15 00 00 00 01 00 02 45 4e 15 00 00 00 01 00 02 46 01 15 00 00 00 01 00 02 47 74 15 00 00 00 01 00 02 48 01 15 00 00 00 01 00 02 49 91 15 00 00 00 01 00 02 4a 01 15 00 00 00 01 00 02 4b be 15 00 00 00 01 00 02 4c 01 15 00 00 00 01 00 02 4d df 15 00 00 00 01 00 02 4e 02 15 00 00 00 01 00 02 4f 15 15 00 00 00 01 00 02 50 02 15 00 00 00 01 00 02 51 48 15 00 00 00 01 00 02 52 02 15 00 00 00 01 00 02 53 4a 15 00 00 00 01 00 02 54 02 15 00 00 00 01 00 02 55 79 15 00 00 00 01 00 02 56 02 15 00 00 00 01 00 02 58 af 15 00 00 00 01 00 02 59 02 15 00 00 00 01 00 02 5a d4 15 00 00 00 01 00 02 5b 03 15 00 00 00 01 00 02 5c 02 15 00 00 00 01 00 02 5d 03 15 00 00 00 01 00 02 5e 26 15 00 00 00 01 00 02 5f 03 15 00 00 00 01 00 02 60 4c 15 00 00 00 01 00 02 61 03 15 00 00 00 01 00 02 62 57 15 00 00 00 01 00 02 63 03 15 00 00 00 01 00 02 64 65 15 00 00 00 01 00 02 65 03 15 00 00 00 01 00 02 66 73 15 00 00 00 01 00 02 67 03 15 00 00 00 01 00 02 68 84 15 00 00 00 01 00 02 69 03 15 00 00 00 01 00 02 6a 94 15 00 00 00 01 00 02 6b 03 15 00 00 00 01 00 02 6c a9 15 00 00 00 01 00 02 6d 03 15 00 00 00 01 00 02 6e c0 15 00 00 00 01 00 02 6f 03 15 00 00 00 01 00 02 70 c6 15 00 00 00 01 00 02 71 01 15 00 00 00 01 00 02 72 82 15 00 00 00 01 00 02 73 01 15 00 00 00 01 00 02 74 84 15 00 00 00 01 00 02 75 01 15 00 00 00 01 00 02 76 8a 15 00 00 00 01 00 02 77 01 15 00 00 00 01 00 02 78 90 15 00 00 00 01 00 02 79 01 15 00 00 00 01 00 02 7a 94 15 00 00 00 01 00 02 7b 01 15 00 00 00 01 00 02 7c 9a 15 00 00 00 01 00 02 7d 01 15 00 00 00 01 00 02 7e a0 15 00 00 00 01 00 02 7f 01 15 00 00 00 01 00 02 80 a6 15 00 00 00 01 00 02 81 01 15 00 00 00 01 00 02 82 aa 15 00 00 00 01 00 02 83 01 15 00 00 00 01 00 02 84 bd 15 00 00 00 01 00 02 85 01 15 00 00 00 01 00 02 86 d0 15 00 00 00 01 00 02 87 01 15 00 00 00 01 00 02 88 f1 15 00 00 00 01 00 02 89 02 15 00 00 00 01 00 02 8a 10 15 00 00 00 01 00 02 8b 02 15 00 00 00 01 00 02 8c 43 15 00 00 00 01 00 02 8d 02 15 00 00 00 01 00 02 8e 6b 15 00 00 00 01 00 02 8f 02 15 00 00 00 01 00 02 90 6c 15 00 00 00 01 00 02 91 02 15 00 00 00 01 00 02 92 97 15 00 00 00 01 00 02 93 02 15 00 00 00 01 00 02 94 ca 15 00 00 00 01 00 02 95 02 15 00 00 00 01 00 02 96 ec 15 00 00 00 01 00 02 97 03 15 00 00 00 01 00 02 98 23 15 00 00 00 01 00 02 99 03 15 00 00 00 01 00 02 9a 38 15 00 00 00 01 00 02 9b 03 15 00 00 00 01 00 02 9c 5e 15 00 00 00 01 00 02 9d 03 15 00 00 00 01 00 02 9e 6a 15 00 00 00 01 00 02 9f 03 15 00 00 00 01 00 02 a0 73 15 00 00 00 01 00 02 a2 03 15 00 00 00 01 00 02 a3 80 15 00 00 00 01 00 02 a4 03 15 00 00 00 01 00 02 a5 8f 15 00 00 00 01 00 02 a6 03 15 00 00 00 01 00 02 a7 9e 15 00 00 00 01 00 02 a9 03 15 00 00 00 01 00 02 aa ac 15 00 00 00 01 00 02 ab 03 15 00 00 00 01 00 02 ac b4 15 00 00 00 01 00 02 ad 03 15 00 00 00 01 00 02 ae c6 15 00 00 00 01 00 02 af 01 15 00 00 00 01 00 02 b0 b7 15 00 00 00 01 00 02 b1 01 15 00 00 00 01 00 02 b2 b9 15 00 00 00 01 00 02 b3 01 15 00 00 00 01 00 02 b4 bd 15 00 00 00 01 00 02 b5 01 15 00 00 00 01 00 02 b6 c1 15 00 00 00 01 00 02 b7 01 15 00 00 00 01 00 02 b8 c5 15 00 00 00 01 00 02 b9 01 15 00 00 00 01 00 02 ba c9 15 00 00 00 01 00 02 bb 01 15 00 00 00 01 00 02 bc cd 15 00 00 00 01 00 02 bd 01 15 00 00 00 01 00 02 be d2 15 00 00 00 01 00 02 bf 01 15 00 00 00 01 00 02 c0 d5 15 00 00 00 01 00 02 c1 01 15 00 00 00 01 00 02 c2 e2 15 00 00 00 01 00 02 c3 01 15 00 00 00 01 00 02 c4 ef 15 00 00 00 01 00 02 c5 02 15 00 00 00 01 00 02 c6 06 15 00 00 00 01 00 02 c7 02 15 00 00 00 01 00 02 c8 19 15 00 00 00 01 00 02 c9 02 15 00 00 00 01 00 02 ca 3e 15 00 00 00 01 00 02 cb 02 15 00 00 00 01 00 02 cc 66 15 00 00 00 01 00 02 cd 02 15 00 00 00 01 00 02 ce 67 15 00 00 00 01 00 02 cf 02 15 00 00 00 01 00 02 d0 92 15 00 00 00 01 00 02 d1 02 15 00 00 00 01 00 02 d2 c7 15 00 00 00 01 00 02 d3 02 15 00 00 00 01 00 02 d4 eb 15 00 00 00 01 00 02 d5 03 15 00 00 00 01 00 02 d6 1e 15 00 00 00 01 00 02 d7 03 15 00 00 00 01 00 02 d8 34 15 00 00 00 01 00 02 d9 03 15 00 00 00 01 00 02 da 5b 15 00 00 00 01 00 02 db 03 15 00 00 00 01 00 02 dc 67 15 00 00 00 01 00 02 dd 03 15 00 00 00 01 00 02 de 72 15 00 00 00 01 00 02 df 03 15 00 00 00 01 00 02 e0 7f 15 00 00 00 01 00 02 e1 03 15 00 00 00 01 00 02 e2 8e 15 00 00 00 01 00 02 e3 03 15 00 00 00 01 00 02 e4 9d 15 00 00 00 01 00 02 e5 03 15 00 00 00 01 00 02 e6 ab 15 00 00 00 01 00 02 e7 03 15 00 00 00 01 00 02 e8 b3 15 00 00 00 01 00 02 e9 03 15 00 00 00 01 00 02 ea c6 15 01 00 00 01 00 02 ff 10];
        qcom,mdss-dsi-dispparam-warm-command-state = "dsi_hs_mode";
        qcom,mdss-dsi-dispparam-default-command = [15 00 00 00 01 00 02 ff 20 15 00 00 00 01 00 02 fb 00 15 00 00 00 01 00 02 ff 21 15 00 00 00 01 00 02 fb 00 15 00 00 00 01 00 02 ff 10 05 01 00 00 10 00 02 11 00];
        qcom,mdss-dsi-dispparam-default-command-state = "dsi_hs_mode";
        qcom,mdss-dsi-dispparam-cold-command = [15 00 00 00 00 00 02 ff 20 15 00 00 00 00 00 02 75 00 15 00 00 00 00 00 02 76 f1 15 00 00 00 00 00 02 77 00 15 00 00 00 00 00 02 78 f8 15 00 00 00 00 00 02 79 01 15 00 00 00 00 00 02 7a 06 15 00 00 00 00 00 02 7b 01 15 00 00 00 00 00 02 7c 13 15 00 00 00 00 00 02 7d 01 15 00 00 00 00 00 02 7e 1f 15 00 00 00 00 00 02 7f 01 15 00 00 00 00 00 02 80 2a 15 00 00 00 00 00 02 81 01 15 00 00 00 00 00 02 82 35 15 00 00 00 00 00 02 83 01 15 00 00 00 00 00 02 84 3e 15 00 00 00 00 00 02 85 01 15 00 00 00 00 00 02 86 48 15 00 00 00 00 00 02 87 01 15 00 00 00 00 00 02 88 69 15 00 00 00 00 00 02 89 01 15 00 00 00 00 00 02 8a 87 15 00 00 00 00 00 02 8b 01 15 00 00 00 00 00 02 8c b8 15 00 00 00 00 00 02 8d 01 15 00 00 00 00 00 02 8e e3 15 00 00 00 00 00 02 8f 02 15 00 00 00 00 00 02 90 25 15 00 00 00 00 00 02 91 02 15 00 00 00 00 00 02 92 54 15 00 00 00 00 00 02 93 02 15 00 00 00 00 00 02 94 56 15 00 00 00 00 00 02 95 02 15 00 00 00 00 00 02 96 83 15 00 00 00 00 00 02 97 02 15 00 00 00 00 00 02 98 b8 15 00 00 00 00 00 02 99 02 15 00 00 00 00 00 02 9a da 15 00 00 00 00 00 02 9b 03 15 00 00 00 00 00 02 9c 0d 15 00 00 00 00 00 02 9d 03 15 00 00 00 00 00 02 9e 2b 15 00 00 00 00 00 02 9f 03 15 00 00 00 00 00 02 a0 53 15 00 00 00 00 00 02 a2 03 15 00 00 00 00 00 02 a3 60 15 00 00 00 00 00 02 a4 03 15 00 00 00 00 00 02 a5 6c 15 00 00 00 00 00 02 a6 03 15 00 00 00 00 00 02 a7 7a 15 00 00 00 00 00 02 a9 03 15 00 00 00 00 00 02 aa 8a 15 00 00 00 00 00 02 ab 03 15 00 00 00 00 00 02 ac 9b 15 00 00 00 00 00 02 ad 03 15 00 00 00 00 00 02 ae ae 15 00 00 00 00 00 02 af 03 15 00 00 00 00 00 02 b0 c3 15 00 00 00 00 00 02 b1 03 15 00 00 00 00 00 02 b2 c6 15 00 00 00 00 00 02 b3 01 15 00 00 00 00 00 02 b4 30 15 00 00 00 00 00 02 b5 01 15 00 00 00 00 00 02 b6 35 15 00 00 00 00 00 02 b7 01 15 00 00 00 00 00 02 b8 41 15 00 00 00 00 00 02 b9 01 15 00 00 00 00 00 02 ba 4e 15 00 00 00 00 00 02 bb 01 15 00 00 00 00 00 02 bc 58 15 00 00 00 00 00 02 bd 01 15 00 00 00 00 00 02 be 61 15 00 00 00 00 00 02 bf 01 15 00 00 00 00 00 02 c0 6a 15 00 00 00 00 00 02 c1 01 15 00 00 00 00 00 02 c2 72 15 00 00 00 00 00 02 c3 01 15 00 00 00 00 00 02 c4 7b 15 00 00 00 00 00 02 c5 01 15 00 00 00 00 00 02 c6 95 15 00 00 00 00 00 02 c7 01 15 00 00 00 00 00 02 c8 ac 15 00 00 00 00 00 02 c9 01 15 00 00 00 00 00 02 ca d1 15 00 00 00 00 00 02 cb 01 15 00 00 00 00 00 02 cc ee 15 00 00 00 00 00 02 cd 02 15 00 00 00 00 00 02 ce 20 15 00 00 00 00 00 02 cf 02 15 00 00 00 00 00 02 d0 4f 15 00 00 00 00 00 02 d1 02 15 00 00 00 00 00 02 d2 51 15 00 00 00 00 00 02 d3 02 15 00 00 00 00 00 02 d4 7e 15 00 00 00 00 00 02 d5 02 15 00 00 00 00 00 02 d6 b5 15 00 00 00 00 00 02 d7 02 15 00 00 00 00 00 02 d8 d9 15 00 00 00 00 00 02 d9 03 15 00 00 00 00 00 02 da 08 15 00 00 00 00 00 02 db 03 15 00 00 00 00 00 02 dc 27 15 00 00 00 00 00 02 dd 03 15 00 00 00 00 00 02 de 50 15 00 00 00 00 00 02 df 03 15 00 00 00 00 00 02 e0 5d 15 00 00 00 00 00 02 e1 03 15 00 00 00 00 00 02 e2 6b 15 00 00 00 00 00 02 e3 03 15 00 00 00 00 00 02 e4 79 15 00 00 00 00 00 02 e5 03 15 00 00 00 00 00 02 e6 89 15 00 00 00 00 00 02 e7 03 15 00 00 00 00 00 02 e8 9a 15 00 00 00 00 00 02 e9 03 15 00 00 00 00 00 02 ea ad 15 00 00 00 00 00 02 eb 03 15 00 00 00 00 00 02 ec c2 15 00 00 00 00 00 02 ed 03 15 00 00 00 00 00 02 ee c6 15 00 00 00 00 00 02 ef 00 15 00 00 00 00 00 02 f0 37 15 00 00 00 00 00 02 f1 00 15 00 00 00 00 00 02 f2 73 15 00 00 00 00 00 02 f3 00 15 00 00 00 00 00 02 f4 9d 15 00 00 00 00 00 02 f5 00 15 00 00 00 00 00 02 f6 b9 15 00 00 00 00 00 02 f7 00 15 00 00 00 00 00 02 f8 cf 15 00 00 00 00 00 02 f9 00 15 00 00 00 00 00 02 fa e2 15 00 00 00 00 00 02 ff 21 15 00 00 00 00 00 02 00 00 15 00 00 00 00 00 02 01 f3 15 00 00 00 00 00 02 02 01 15 00 00 00 00 00 02 03 02 15 00 00 00 00 00 02 04 01 15 00 00 00 00 00 02 05 0f 15 00 00 00 00 00 02 06 01 15 00 00 00 00 00 02 07 3d 15 00 00 00 00 00 02 08 01 15 00 00 00 00 00 02 09 62 15 00 00 00 00 00 02 0a 01 15 00 00 00 00 00 02 0b 9f 15 00 00 00 00 00 02 0c 01 15 00 00 00 00 00 02 0d d0 15 00 00 00 00 00 02 0e 02 15 00 00 00 00 00 02 0f 1a 15 00 00 00 00 00 02 10 02 15 00 00 00 00 00 02 11 4d 15 00 00 00 00 00 02 12 02 15 00 00 00 00 00 02 13 4f 15 00 00 00 00 00 02 14 02 15 00 00 00 00 00 02 15 7e 15 00 00 00 00 00 02 16 02 15 00 00 00 00 00 02 17 b2 15 00 00 00 00 00 02 18 02 15 00 00 00 00 00 02 19 d5 15 00 00 00 00 00 02 1a 03 15 00 00 00 00 00 02 1b 07 15 00 00 00 00 00 02 1c 03 15 00 00 00 00 00 02 1d 2a 15 00 00 00 00 00 02 1e 03 15 00 00 00 00 00 02 1f 4f 15 00 00 00 00 00 02 20 03 15 00 00 00 00 00 02 21 59 15 00 00 00 00 00 02 22 03 15 00 00 00 00 00 02 23 66 15 00 00 00 00 00 02 24 03 15 00 00 00 00 00 02 25 74 15 00 00 00 00 00 02 26 03 15 00 00 00 00 00 02 27 85 15 00 00 00 00 00 02 28 03 15 00 00 00 00 00 02 29 95 15 00 00 00 00 00 02 2a 03 15 00 00 00 00 00 02 2b aa 15 00 00 00 00 00 02 2d 03 15 00 00 00 00 00 02 2f c1 15 00 00 00 00 00 02 30 03 15 00 00 00 00 00 02 31 c6 15 00 00 00 00 00 02 32 00 15 00 00 00 00 00 02 33 84 15 00 00 00 00 00 02 34 00 15 00 00 00 00 00 02 35 be 15 00 00 00 00 00 02 36 00 15 00 00 00 00 00 02 37 e6 15 00 00 00 00 00 02 38 01 15 00 00 00 00 00 02 39 01 15 00 00 00 00 00 02 3a 01 15 00 00 00 00 00 02 3b 15 15 00 00 00 00 00 02 3d 01 15 00 00 00 00 00 02 3f 26 15 00 00 00 00 00 02 40 01 15 00 00 00 00 00 02 41 34 15 00 00 00 00 00 02 42 01 15 00 00 00 00 00 02 43 42 15 00 00 00 00 00 02 44 01 15 00 00 00 00 00 02 45 4e 15 00 00 00 00 00 02 46 01 15 00 00 00 00 00 02 47 74 15 00 00 00 00 00 02 48 01 15 00 00 00 00 00 02 49 91 15 00 00 00 00 00 02 4a 01 15 00 00 00 00 00 02 4b be 15 00 00 00 00 00 02 4c 01 15 00 00 00 00 00 02 4d df 15 00 00 00 00 00 02 4e 02 15 00 00 00 00 00 02 4f 15 15 00 00 00 00 00 02 50 02 15 00 00 00 00 00 02 51 48 15 00 00 00 00 00 02 52 02 15 00 00 00 00 00 02 53 4a 15 00 00 00 00 00 02 54 02 15 00 00 00 00 00 02 55 79 15 00 00 00 00 00 02 56 02 15 00 00 00 00 00 02 58 af 15 00 00 00 00 00 02 59 02 15 00 00 00 00 00 02 5a d4 15 00 00 00 00 00 02 5b 03 15 00 00 00 00 00 02 5c 02 15 00 00 00 00 00 02 5d 03 15 00 00 00 00 00 02 5e 26 15 00 00 00 00 00 02 5f 03 15 00 00 00 00 00 02 60 4c 15 00 00 00 00 00 02 61 03 15 00 00 00 00 00 02 62 57 15 00 00 00 00 00 02 63 03 15 00 00 00 00 00 02 64 65 15 00 00 00 00 00 02 65 03 15 00 00 00 00 00 02 66 73 15 00 00 00 00 00 02 67 03 15 00 00 00 00 00 02 68 84 15 00 00 00 00 00 02 69 03 15 00 00 00 00 00 02 6a 94 15 00 00 00 00 00 02 6b 03 15 00 00 00 00 00 02 6c a9 15 00 00 00 00 00 02 6d 03 15 00 00 00 00 00 02 6e c0 15 00 00 00 00 00 02 6f 03 15 00 00 00 00 00 02 70 c6 15 00 00 00 00 00 02 71 01 15 00 00 00 00 00 02 72 27 15 00 00 00 00 00 02 73 01 15 00 00 00 00 00 02 74 2c 15 00 00 00 00 00 02 75 01 15 00 00 00 00 00 02 76 35 15 00 00 00 00 00 02 77 01 15 00 00 00 00 00 02 78 40 15 00 00 00 00 00 02 79 01 15 00 00 00 00 00 02 7a 48 15 00 00 00 00 00 02 7b 01 15 00 00 00 00 00 02 7c 51 15 00 00 00 00 00 02 7d 01 15 00 00 00 00 00 02 7e 58 15 00 00 00 00 00 02 7f 01 15 00 00 00 00 00 02 80 61 15 00 00 00 00 00 02 81 01 15 00 00 00 00 00 02 82 69 15 00 00 00 00 00 02 83 01 15 00 00 00 00 00 02 84 84 15 00 00 00 00 00 02 85 01 15 00 00 00 00 00 02 86 9d 15 00 00 00 00 00 02 87 01 15 00 00 00 00 00 02 88 c9 15 00 00 00 00 00 02 89 01 15 00 00 00 00 00 02 8a f0 15 00 00 00 00 00 02 8b 02 15 00 00 00 00 00 02 8c 2e 15 00 00 00 00 00 02 8d 02 15 00 00 00 00 00 02 8e 5b 15 00 00 00 00 00 02 8f 02 15 00 00 00 00 00 02 90 5d 15 00 00 00 00 00 02 91 02 15 00 00 00 00 00 02 92 8a 15 00 00 00 00 00 02 93 02 15 00 00 00 00 00 02 94 be 15 00 00 00 00 00 02 95 02 15 00 00 00 00 00 02 96 e1 15 00 00 00 00 00 02 97 03 15 00 00 00 00 00 02 98 17 15 00 00 00 00 00 02 99 03 15 00 00 00 00 00 02 9a 2e 15 00 00 00 00 00 02 9b 03 15 00 00 00 00 00 02 9c 55 15 00 00 00 00 00 02 9d 03 15 00 00 00 00 00 02 9e 62 15 00 00 00 00 00 02 9f 03 15 00 00 00 00 00 02 a0 6d 15 00 00 00 00 00 02 a2 03 15 00 00 00 00 00 02 a3 7b 15 00 00 00 00 00 02 a4 03 15 00 00 00 00 00 02 a5 8a 15 00 00 00 00 00 02 a6 03 15 00 00 00 00 00 02 a7 9b 15 00 00 00 00 00 02 a9 03 15 00 00 00 00 00 02 aa aa 15 00 00 00 00 00 02 ab 03 15 00 00 00 00 00 02 ac bc 15 00 00 00 00 00 02 ad 03 15 00 00 00 00 00 02 ae c6 15 00 00 00 00 00 02 af 01 15 00 00 00 00 00 02 b0 62 15 00 00 00 00 00 02 b1 01 15 00 00 00 00 00 02 b2 66 15 00 00 00 00 00 02 b3 01 15 00 00 00 00 00 02 b4 6e 15 00 00 00 00 00 02 b5 01 15 00 00 00 00 00 02 b6 77 15 00 00 00 00 00 02 b7 01 15 00 00 00 00 00 02 b8 7d 15 00 00 00 00 00 02 b9 01 15 00 00 00 00 00 02 ba 85 15 00 00 00 00 00 02 bb 01 15 00 00 00 00 00 02 bc 8b 15 00 00 00 00 00 02 bd 01 15 00 00 00 00 00 02 be 92 15 00 00 00 00 00 02 bf 01 15 00 00 00 00 00 02 c0 98 15 00 00 00 00 00 02 c1 01 15 00 00 00 00 00 02 c2 ad 15 00 00 00 00 00 02 c3 01 15 00 00 00 00 00 02 c4 c0 15 00 00 00 00 00 02 c5 01 15 00 00 00 00 00 02 c6 e0 15 00 00 00 00 00 02 c7 01 15 00 00 00 00 00 02 c8 fb 15 00 00 00 00 00 02 c9 02 15 00 00 00 00 00 02 ca 29 15 00 00 00 00 00 02 cb 02 15 00 00 00 00 00 02 cc 56 15 00 00 00 00 00 02 cd 02 15 00 00 00 00 00 02 ce 58 15 00 00 00 00 00 02 cf 02 15 00 00 00 00 00 02 d0 85 15 00 00 00 00 00 02 d1 02 15 00 00 00 00 00 02 d2 bb 15 00 00 00 00 00 02 d3 02 15 00 00 00 00 00 02 d4 e0 15 00 00 00 00 00 02 d5 03 15 00 00 00 00 00 02 d6 12 15 00 00 00 00 00 02 d7 03 15 00 00 00 00 00 02 d8 2a 15 00 00 00 00 00 02 d9 03 15 00 00 00 00 00 02 da 52 15 00 00 00 00 00 02 db 03 15 00 00 00 00 00 02 dc 60 15 00 00 00 00 00 02 dd 03 15 00 00 00 00 00 02 de 6c 15 00 00 00 00 00 02 df 03 15 00 00 00 00 00 02 e0 7a 15 00 00 00 00 00 02 e1 03 15 00 00 00 00 00 02 e2 89 15 00 00 00 00 00 02 e3 03 15 00 00 00 00 00 02 e4 9a 15 00 00 00 00 00 02 e5 03 15 00 00 00 00 00 02 e6 a9 15 00 00 00 00 00 02 e7 03 15 00 00 00 00 00 02 e8 bb 15 00 00 00 00 00 02 e9 03 15 00 00 00 00 00 02 ea c6 15 01 00 00 01 00 02 ff 10];
        qcom,mdss-dsi-dispparam-cold-command-state = "dsi_hs_mode";
        qcom,mdss-dsi-dispparam-papermode-command = [15 01 00 00 78 00 02 ff 20 15 00 00 00 01 00 02 fb 01 15 00 00 00 01 00 02 75 00 15 00 00 00 01 00 02 76 c8 15 00 00 00 01 00 02 77 00 15 00 00 00 01 00 02 78 d6 15 00 00 00 01 00 02 79 00 15 00 00 00 01 00 02 7a ed 15 00 00 00 01 00 02 7b 01 15 00 00 00 01 00 02 7c 00 15 00 00 00 01 00 02 7d 01 15 00 00 00 01 00 02 7e 10 15 00 00 00 01 00 02 7f 01 15 00 00 00 01 00 02 80 1e 15 00 00 00 01 00 02 81 01 15 00 00 00 01 00 02 82 2b 15 00 00 00 01 00 02 83 01 15 00 00 00 01 00 02 84 37 15 00 00 00 01 00 02 85 01 15 00 00 00 01 00 02 86 42 15 00 00 00 01 00 02 87 01 15 00 00 00 01 00 02 88 66 15 00 00 00 01 00 02 89 01 15 00 00 00 01 00 02 8a 84 15 00 00 00 01 00 02 8b 01 15 00 00 00 01 00 02 8c b4 15 00 00 00 01 00 02 8d 01 15 00 00 00 01 00 02 8e da 15 00 00 00 01 00 02 8f 02 15 00 00 00 01 00 02 90 15 15 00 00 00 01 00 02 91 02 15 00 00 00 01 00 02 92 45 15 00 00 00 01 00 02 93 02 15 00 00 00 01 00 02 94 46 15 00 00 00 01 00 02 95 02 15 00 00 00 01 00 02 96 72 15 00 00 00 01 00 02 97 02 15 00 00 00 01 00 02 98 a2 15 00 00 00 01 00 02 99 02 15 00 00 00 01 00 02 9a c4 15 00 00 00 01 00 02 9b 02 15 00 00 00 01 00 02 9c f0 15 00 00 00 01 00 02 9d 03 15 00 00 00 01 00 02 9e 0b 15 00 00 00 01 00 02 9f 03 15 00 00 00 01 00 02 a0 2d 15 00 00 00 01 00 02 a2 03 15 00 00 00 01 00 02 a3 38 15 00 00 00 01 00 02 a4 03 15 00 00 00 01 00 02 a5 46 15 00 00 00 01 00 02 a6 03 15 00 00 00 01 00 02 a7 5b 15 00 00 00 01 00 02 a9 03 15 00 00 00 01 00 02 aa 84 15 00 00 00 01 00 02 ab 03 15 00 00 00 01 00 02 ac 9e 15 00 00 00 01 00 02 ad 03 15 00 00 00 01 00 02 ae aa 15 00 00 00 01 00 02 af 03 15 00 00 00 01 00 02 b0 af 15 00 00 00 01 00 02 b1 03 15 00 00 00 01 00 02 b2 ff 15 00 00 00 01 00 02 b3 00 15 00 00 00 01 00 02 b4 c8 15 00 00 00 01 00 02 b5 00 15 00 00 00 01 00 02 b6 d6 15 00 00 00 01 00 02 b7 00 15 00 00 00 01 00 02 b8 ed 15 00 00 00 01 00 02 b9 01 15 00 00 00 01 00 02 ba 00 15 00 00 00 01 00 02 bb 01 15 00 00 00 01 00 02 bc 10 15 00 00 00 01 00 02 bd 01 15 00 00 00 01 00 02 be 1e 15 00 00 00 01 00 02 bf 01 15 00 00 00 01 00 02 c0 2b 15 00 00 00 01 00 02 c1 01 15 00 00 00 01 00 02 c2 37 15 00 00 00 01 00 02 c3 01 15 00 00 00 01 00 02 c4 42 15 00 00 00 01 00 02 c5 01 15 00 00 00 01 00 02 c6 66 15 00 00 00 01 00 02 c7 01 15 00 00 00 01 00 02 c8 84 15 00 00 00 01 00 02 c9 01 15 00 00 00 01 00 02 ca b4 15 00 00 00 01 00 02 cb 01 15 00 00 00 01 00 02 cc da 15 00 00 00 01 00 02 cd 02 15 00 00 00 01 00 02 ce 15 15 00 00 00 01 00 02 cf 02 15 00 00 00 01 00 02 d0 45 15 00 00 00 01 00 02 d1 02 15 00 00 00 01 00 02 d2 46 15 00 00 00 01 00 02 d3 02 15 00 00 00 01 00 02 d4 72 15 00 00 00 01 00 02 d5 02 15 00 00 00 01 00 02 d6 a2 15 00 00 00 01 00 02 d7 02 15 00 00 00 01 00 02 d8 c4 15 00 00 00 01 00 02 d9 02 15 00 00 00 01 00 02 da f0 15 00 00 00 01 00 02 db 03 15 00 00 00 01 00 02 dc 0b 15 00 00 00 01 00 02 dd 03 15 00 00 00 01 00 02 de 2d 15 00 00 00 01 00 02 df 03 15 00 00 00 01 00 02 e0 38 15 00 00 00 01 00 02 e1 03 15 00 00 00 01 00 02 e2 46 15 00 00 00 01 00 02 e3 03 15 00 00 00 01 00 02 e4 5b 15 00 00 00 01 00 02 e5 03 15 00 00 00 01 00 02 e6 84 15 00 00 00 01 00 02 e7 03 15 00 00 00 01 00 02 e8 9e 15 00 00 00 01 00 02 e9 03 15 00 00 00 01 00 02 ea aa 15 00 00 00 01 00 02 eb 03 15 00 00 00 01 00 02 ec af 15 00 00 00 01 00 02 ed 03 15 00 00 00 01 00 02 ee ff 15 00 00 00 01 00 02 ef 00 15 00 00 00 01 00 02 f0 9f 15 00 00 00 01 00 02 f1 00 15 00 00 00 01 00 02 f2 b8 15 00 00 00 01 00 02 f3 00 15 00 00 00 01 00 02 f4 d9 15 00 00 00 01 00 02 f5 00 15 00 00 00 01 00 02 f6 f1 15 00 00 00 01 00 02 f7 01 15 00 00 00 01 00 02 f8 05 15 00 00 00 01 00 02 f9 01 15 00 00 00 01 00 02 fa 16 15 00 00 00 01 00 02 ff 21 15 00 00 00 01 00 02 fb 01 15 00 00 00 01 00 02 00 01 15 00 00 00 01 00 02 01 25 15 00 00 00 01 00 02 02 01 15 00 00 00 01 00 02 03 32 15 00 00 00 01 00 02 04 01 15 00 00 00 01 00 02 05 3f 15 00 00 00 01 00 02 06 01 15 00 00 00 01 00 02 07 67 15 00 00 00 01 00 02 08 01 15 00 00 00 01 00 02 09 87 15 00 00 00 01 00 02 0a 01 15 00 00 00 01 00 02 0b ba 15 00 00 00 01 00 02 0c 01 15 00 00 00 01 00 02 0d e2 15 00 00 00 01 00 02 0e 02 15 00 00 00 01 00 02 0f 1f 15 00 00 00 01 00 02 10 02 15 00 00 00 01 00 02 11 50 15 00 00 00 01 00 02 12 02 15 00 00 00 01 00 02 13 51 15 00 00 00 01 00 02 14 02 15 00 00 00 01 00 02 15 7f 15 00 00 00 01 00 02 16 02 15 00 00 00 01 00 02 17 b2 15 00 00 00 01 00 02 18 02 15 00 00 00 01 00 02 19 da 15 00 00 00 01 00 02 1a 03 15 00 00 00 01 00 02 1b 02 15 00 00 00 01 00 02 1c 03 15 00 00 00 01 00 02 1d 1d 15 00 00 00 01 00 02 1e 03 15 00 00 00 01 00 02 1f 59 15 00 00 00 01 00 02 20 03 15 00 00 00 01 00 02 21 9e 15 00 00 00 01 00 02 22 03 15 00 00 00 01 00 02 23 b1 15 00 00 00 01 00 02 24 03 15 00 00 00 01 00 02 25 bd 15 00 00 00 01 00 02 26 03 15 00 00 00 01 00 02 27 c7 15 00 00 00 01 00 02 28 03 15 00 00 00 01 00 02 29 cf 15 00 00 00 01 00 02 2a 03 15 00 00 00 01 00 02 2b d5 15 00 00 00 01 00 02 2d 03 15 00 00 00 01 00 02 2f d8 15 00 00 00 01 00 02 30 03 15 00 00 00 01 00 02 31 d9 15 00 00 00 01 00 02 32 00 15 00 00 00 01 00 02 33 9f 15 00 00 00 01 00 02 34 00 15 00 00 00 01 00 02 35 b8 15 00 00 00 01 00 02 36 00 15 00 00 00 01 00 02 37 d9 15 00 00 00 01 00 02 38 00 15 00 00 00 01 00 02 39 f1 15 00 00 00 01 00 02 3a 01 15 00 00 00 01 00 02 3b 05 15 00 00 00 01 00 02 3d 01 15 00 00 00 01 00 02 3f 16 15 00 00 00 01 00 02 40 01 15 00 00 00 01 00 02 41 25 15 00 00 00 01 00 02 42 01 15 00 00 00 01 00 02 43 32 15 00 00 00 01 00 02 44 01 15 00 00 00 01 00 02 45 3f 15 00 00 00 01 00 02 46 01 15 00 00 00 01 00 02 47 67 15 00 00 00 01 00 02 48 01 15 00 00 00 01 00 02 49 87 15 00 00 00 01 00 02 4a 01 15 00 00 00 01 00 02 4b ba 15 00 00 00 01 00 02 4c 01 15 00 00 00 01 00 02 4d e2 15 00 00 00 01 00 02 4e 02 15 00 00 00 01 00 02 4f 1f 15 00 00 00 01 00 02 50 02 15 00 00 00 01 00 02 51 50 15 00 00 00 01 00 02 52 02 15 00 00 00 01 00 02 53 51 15 00 00 00 01 00 02 54 02 15 00 00 00 01 00 02 55 7f 15 00 00 00 01 00 02 56 02 15 00 00 00 01 00 02 58 b2 15 00 00 00 01 00 02 59 02 15 00 00 00 01 00 02 5a da 15 00 00 00 01 00 02 5b 03 15 00 00 00 01 00 02 5c 02 15 00 00 00 01 00 02 5d 03 15 00 00 00 01 00 02 5e 1d 15 00 00 00 01 00 02 5f 03 15 00 00 00 01 00 02 60 59 15 00 00 00 01 00 02 61 03 15 00 00 00 01 00 02 62 9e 15 00 00 00 01 00 02 63 03 15 00 00 00 01 00 02 64 b1 15 00 00 00 01 00 02 65 03 15 00 00 00 01 00 02 66 bd 15 00 00 00 01 00 02 67 03 15 00 00 00 01 00 02 68 c7 15 00 00 00 01 00 02 69 03 15 00 00 00 01 00 02 6a cf 15 00 00 00 01 00 02 6b 03 15 00 00 00 01 00 02 6c d5 15 00 00 00 01 00 02 6d 03 15 00 00 00 01 00 02 6e d8 15 00 00 00 01 00 02 6f 03 15 00 00 00 01 00 02 70 d9 15 00 00 00 01 00 02 71 02 15 00 00 00 01 00 02 72 2b 15 00 00 00 01 00 02 73 02 15 00 00 00 01 00 02 74 2c 15 00 00 00 01 00 02 75 02 15 00 00 00 01 00 02 76 2e 15 00 00 00 01 00 02 77 02 15 00 00 00 01 00 02 78 30 15 00 00 00 01 00 02 79 02 15 00 00 00 01 00 02 7a 31 15 00 00 00 01 00 02 7b 02 15 00 00 00 01 00 02 7c 33 15 00 00 00 01 00 02 7d 02 15 00 00 00 01 00 02 7e 35 15 00 00 00 01 00 02 7f 02 15 00 00 00 01 00 02 80 37 15 00 00 00 01 00 02 81 02 15 00 00 00 01 00 02 82 39 15 00 00 00 01 00 02 83 02 15 00 00 00 01 00 02 84 40 15 00 00 00 01 00 02 85 02 15 00 00 00 01 00 02 86 47 15 00 00 00 01 00 02 87 02 15 00 00 00 01 00 02 88 55 15 00 00 00 01 00 02 89 02 15 00 00 00 01 00 02 8a 62 15 00 00 00 01 00 02 8b 02 15 00 00 00 01 00 02 8c 7d 15 00 00 00 01 00 02 8d 02 15 00 00 00 01 00 02 8e 99 15 00 00 00 01 00 02 8f 02 15 00 00 00 01 00 02 90 9a 15 00 00 00 01 00 02 91 02 15 00 00 00 01 00 02 92 be 15 00 00 00 01 00 02 93 02 15 00 00 00 01 00 02 94 f0 15 00 00 00 01 00 02 95 03 15 00 00 00 01 00 02 96 0e 15 00 00 00 01 00 02 97 03 15 00 00 00 01 00 02 98 37 15 00 00 00 01 00 02 99 03 15 00 00 00 01 00 02 9a 6b 15 00 00 00 01 00 02 9b 03 15 00 00 00 01 00 02 9c b6 15 00 00 00 01 00 02 9d 03 15 00 00 00 01 00 02 9e be 15 00 00 00 01 00 02 9f 03 15 00 00 00 01 00 02 a0 c5 15 00 00 00 01 00 02 a2 03 15 00 00 00 01 00 02 a3 cb 15 00 00 00 01 00 02 a4 03 15 00 00 00 01 00 02 a5 d0 15 00 00 00 01 00 02 a6 03 15 00 00 00 01 00 02 a7 d4 15 00 00 00 01 00 02 a9 03 15 00 00 00 01 00 02 aa d7 15 00 00 00 01 00 02 ab 03 15 00 00 00 01 00 02 ac d8 15 00 00 00 01 00 02 ad 03 15 00 00 00 01 00 02 ae d9 15 00 00 00 01 00 02 af 02 15 00 00 00 01 00 02 b0 2b 15 00 00 00 01 00 02 b1 02 15 00 00 00 01 00 02 b2 2c 15 00 00 00 01 00 02 b3 02 15 00 00 00 01 00 02 b4 2e 15 00 00 00 01 00 02 b5 02 15 00 00 00 01 00 02 b6 30 15 00 00 00 01 00 02 b7 02 15 00 00 00 01 00 02 b8 31 15 00 00 00 01 00 02 b9 02 15 00 00 00 01 00 02 ba 33 15 00 00 00 01 00 02 bb 02 15 00 00 00 01 00 02 bc 35 15 00 00 00 01 00 02 bd 02 15 00 00 00 01 00 02 be 37 15 00 00 00 01 00 02 bf 02 15 00 00 00 01 00 02 c0 39 15 00 00 00 01 00 02 c1 02 15 00 00 00 01 00 02 c2 40 15 00 00 00 01 00 02 c3 02 15 00 00 00 01 00 02 c4 47 15 00 00 00 01 00 02 c5 02 15 00 00 00 01 00 02 c6 55 15 00 00 00 01 00 02 c7 02 15 00 00 00 01 00 02 c8 62 15 00 00 00 01 00 02 c9 02 15 00 00 00 01 00 02 ca 7d 15 00 00 00 01 00 02 cb 02 15 00 00 00 01 00 02 cc 99 15 00 00 00 01 00 02 cd 02 15 00 00 00 01 00 02 ce 9a 15 00 00 00 01 00 02 cf 02 15 00 00 00 01 00 02 d0 be 15 00 00 00 01 00 02 d1 02 15 00 00 00 01 00 02 d2 f0 15 00 00 00 01 00 02 d3 03 15 00 00 00 01 00 02 d4 0e 15 00 00 00 01 00 02 d5 03 15 00 00 00 01 00 02 d6 37 15 00 00 00 01 00 02 d7 03 15 00 00 00 01 00 02 d8 6b 15 00 00 00 01 00 02 d9 03 15 00 00 00 01 00 02 da b6 15 00 00 00 01 00 02 db 03 15 00 00 00 01 00 02 dc be 15 00 00 00 01 00 02 dd 03 15 00 00 00 01 00 02 de c5 15 00 00 00 01 00 02 df 03 15 00 00 00 01 00 02 e0 cb 15 00 00 00 01 00 02 e1 03 15 00 00 00 01 00 02 e2 d0 15 00 00 00 01 00 02 e3 03 15 00 00 00 01 00 02 e4 d4 15 00 00 00 01 00 02 e5 03 15 00 00 00 01 00 02 e6 d7 15 00 00 00 01 00 02 e7 03 15 00 00 00 01 00 02 e8 d8 15 00 00 00 01 00 02 e9 03 15 00 00 00 01 00 02 ea d9 15 00 00 00 01 00 02 fb 01 15 01 00 00 01 00 02 ff 10];
        qcom,mdss-dsi-dispparam-papermode-state = "dsi_hs_mode";
        qcom,mdss-dsi-dispparam-papermode1-command = [15 01 00 00 78 00 02 ff 20 15 00 00 00 01 00 02 fb 01 15 00 00 00 01 00 02 75 00 15 00 00 00 01 00 02 76 c8 15 00 00 00 01 00 02 77 00 15 00 00 00 01 00 02 78 d6 15 00 00 00 01 00 02 79 00 15 00 00 00 01 00 02 7a ed 15 00 00 00 01 00 02 7b 01 15 00 00 00 01 00 02 7c 00 15 00 00 00 01 00 02 7d 01 15 00 00 00 01 00 02 7e 10 15 00 00 00 01 00 02 7f 01 15 00 00 00 01 00 02 80 1e 15 00 00 00 01 00 02 81 01 15 00 00 00 01 00 02 82 2b 15 00 00 00 01 00 02 83 01 15 00 00 00 01 00 02 84 37 15 00 00 00 01 00 02 85 01 15 00 00 00 01 00 02 86 42 15 00 00 00 01 00 02 87 01 15 00 00 00 01 00 02 88 66 15 00 00 00 01 00 02 89 01 15 00 00 00 01 00 02 8a 84 15 00 00 00 01 00 02 8b 01 15 00 00 00 01 00 02 8c b4 15 00 00 00 01 00 02 8d 01 15 00 00 00 01 00 02 8e da 15 00 00 00 01 00 02 8f 02 15 00 00 00 01 00 02 90 15 15 00 00 00 01 00 02 91 02 15 00 00 00 01 00 02 92 45 15 00 00 00 01 00 02 93 02 15 00 00 00 01 00 02 94 46 15 00 00 00 01 00 02 95 02 15 00 00 00 01 00 02 96 72 15 00 00 00 01 00 02 97 02 15 00 00 00 01 00 02 98 a2 15 00 00 00 01 00 02 99 02 15 00 00 00 01 00 02 9a c4 15 00 00 00 01 00 02 9b 02 15 00 00 00 01 00 02 9c f0 15 00 00 00 01 00 02 9d 03 15 00 00 00 01 00 02 9e 0b 15 00 00 00 01 00 02 9f 03 15 00 00 00 01 00 02 a0 2d 15 00 00 00 01 00 02 a2 03 15 00 00 00 01 00 02 a3 38 15 00 00 00 01 00 02 a4 03 15 00 00 00 01 00 02 a5 46 15 00 00 00 01 00 02 a6 03 15 00 00 00 01 00 02 a7 5b 15 00 00 00 01 00 02 a9 03 15 00 00 00 01 00 02 aa 84 15 00 00 00 01 00 02 ab 03 15 00 00 00 01 00 02 ac 9e 15 00 00 00 01 00 02 ad 03 15 00 00 00 01 00 02 ae aa 15 00 00 00 01 00 02 af 03 15 00 00 00 01 00 02 b0 af 15 00 00 00 01 00 02 b1 03 15 00 00 00 01 00 02 b2 ff 15 00 00 00 01 00 02 b3 00 15 00 00 00 01 00 02 b4 c8 15 00 00 00 01 00 02 b5 00 15 00 00 00 01 00 02 b6 d6 15 00 00 00 01 00 02 b7 00 15 00 00 00 01 00 02 b8 ed 15 00 00 00 01 00 02 b9 01 15 00 00 00 01 00 02 ba 00 15 00 00 00 01 00 02 bb 01 15 00 00 00 01 00 02 bc 10 15 00 00 00 01 00 02 bd 01 15 00 00 00 01 00 02 be 1e 15 00 00 00 01 00 02 bf 01 15 00 00 00 01 00 02 c0 2b 15 00 00 00 01 00 02 c1 01 15 00 00 00 01 00 02 c2 37 15 00 00 00 01 00 02 c3 01 15 00 00 00 01 00 02 c4 42 15 00 00 00 01 00 02 c5 01 15 00 00 00 01 00 02 c6 66 15 00 00 00 01 00 02 c7 01 15 00 00 00 01 00 02 c8 84 15 00 00 00 01 00 02 c9 01 15 00 00 00 01 00 02 ca b4 15 00 00 00 01 00 02 cb 01 15 00 00 00 01 00 02 cc da 15 00 00 00 01 00 02 cd 02 15 00 00 00 01 00 02 ce 15 15 00 00 00 01 00 02 cf 02 15 00 00 00 01 00 02 d0 45 15 00 00 00 01 00 02 d1 02 15 00 00 00 01 00 02 d2 46 15 00 00 00 01 00 02 d3 02 15 00 00 00 01 00 02 d4 72 15 00 00 00 01 00 02 d5 02 15 00 00 00 01 00 02 d6 a2 15 00 00 00 01 00 02 d7 02 15 00 00 00 01 00 02 d8 c4 15 00 00 00 01 00 02 d9 02 15 00 00 00 01 00 02 da f0 15 00 00 00 01 00 02 db 03 15 00 00 00 01 00 02 dc 0b 15 00 00 00 01 00 02 dd 03 15 00 00 00 01 00 02 de 2d 15 00 00 00 01 00 02 df 03 15 00 00 00 01 00 02 e0 38 15 00 00 00 01 00 02 e1 03 15 00 00 00 01 00 02 e2 46 15 00 00 00 01 00 02 e3 03 15 00 00 00 01 00 02 e4 5b 15 00 00 00 01 00 02 e5 03 15 00 00 00 01 00 02 e6 84 15 00 00 00 01 00 02 e7 03 15 00 00 00 01 00 02 e8 9e 15 00 00 00 01 00 02 e9 03 15 00 00 00 01 00 02 ea aa 15 00 00 00 01 00 02 eb 03 15 00 00 00 01 00 02 ec af 15 00 00 00 01 00 02 ed 03 15 00 00 00 01 00 02 ee ff 15 00 00 00 01 00 02 ef 00 15 00 00 00 01 00 02 f0 9f 15 00 00 00 01 00 02 f1 00 15 00 00 00 01 00 02 f2 b8 15 00 00 00 01 00 02 f3 00 15 00 00 00 01 00 02 f4 d9 15 00 00 00 01 00 02 f5 00 15 00 00 00 01 00 02 f6 f1 15 00 00 00 01 00 02 f7 01 15 00 00 00 01 00 02 f8 05 15 00 00 00 01 00 02 f9 01 15 00 00 00 01 00 02 fa 16 15 00 00 00 01 00 02 ff 21 15 00 00 00 01 00 02 fb 01 15 00 00 00 01 00 02 00 01 15 00 00 00 01 00 02 01 25 15 00 00 00 01 00 02 02 01 15 00 00 00 01 00 02 03 32 15 00 00 00 01 00 02 04 01 15 00 00 00 01 00 02 05 3f 15 00 00 00 01 00 02 06 01 15 00 00 00 01 00 02 07 67 15 00 00 00 01 00 02 08 01 15 00 00 00 01 00 02 09 87 15 00 00 00 01 00 02 0a 01 15 00 00 00 01 00 02 0b ba 15 00 00 00 01 00 02 0c 01 15 00 00 00 01 00 02 0d e2 15 00 00 00 01 00 02 0e 02 15 00 00 00 01 00 02 0f 1f 15 00 00 00 01 00 02 10 02 15 00 00 00 01 00 02 11 50 15 00 00 00 01 00 02 12 02 15 00 00 00 01 00 02 13 51 15 00 00 00 01 00 02 14 02 15 00 00 00 01 00 02 15 7f 15 00 00 00 01 00 02 16 02 15 00 00 00 01 00 02 17 b2 15 00 00 00 01 00 02 18 02 15 00 00 00 01 00 02 19 da 15 00 00 00 01 00 02 1a 03 15 00 00 00 01 00 02 1b 02 15 00 00 00 01 00 02 1c 03 15 00 00 00 01 00 02 1d 1d 15 00 00 00 01 00 02 1e 03 15 00 00 00 01 00 02 1f 59 15 00 00 00 01 00 02 20 03 15 00 00 00 01 00 02 21 9e 15 00 00 00 01 00 02 22 03 15 00 00 00 01 00 02 23 b1 15 00 00 00 01 00 02 24 03 15 00 00 00 01 00 02 25 bd 15 00 00 00 01 00 02 26 03 15 00 00 00 01 00 02 27 c7 15 00 00 00 01 00 02 28 03 15 00 00 00 01 00 02 29 cf 15 00 00 00 01 00 02 2a 03 15 00 00 00 01 00 02 2b d5 15 00 00 00 01 00 02 2d 03 15 00 00 00 01 00 02 2f d8 15 00 00 00 01 00 02 30 03 15 00 00 00 01 00 02 31 d9 15 00 00 00 01 00 02 32 00 15 00 00 00 01 00 02 33 9f 15 00 00 00 01 00 02 34 00 15 00 00 00 01 00 02 35 b8 15 00 00 00 01 00 02 36 00 15 00 00 00 01 00 02 37 d9 15 00 00 00 01 00 02 38 00 15 00 00 00 01 00 02 39 f1 15 00 00 00 01 00 02 3a 01 15 00 00 00 01 00 02 3b 05 15 00 00 00 01 00 02 3d 01 15 00 00 00 01 00 02 3f 16 15 00 00 00 01 00 02 40 01 15 00 00 00 01 00 02 41 25 15 00 00 00 01 00 02 42 01 15 00 00 00 01 00 02 43 32 15 00 00 00 01 00 02 44 01 15 00 00 00 01 00 02 45 3f 15 00 00 00 01 00 02 46 01 15 00 00 00 01 00 02 47 67 15 00 00 00 01 00 02 48 01 15 00 00 00 01 00 02 49 87 15 00 00 00 01 00 02 4a 01 15 00 00 00 01 00 02 4b ba 15 00 00 00 01 00 02 4c 01 15 00 00 00 01 00 02 4d e2 15 00 00 00 01 00 02 4e 02 15 00 00 00 01 00 02 4f 1f 15 00 00 00 01 00 02 50 02 15 00 00 00 01 00 02 51 50 15 00 00 00 01 00 02 52 02 15 00 00 00 01 00 02 53 51 15 00 00 00 01 00 02 54 02 15 00 00 00 01 00 02 55 7f 15 00 00 00 01 00 02 56 02 15 00 00 00 01 00 02 58 b2 15 00 00 00 01 00 02 59 02 15 00 00 00 01 00 02 5a da 15 00 00 00 01 00 02 5b 03 15 00 00 00 01 00 02 5c 02 15 00 00 00 01 00 02 5d 03 15 00 00 00 01 00 02 5e 1d 15 00 00 00 01 00 02 5f 03 15 00 00 00 01 00 02 60 59 15 00 00 00 01 00 02 61 03 15 00 00 00 01 00 02 62 9e 15 00 00 00 01 00 02 63 03 15 00 00 00 01 00 02 64 b1 15 00 00 00 01 00 02 65 03 15 00 00 00 01 00 02 66 bd 15 00 00 00 01 00 02 67 03 15 00 00 00 01 00 02 68 c7 15 00 00 00 01 00 02 69 03 15 00 00 00 01 00 02 6a cf 15 00 00 00 01 00 02 6b 03 15 00 00 00 01 00 02 6c d5 15 00 00 00 01 00 02 6d 03 15 00 00 00 01 00 02 6e d8 15 00 00 00 01 00 02 6f 03 15 00 00 00 01 00 02 70 d9 15 00 00 00 01 00 02 71 01 15 00 00 00 01 00 02 72 79 15 00 00 00 01 00 02 73 01 15 00 00 00 01 00 02 74 7a 15 00 00 00 01 00 02 75 01 15 00 00 00 01 00 02 76 7b 15 00 00 00 01 00 02 77 01 15 00 00 00 01 00 02 78 82 15 00 00 00 01 00 02 79 01 15 00 00 00 01 00 02 7a 89 15 00 00 00 01 00 02 7b 01 15 00 00 00 01 00 02 7c 8f 15 00 00 00 01 00 02 7d 01 15 00 00 00 01 00 02 7e 95 15 00 00 00 01 00 02 7f 01 15 00 00 00 01 00 02 80 9b 15 00 00 00 01 00 02 81 01 15 00 00 00 01 00 02 82 a1 15 00 00 00 01 00 02 83 01 15 00 00 00 01 00 02 84 b7 15 00 00 00 01 00 02 85 01 15 00 00 00 01 00 02 86 ca 15 00 00 00 01 00 02 87 01 15 00 00 00 01 00 02 88 ec 15 00 00 00 01 00 02 89 02 15 00 00 00 01 00 02 8a 08 15 00 00 00 01 00 02 8b 02 15 00 00 00 01 00 02 8c 38 15 00 00 00 01 00 02 8d 02 15 00 00 00 01 00 02 8e 62 15 00 00 00 01 00 02 8f 02 15 00 00 00 01 00 02 90 63 15 00 00 00 01 00 02 91 02 15 00 00 00 01 00 02 92 8c 15 00 00 00 01 00 02 93 02 15 00 00 00 01 00 02 94 c0 15 00 00 00 01 00 02 95 02 15 00 00 00 01 00 02 96 e5 15 00 00 00 01 00 02 97 03 15 00 00 00 01 00 02 98 0b 15 00 00 00 01 00 02 99 03 15 00 00 00 01 00 02 9a 26 15 00 00 00 01 00 02 9b 03 15 00 00 00 01 00 02 9c 97 15 00 00 00 01 00 02 9d 03 15 00 00 00 01 00 02 9e ab 15 00 00 00 01 00 02 9f 03 15 00 00 00 01 00 02 a0 b8 15 00 00 00 01 00 02 a2 03 15 00 00 00 01 00 02 a3 c2 15 00 00 00 01 00 02 a4 03 15 00 00 00 01 00 02 a5 ca 15 00 00 00 01 00 02 a6 03 15 00 00 00 01 00 02 a7 d1 15 00 00 00 01 00 02 a9 03 15 00 00 00 01 00 02 aa d5 15 00 00 00 01 00 02 ab 03 15 00 00 00 01 00 02 ac d8 15 00 00 00 01 00 02 ad 03 15 00 00 00 01 00 02 ae d9 15 00 00 00 01 00 02 af 01 15 00 00 00 01 00 02 b0 79 15 00 00 00 01 00 02 b1 01 15 00 00 00 01 00 02 b2 7a 15 00 00 00 01 00 02 b3 01 15 00 00 00 01 00 02 b4 7b 15 00 00 00 01 00 02 b5 01 15 00 00 00 01 00 02 b6 82 15 00 00 00 01 00 02 b7 01 15 00 00 00 01 00 02 b8 89 15 00 00 00 01 00 02 b9 01 15 00 00 00 01 00 02 ba 8f 15 00 00 00 01 00 02 bb 01 15 00 00 00 01 00 02 bc 95 15 00 00 00 01 00 02 bd 01 15 00 00 00 01 00 02 be 9b 15 00 00 00 01 00 02 bf 01 15 00 00 00 01 00 02 c0 a1 15 00 00 00 01 00 02 c1 01 15 00 00 00 01 00 02 c2 b7 15 00 00 00 01 00 02 c3 01 15 00 00 00 01 00 02 c4 ca 15 00 00 00 01 00 02 c5 01 15 00 00 00 01 00 02 c6 ec 15 00 00 00 01 00 02 c7 02 15 00 00 00 01 00 02 c8 08 15 00 00 00 01 00 02 c9 02 15 00 00 00 01 00 02 ca 38 15 00 00 00 01 00 02 cb 02 15 00 00 00 01 00 02 cc 62 15 00 00 00 01 00 02 cd 02 15 00 00 00 01 00 02 ce 63 15 00 00 00 01 00 02 cf 02 15 00 00 00 01 00 02 d0 8c 15 00 00 00 01 00 02 d1 02 15 00 00 00 01 00 02 d2 c0 15 00 00 00 01 00 02 d3 02 15 00 00 00 01 00 02 d4 e5 15 00 00 00 01 00 02 d5 03 15 00 00 00 01 00 02 d6 0b 15 00 00 00 01 00 02 d7 03 15 00 00 00 01 00 02 d8 26 15 00 00 00 01 00 02 d9 03 15 00 00 00 01 00 02 da 97 15 00 00 00 01 00 02 db 03 15 00 00 00 01 00 02 dc ab 15 00 00 00 01 00 02 dd 03 15 00 00 00 01 00 02 de b8 15 00 00 00 01 00 02 df 03 15 00 00 00 01 00 02 e0 c2 15 00 00 00 01 00 02 e1 03 15 00 00 00 01 00 02 e2 ca 15 00 00 00 01 00 02 e3 03 15 00 00 00 01 00 02 e4 d1 15 00 00 00 01 00 02 e5 03 15 00 00 00 01 00 02 e6 d5 15 00 00 00 01 00 02 e7 03 15 00 00 00 01 00 02 e8 d8 15 00 00 00 01 00 02 e9 03 15 00 00 00 01 00 02 ea d9 15 00 00 00 01 00 02 fb 01 15 01 00 00 01 00 02 ff 10];
        qcom,mdss-dsi-dispparam-papermode1-state = "dsi_hs_mode";
        qcom,mdss-dsi-dispparam-papermode2-command = [15 01 00 00 78 00 02 ff 20 15 00 00 00 01 00 02 fb 01 15 00 00 00 01 00 02 75 00 15 00 00 00 01 00 02 76 c8 15 00 00 00 01 00 02 77 00 15 00 00 00 01 00 02 78 d6 15 00 00 00 01 00 02 79 00 15 00 00 00 01 00 02 7a ed 15 00 00 00 01 00 02 7b 01 15 00 00 00 01 00 02 7c 00 15 00 00 00 01 00 02 7d 01 15 00 00 00 01 00 02 7e 10 15 00 00 00 01 00 02 7f 01 15 00 00 00 01 00 02 80 1e 15 00 00 00 01 00 02 81 01 15 00 00 00 01 00 02 82 2b 15 00 00 00 01 00 02 83 01 15 00 00 00 01 00 02 84 37 15 00 00 00 01 00 02 85 01 15 00 00 00 01 00 02 86 42 15 00 00 00 01 00 02 87 01 15 00 00 00 01 00 02 88 66 15 00 00 00 01 00 02 89 01 15 00 00 00 01 00 02 8a 84 15 00 00 00 01 00 02 8b 01 15 00 00 00 01 00 02 8c b4 15 00 00 00 01 00 02 8d 01 15 00 00 00 01 00 02 8e da 15 00 00 00 01 00 02 8f 02 15 00 00 00 01 00 02 90 15 15 00 00 00 01 00 02 91 02 15 00 00 00 01 00 02 92 45 15 00 00 00 01 00 02 93 02 15 00 00 00 01 00 02 94 46 15 00 00 00 01 00 02 95 02 15 00 00 00 01 00 02 96 72 15 00 00 00 01 00 02 97 02 15 00 00 00 01 00 02 98 a2 15 00 00 00 01 00 02 99 02 15 00 00 00 01 00 02 9a c4 15 00 00 00 01 00 02 9b 02 15 00 00 00 01 00 02 9c f0 15 00 00 00 01 00 02 9d 03 15 00 00 00 01 00 02 9e 0b 15 00 00 00 01 00 02 9f 03 15 00 00 00 01 00 02 a0 2d 15 00 00 00 01 00 02 a2 03 15 00 00 00 01 00 02 a3 38 15 00 00 00 01 00 02 a4 03 15 00 00 00 01 00 02 a5 46 15 00 00 00 01 00 02 a6 03 15 00 00 00 01 00 02 a7 5b 15 00 00 00 01 00 02 a9 03 15 00 00 00 01 00 02 aa 84 15 00 00 00 01 00 02 ab 03 15 00 00 00 01 00 02 ac 9e 15 00 00 00 01 00 02 ad 03 15 00 00 00 01 00 02 ae aa 15 00 00 00 01 00 02 af 03 15 00 00 00 01 00 02 b0 af 15 00 00 00 01 00 02 b1 03 15 00 00 00 01 00 02 b2 ff 15 00 00 00 01 00 02 b3 00 15 00 00 00 01 00 02 b4 c8 15 00 00 00 01 00 02 b5 00 15 00 00 00 01 00 02 b6 d6 15 00 00 00 01 00 02 b7 00 15 00 00 00 01 00 02 b8 ed 15 00 00 00 01 00 02 b9 01 15 00 00 00 01 00 02 ba 00 15 00 00 00 01 00 02 bb 01 15 00 00 00 01 00 02 bc 10 15 00 00 00 01 00 02 bd 01 15 00 00 00 01 00 02 be 1e 15 00 00 00 01 00 02 bf 01 15 00 00 00 01 00 02 c0 2b 15 00 00 00 01 00 02 c1 01 15 00 00 00 01 00 02 c2 37 15 00 00 00 01 00 02 c3 01 15 00 00 00 01 00 02 c4 42 15 00 00 00 01 00 02 c5 01 15 00 00 00 01 00 02 c6 66 15 00 00 00 01 00 02 c7 01 15 00 00 00 01 00 02 c8 84 15 00 00 00 01 00 02 c9 01 15 00 00 00 01 00 02 ca b4 15 00 00 00 01 00 02 cb 01 15 00 00 00 01 00 02 cc da 15 00 00 00 01 00 02 cd 02 15 00 00 00 01 00 02 ce 15 15 00 00 00 01 00 02 cf 02 15 00 00 00 01 00 02 d0 45 15 00 00 00 01 00 02 d1 02 15 00 00 00 01 00 02 d2 46 15 00 00 00 01 00 02 d3 02 15 00 00 00 01 00 02 d4 72 15 00 00 00 01 00 02 d5 02 15 00 00 00 01 00 02 d6 a2 15 00 00 00 01 00 02 d7 02 15 00 00 00 01 00 02 d8 c4 15 00 00 00 01 00 02 d9 02 15 00 00 00 01 00 02 da f0 15 00 00 00 01 00 02 db 03 15 00 00 00 01 00 02 dc 0b 15 00 00 00 01 00 02 dd 03 15 00 00 00 01 00 02 de 2d 15 00 00 00 01 00 02 df 03 15 00 00 00 01 00 02 e0 38 15 00 00 00 01 00 02 e1 03 15 00 00 00 01 00 02 e2 46 15 00 00 00 01 00 02 e3 03 15 00 00 00 01 00 02 e4 5b 15 00 00 00 01 00 02 e5 03 15 00 00 00 01 00 02 e6 84 15 00 00 00 01 00 02 e7 03 15 00 00 00 01 00 02 e8 9e 15 00 00 00 01 00 02 e9 03 15 00 00 00 01 00 02 ea aa 15 00 00 00 01 00 02 eb 03 15 00 00 00 01 00 02 ec af 15 00 00 00 01 00 02 ed 03 15 00 00 00 01 00 02 ee ff 15 00 00 00 01 00 02 ef 00 15 00 00 00 01 00 02 f0 9f 15 00 00 00 01 00 02 f1 00 15 00 00 00 01 00 02 f2 b8 15 00 00 00 01 00 02 f3 00 15 00 00 00 01 00 02 f4 d9 15 00 00 00 01 00 02 f5 00 15 00 00 00 01 00 02 f6 f1 15 00 00 00 01 00 02 f7 01 15 00 00 00 01 00 02 f8 05 15 00 00 00 01 00 02 f9 01 15 00 00 00 01 00 02 fa 16 15 00 00 00 01 00 02 ff 21 15 00 00 00 01 00 02 fb 01 15 00 00 00 01 00 02 00 01 15 00 00 00 01 00 02 01 25 15 00 00 00 01 00 02 02 01 15 00 00 00 01 00 02 03 32 15 00 00 00 01 00 02 04 01 15 00 00 00 01 00 02 05 3f 15 00 00 00 01 00 02 06 01 15 00 00 00 01 00 02 07 67 15 00 00 00 01 00 02 08 01 15 00 00 00 01 00 02 09 87 15 00 00 00 01 00 02 0a 01 15 00 00 00 01 00 02 0b ba 15 00 00 00 01 00 02 0c 01 15 00 00 00 01 00 02 0d e2 15 00 00 00 01 00 02 0e 02 15 00 00 00 01 00 02 0f 1f 15 00 00 00 01 00 02 10 02 15 00 00 00 01 00 02 11 50 15 00 00 00 01 00 02 12 02 15 00 00 00 01 00 02 13 51 15 00 00 00 01 00 02 14 02 15 00 00 00 01 00 02 15 7f 15 00 00 00 01 00 02 16 02 15 00 00 00 01 00 02 17 b2 15 00 00 00 01 00 02 18 02 15 00 00 00 01 00 02 19 da 15 00 00 00 01 00 02 1a 03 15 00 00 00 01 00 02 1b 02 15 00 00 00 01 00 02 1c 03 15 00 00 00 01 00 02 1d 1d 15 00 00 00 01 00 02 1e 03 15 00 00 00 01 00 02 1f 59 15 00 00 00 01 00 02 20 03 15 00 00 00 01 00 02 21 9e 15 00 00 00 01 00 02 22 03 15 00 00 00 01 00 02 23 b1 15 00 00 00 01 00 02 24 03 15 00 00 00 01 00 02 25 bd 15 00 00 00 01 00 02 26 03 15 00 00 00 01 00 02 27 c7 15 00 00 00 01 00 02 28 03 15 00 00 00 01 00 02 29 cf 15 00 00 00 01 00 02 2a 03 15 00 00 00 01 00 02 2b d5 15 00 00 00 01 00 02 2d 03 15 00 00 00 01 00 02 2f d8 15 00 00 00 01 00 02 30 03 15 00 00 00 01 00 02 31 d9 15 00 00 00 01 00 02 32 00 15 00 00 00 01 00 02 33 9f 15 00 00 00 01 00 02 34 00 15 00 00 00 01 00 02 35 b8 15 00 00 00 01 00 02 36 00 15 00 00 00 01 00 02 37 d9 15 00 00 00 01 00 02 38 00 15 00 00 00 01 00 02 39 f1 15 00 00 00 01 00 02 3a 01 15 00 00 00 01 00 02 3b 05 15 00 00 00 01 00 02 3d 01 15 00 00 00 01 00 02 3f 16 15 00 00 00 01 00 02 40 01 15 00 00 00 01 00 02 41 25 15 00 00 00 01 00 02 42 01 15 00 00 00 01 00 02 43 32 15 00 00 00 01 00 02 44 01 15 00 00 00 01 00 02 45 3f 15 00 00 00 01 00 02 46 01 15 00 00 00 01 00 02 47 67 15 00 00 00 01 00 02 48 01 15 00 00 00 01 00 02 49 87 15 00 00 00 01 00 02 4a 01 15 00 00 00 01 00 02 4b ba 15 00 00 00 01 00 02 4c 01 15 00 00 00 01 00 02 4d e2 15 00 00 00 01 00 02 4e 02 15 00 00 00 01 00 02 4f 1f 15 00 00 00 01 00 02 50 02 15 00 00 00 01 00 02 51 50 15 00 00 00 01 00 02 52 02 15 00 00 00 01 00 02 53 51 15 00 00 00 01 00 02 54 02 15 00 00 00 01 00 02 55 7f 15 00 00 00 01 00 02 56 02 15 00 00 00 01 00 02 58 b2 15 00 00 00 01 00 02 59 02 15 00 00 00 01 00 02 5a da 15 00 00 00 01 00 02 5b 03 15 00 00 00 01 00 02 5c 02 15 00 00 00 01 00 02 5d 03 15 00 00 00 01 00 02 5e 1d 15 00 00 00 01 00 02 5f 03 15 00 00 00 01 00 02 60 59 15 00 00 00 01 00 02 61 03 15 00 00 00 01 00 02 62 9e 15 00 00 00 01 00 02 63 03 15 00 00 00 01 00 02 64 b1 15 00 00 00 01 00 02 65 03 15 00 00 00 01 00 02 66 bd 15 00 00 00 01 00 02 67 03 15 00 00 00 01 00 02 68 c7 15 00 00 00 01 00 02 69 03 15 00 00 00 01 00 02 6a cf 15 00 00 00 01 00 02 6b 03 15 00 00 00 01 00 02 6c d5 15 00 00 00 01 00 02 6d 03 15 00 00 00 01 00 02 6e d8 15 00 00 00 01 00 02 6f 03 15 00 00 00 01 00 02 70 d9 15 00 00 00 01 00 02 71 01 15 00 00 00 01 00 02 72 8b 15 00 00 00 01 00 02 73 01 15 00 00 00 01 00 02 74 8e 15 00 00 00 01 00 02 75 01 15 00 00 00 01 00 02 76 94 15 00 00 00 01 00 02 77 01 15 00 00 00 01 00 02 78 9a 15 00 00 00 01 00 02 79 01 15 00 00 00 01 00 02 7a a0 15 00 00 00 01 00 02 7b 01 15 00 00 00 01 00 02 7c a5 15 00 00 00 01 00 02 7d 01 15 00 00 00 01 00 02 7e aa 15 00 00 00 01 00 02 7f 01 15 00 00 00 01 00 02 80 b0 15 00 00 00 01 00 02 81 01 15 00 00 00 01 00 02 82 b5 15 00 00 00 01 00 02 83 01 15 00 00 00 01 00 02 84 c8 15 00 00 00 01 00 02 85 01 15 00 00 00 01 00 02 86 d9 15 00 00 00 01 00 02 87 01 15 00 00 00 01 00 02 88 f7 15 00 00 00 01 00 02 89 02 15 00 00 00 01 00 02 8a 11 15 00 00 00 01 00 02 8b 02 15 00 00 00 01 00 02 8c 3f 15 00 00 00 01 00 02 8d 02 15 00 00 00 01 00 02 8e 67 15 00 00 00 01 00 02 8f 02 15 00 00 00 01 00 02 90 68 15 00 00 00 01 00 02 91 02 15 00 00 00 01 00 02 92 90 15 00 00 00 01 00 02 93 02 15 00 00 00 01 00 02 94 c4 15 00 00 00 01 00 02 95 02 15 00 00 00 01 00 02 96 e8 15 00 00 00 01 00 02 97 03 15 00 00 00 01 00 02 98 0e 15 00 00 00 01 00 02 99 03 15 00 00 00 01 00 02 9a 29 15 00 00 00 01 00 02 9b 03 15 00 00 00 01 00 02 9c 9d 15 00 00 00 01 00 02 9d 03 15 00 00 00 01 00 02 9e ae 15 00 00 00 01 00 02 9f 03 15 00 00 00 01 00 02 a0 ba 15 00 00 00 01 00 02 a2 03 15 00 00 00 01 00 02 a3 c3 15 00 00 00 01 00 02 a4 03 15 00 00 00 01 00 02 a5 cb 15 00 00 00 01 00 02 a6 03 15 00 00 00 01 00 02 a7 d1 15 00 00 00 01 00 02 a9 03 15 00 00 00 01 00 02 aa d6 15 00 00 00 01 00 02 ab 03 15 00 00 00 01 00 02 ac d8 15 00 00 00 01 00 02 ad 03 15 00 00 00 01 00 02 ae d9 15 00 00 00 01 00 02 af 01 15 00 00 00 01 00 02 b0 8b 15 00 00 00 01 00 02 b1 01 15 00 00 00 01 00 02 b2 8e 15 00 00 00 01 00 02 b3 01 15 00 00 00 01 00 02 b4 94 15 00 00 00 01 00 02 b5 01 15 00 00 00 01 00 02 b6 9a 15 00 00 00 01 00 02 b7 01 15 00 00 00 01 00 02 b8 a0 15 00 00 00 01 00 02 b9 01 15 00 00 00 01 00 02 ba a5 15 00 00 00 01 00 02 bb 01 15 00 00 00 01 00 02 bc aa 15 00 00 00 01 00 02 bd 01 15 00 00 00 01 00 02 be b0 15 00 00 00 01 00 02 bf 01 15 00 00 00 01 00 02 c0 b5 15 00 00 00 01 00 02 c1 01 15 00 00 00 01 00 02 c2 c8 15 00 00 00 01 00 02 c3 01 15 00 00 00 01 00 02 c4 d9 15 00 00 00 01 00 02 c5 01 15 00 00 00 01 00 02 c6 f7 15 00 00 00 01 00 02 c7 02 15 00 00 00 01 00 02 c8 11 15 00 00 00 01 00 02 c9 02 15 00 00 00 01 00 02 ca 3f 15 00 00 00 01 00 02 cb 02 15 00 00 00 01 00 02 cc 67 15 00 00 00 01 00 02 cd 02 15 00 00 00 01 00 02 ce 68 15 00 00 00 01 00 02 cf 02 15 00 00 00 01 00 02 d0 90 15 00 00 00 01 00 02 d1 02 15 00 00 00 01 00 02 d2 c4 15 00 00 00 01 00 02 d3 02 15 00 00 00 01 00 02 d4 e8 15 00 00 00 01 00 02 d5 03 15 00 00 00 01 00 02 d6 0e 15 00 00 00 01 00 02 d7 03 15 00 00 00 01 00 02 d8 29 15 00 00 00 01 00 02 d9 03 15 00 00 00 01 00 02 da 9d 15 00 00 00 01 00 02 db 03 15 00 00 00 01 00 02 dc ae 15 00 00 00 01 00 02 dd 03 15 00 00 00 01 00 02 de ba 15 00 00 00 01 00 02 df 03 15 00 00 00 01 00 02 e0 c3 15 00 00 00 01 00 02 e1 03 15 00 00 00 01 00 02 e2 cb 15 00 00 00 01 00 02 e3 03 15 00 00 00 01 00 02 e4 d1 15 00 00 00 01 00 02 e5 03 15 00 00 00 01 00 02 e6 d6 15 00 00 00 01 00 02 e7 03 15 00 00 00 01 00 02 e8 d8 15 00 00 00 01 00 02 e9 03 15 00 00 00 01 00 02 ea d9 15 00 00 00 01 00 02 fb 01 15 01 00 00 01 00 02 ff 10];
        qcom,mdss-dsi-dispparam-papermode2-state = "dsi_hs_mode";
        qcom,mdss-dsi-dispparam-papermode3-command = [15 01 00 00 78 00 02 ff 20 15 00 00 00 01 00 02 fb 01 15 00 00 00 01 00 02 75 00 15 00 00 00 01 00 02 76 c8 15 00 00 00 01 00 02 77 00 15 00 00 00 01 00 02 78 d6 15 00 00 00 01 00 02 79 00 15 00 00 00 01 00 02 7a ed 15 00 00 00 01 00 02 7b 01 15 00 00 00 01 00 02 7c 00 15 00 00 00 01 00 02 7d 01 15 00 00 00 01 00 02 7e 10 15 00 00 00 01 00 02 7f 01 15 00 00 00 01 00 02 80 1e 15 00 00 00 01 00 02 81 01 15 00 00 00 01 00 02 82 2b 15 00 00 00 01 00 02 83 01 15 00 00 00 01 00 02 84 37 15 00 00 00 01 00 02 85 01 15 00 00 00 01 00 02 86 42 15 00 00 00 01 00 02 87 01 15 00 00 00 01 00 02 88 66 15 00 00 00 01 00 02 89 01 15 00 00 00 01 00 02 8a 84 15 00 00 00 01 00 02 8b 01 15 00 00 00 01 00 02 8c b4 15 00 00 00 01 00 02 8d 01 15 00 00 00 01 00 02 8e da 15 00 00 00 01 00 02 8f 02 15 00 00 00 01 00 02 90 15 15 00 00 00 01 00 02 91 02 15 00 00 00 01 00 02 92 45 15 00 00 00 01 00 02 93 02 15 00 00 00 01 00 02 94 46 15 00 00 00 01 00 02 95 02 15 00 00 00 01 00 02 96 72 15 00 00 00 01 00 02 97 02 15 00 00 00 01 00 02 98 a2 15 00 00 00 01 00 02 99 02 15 00 00 00 01 00 02 9a c4 15 00 00 00 01 00 02 9b 02 15 00 00 00 01 00 02 9c f0 15 00 00 00 01 00 02 9d 03 15 00 00 00 01 00 02 9e 0b 15 00 00 00 01 00 02 9f 03 15 00 00 00 01 00 02 a0 2d 15 00 00 00 01 00 02 a2 03 15 00 00 00 01 00 02 a3 38 15 00 00 00 01 00 02 a4 03 15 00 00 00 01 00 02 a5 46 15 00 00 00 01 00 02 a6 03 15 00 00 00 01 00 02 a7 5b 15 00 00 00 01 00 02 a9 03 15 00 00 00 01 00 02 aa 84 15 00 00 00 01 00 02 ab 03 15 00 00 00 01 00 02 ac 9e 15 00 00 00 01 00 02 ad 03 15 00 00 00 01 00 02 ae aa 15 00 00 00 01 00 02 af 03 15 00 00 00 01 00 02 b0 af 15 00 00 00 01 00 02 b1 03 15 00 00 00 01 00 02 b2 ff 15 00 00 00 01 00 02 b3 00 15 00 00 00 01 00 02 b4 c8 15 00 00 00 01 00 02 b5 00 15 00 00 00 01 00 02 b6 d6 15 00 00 00 01 00 02 b7 00 15 00 00 00 01 00 02 b8 ed 15 00 00 00 01 00 02 b9 01 15 00 00 00 01 00 02 ba 00 15 00 00 00 01 00 02 bb 01 15 00 00 00 01 00 02 bc 10 15 00 00 00 01 00 02 bd 01 15 00 00 00 01 00 02 be 1e 15 00 00 00 01 00 02 bf 01 15 00 00 00 01 00 02 c0 2b 15 00 00 00 01 00 02 c1 01 15 00 00 00 01 00 02 c2 37 15 00 00 00 01 00 02 c3 01 15 00 00 00 01 00 02 c4 42 15 00 00 00 01 00 02 c5 01 15 00 00 00 01 00 02 c6 66 15 00 00 00 01 00 02 c7 01 15 00 00 00 01 00 02 c8 84 15 00 00 00 01 00 02 c9 01 15 00 00 00 01 00 02 ca b4 15 00 00 00 01 00 02 cb 01 15 00 00 00 01 00 02 cc da 15 00 00 00 01 00 02 cd 02 15 00 00 00 01 00 02 ce 15 15 00 00 00 01 00 02 cf 02 15 00 00 00 01 00 02 d0 45 15 00 00 00 01 00 02 d1 02 15 00 00 00 01 00 02 d2 46 15 00 00 00 01 00 02 d3 02 15 00 00 00 01 00 02 d4 72 15 00 00 00 01 00 02 d5 02 15 00 00 00 01 00 02 d6 a2 15 00 00 00 01 00 02 d7 02 15 00 00 00 01 00 02 d8 c4 15 00 00 00 01 00 02 d9 02 15 00 00 00 01 00 02 da f0 15 00 00 00 01 00 02 db 03 15 00 00 00 01 00 02 dc 0b 15 00 00 00 01 00 02 dd 03 15 00 00 00 01 00 02 de 2d 15 00 00 00 01 00 02 df 03 15 00 00 00 01 00 02 e0 38 15 00 00 00 01 00 02 e1 03 15 00 00 00 01 00 02 e2 46 15 00 00 00 01 00 02 e3 03 15 00 00 00 01 00 02 e4 5b 15 00 00 00 01 00 02 e5 03 15 00 00 00 01 00 02 e6 84 15 00 00 00 01 00 02 e7 03 15 00 00 00 01 00 02 e8 9e 15 00 00 00 01 00 02 e9 03 15 00 00 00 01 00 02 ea aa 15 00 00 00 01 00 02 eb 03 15 00 00 00 01 00 02 ec af 15 00 00 00 01 00 02 ed 03 15 00 00 00 01 00 02 ee ff 15 00 00 00 01 00 02 ef 00 15 00 00 00 01 00 02 f0 9f 15 00 00 00 01 00 02 f1 00 15 00 00 00 01 00 02 f2 b8 15 00 00 00 01 00 02 f3 00 15 00 00 00 01 00 02 f4 d9 15 00 00 00 01 00 02 f5 00 15 00 00 00 01 00 02 f6 f1 15 00 00 00 01 00 02 f7 01 15 00 00 00 01 00 02 f8 05 15 00 00 00 01 00 02 f9 01 15 00 00 00 01 00 02 fa 16 15 00 00 00 01 00 02 ff 21 15 00 00 00 01 00 02 fb 01 15 00 00 00 01 00 02 00 01 15 00 00 00 01 00 02 01 25 15 00 00 00 01 00 02 02 01 15 00 00 00 01 00 02 03 32 15 00 00 00 01 00 02 04 01 15 00 00 00 01 00 02 05 3f 15 00 00 00 01 00 02 06 01 15 00 00 00 01 00 02 07 67 15 00 00 00 01 00 02 08 01 15 00 00 00 01 00 02 09 87 15 00 00 00 01 00 02 0a 01 15 00 00 00 01 00 02 0b ba 15 00 00 00 01 00 02 0c 01 15 00 00 00 01 00 02 0d e2 15 00 00 00 01 00 02 0e 02 15 00 00 00 01 00 02 0f 1f 15 00 00 00 01 00 02 10 02 15 00 00 00 01 00 02 11 50 15 00 00 00 01 00 02 12 02 15 00 00 00 01 00 02 13 51 15 00 00 00 01 00 02 14 02 15 00 00 00 01 00 02 15 7f 15 00 00 00 01 00 02 16 02 15 00 00 00 01 00 02 17 b2 15 00 00 00 01 00 02 18 02 15 00 00 00 01 00 02 19 da 15 00 00 00 01 00 02 1a 03 15 00 00 00 01 00 02 1b 02 15 00 00 00 01 00 02 1c 03 15 00 00 00 01 00 02 1d 1d 15 00 00 00 01 00 02 1e 03 15 00 00 00 01 00 02 1f 59 15 00 00 00 01 00 02 20 03 15 00 00 00 01 00 02 21 9e 15 00 00 00 01 00 02 22 03 15 00 00 00 01 00 02 23 b1 15 00 00 00 01 00 02 24 03 15 00 00 00 01 00 02 25 bd 15 00 00 00 01 00 02 26 03 15 00 00 00 01 00 02 27 c7 15 00 00 00 01 00 02 28 03 15 00 00 00 01 00 02 29 cf 15 00 00 00 01 00 02 2a 03 15 00 00 00 01 00 02 2b d5 15 00 00 00 01 00 02 2d 03 15 00 00 00 01 00 02 2f d8 15 00 00 00 01 00 02 30 03 15 00 00 00 01 00 02 31 d9 15 00 00 00 01 00 02 32 00 15 00 00 00 01 00 02 33 9f 15 00 00 00 01 00 02 34 00 15 00 00 00 01 00 02 35 b8 15 00 00 00 01 00 02 36 00 15 00 00 00 01 00 02 37 d9 15 00 00 00 01 00 02 38 00 15 00 00 00 01 00 02 39 f1 15 00 00 00 01 00 02 3a 01 15 00 00 00 01 00 02 3b 05 15 00 00 00 01 00 02 3d 01 15 00 00 00 01 00 02 3f 16 15 00 00 00 01 00 02 40 01 15 00 00 00 01 00 02 41 25 15 00 00 00 01 00 02 42 01 15 00 00 00 01 00 02 43 32 15 00 00 00 01 00 02 44 01 15 00 00 00 01 00 02 45 3f 15 00 00 00 01 00 02 46 01 15 00 00 00 01 00 02 47 67 15 00 00 00 01 00 02 48 01 15 00 00 00 01 00 02 49 87 15 00 00 00 01 00 02 4a 01 15 00 00 00 01 00 02 4b ba 15 00 00 00 01 00 02 4c 01 15 00 00 00 01 00 02 4d e2 15 00 00 00 01 00 02 4e 02 15 00 00 00 01 00 02 4f 1f 15 00 00 00 01 00 02 50 02 15 00 00 00 01 00 02 51 50 15 00 00 00 01 00 02 52 02 15 00 00 00 01 00 02 53 51 15 00 00 00 01 00 02 54 02 15 00 00 00 01 00 02 55 7f 15 00 00 00 01 00 02 56 02 15 00 00 00 01 00 02 58 b2 15 00 00 00 01 00 02 59 02 15 00 00 00 01 00 02 5a da 15 00 00 00 01 00 02 5b 03 15 00 00 00 01 00 02 5c 02 15 00 00 00 01 00 02 5d 03 15 00 00 00 01 00 02 5e 1d 15 00 00 00 01 00 02 5f 03 15 00 00 00 01 00 02 60 59 15 00 00 00 01 00 02 61 03 15 00 00 00 01 00 02 62 9e 15 00 00 00 01 00 02 63 03 15 00 00 00 01 00 02 64 b1 15 00 00 00 01 00 02 65 03 15 00 00 00 01 00 02 66 bd 15 00 00 00 01 00 02 67 03 15 00 00 00 01 00 02 68 c7 15 00 00 00 01 00 02 69 03 15 00 00 00 01 00 02 6a cf 15 00 00 00 01 00 02 6b 03 15 00 00 00 01 00 02 6c d5 15 00 00 00 01 00 02 6d 03 15 00 00 00 01 00 02 6e d8 15 00 00 00 01 00 02 6f 03 15 00 00 00 01 00 02 70 d9 15 00 00 00 01 00 02 71 01 15 00 00 00 01 00 02 72 b5 15 00 00 00 01 00 02 73 01 15 00 00 00 01 00 02 74 b7 15 00 00 00 01 00 02 75 01 15 00 00 00 01 00 02 76 bc 15 00 00 00 01 00 02 77 01 15 00 00 00 01 00 02 78 c0 15 00 00 00 01 00 02 79 01 15 00 00 00 01 00 02 7a c5 15 00 00 00 01 00 02 7b 01 15 00 00 00 01 00 02 7c c9 15 00 00 00 01 00 02 7d 01 15 00 00 00 01 00 02 7e cd 15 00 00 00 01 00 02 7f 01 15 00 00 00 01 00 02 80 d1 15 00 00 00 01 00 02 81 01 15 00 00 00 01 00 02 82 d5 15 00 00 00 01 00 02 83 01 15 00 00 00 01 00 02 84 e4 15 00 00 00 01 00 02 85 01 15 00 00 00 01 00 02 86 f2 15 00 00 00 01 00 02 87 02 15 00 00 00 01 00 02 88 0b 15 00 00 00 01 00 02 89 02 15 00 00 00 01 00 02 8a 21 15 00 00 00 01 00 02 8b 02 15 00 00 00 01 00 02 8c 49 15 00 00 00 01 00 02 8d 02 15 00 00 00 01 00 02 8e 6f 15 00 00 00 01 00 02 8f 02 15 00 00 00 01 00 02 90 70 15 00 00 00 01 00 02 91 02 15 00 00 00 01 00 02 92 96 15 00 00 00 01 00 02 93 02 15 00 00 00 01 00 02 94 ca 15 00 00 00 01 00 02 95 02 15 00 00 00 01 00 02 96 ec 15 00 00 00 01 00 02 97 03 15 00 00 00 01 00 02 98 17 15 00 00 00 01 00 02 99 03 15 00 00 00 01 00 02 9a 35 15 00 00 00 01 00 02 9b 03 15 00 00 00 01 00 02 9c 8e 15 00 00 00 01 00 02 9d 03 15 00 00 00 01 00 02 9e a6 15 00 00 00 01 00 02 9f 03 15 00 00 00 01 00 02 a0 b5 15 00 00 00 01 00 02 a2 03 15 00 00 00 01 00 02 a3 c0 15 00 00 00 01 00 02 a4 03 15 00 00 00 01 00 02 a5 c9 15 00 00 00 01 00 02 a6 03 15 00 00 00 01 00 02 a7 d0 15 00 00 00 01 00 02 a9 03 15 00 00 00 01 00 02 aa d5 15 00 00 00 01 00 02 ab 03 15 00 00 00 01 00 02 ac d8 15 00 00 00 01 00 02 ad 03 15 00 00 00 01 00 02 ae d9 15 00 00 00 01 00 02 af 01 15 00 00 00 01 00 02 b0 b5 15 00 00 00 01 00 02 b1 01 15 00 00 00 01 00 02 b2 b7 15 00 00 00 01 00 02 b3 01 15 00 00 00 01 00 02 b4 bc 15 00 00 00 01 00 02 b5 01 15 00 00 00 01 00 02 b6 c0 15 00 00 00 01 00 02 b7 01 15 00 00 00 01 00 02 b8 c5 15 00 00 00 01 00 02 b9 01 15 00 00 00 01 00 02 ba c9 15 00 00 00 01 00 02 bb 01 15 00 00 00 01 00 02 bc cd 15 00 00 00 01 00 02 bd 01 15 00 00 00 01 00 02 be d1 15 00 00 00 01 00 02 bf 01 15 00 00 00 01 00 02 c0 d5 15 00 00 00 01 00 02 c1 01 15 00 00 00 01 00 02 c2 e4 15 00 00 00 01 00 02 c3 01 15 00 00 00 01 00 02 c4 f2 15 00 00 00 01 00 02 c5 02 15 00 00 00 01 00 02 c6 0b 15 00 00 00 01 00 02 c7 02 15 00 00 00 01 00 02 c8 21 15 00 00 00 01 00 02 c9 02 15 00 00 00 01 00 02 ca 49 15 00 00 00 01 00 02 cb 02 15 00 00 00 01 00 02 cc 6f 15 00 00 00 01 00 02 cd 02 15 00 00 00 01 00 02 ce 70 15 00 00 00 01 00 02 cf 02 15 00 00 00 01 00 02 d0 96 15 00 00 00 01 00 02 d1 02 15 00 00 00 01 00 02 d2 ca 15 00 00 00 01 00 02 d3 02 15 00 00 00 01 00 02 d4 ec 15 00 00 00 01 00 02 d5 03 15 00 00 00 01 00 02 d6 17 15 00 00 00 01 00 02 d7 03 15 00 00 00 01 00 02 d8 35 15 00 00 00 01 00 02 d9 03 15 00 00 00 01 00 02 da 8e 15 00 00 00 01 00 02 db 03 15 00 00 00 01 00 02 dc a6 15 00 00 00 01 00 02 dd 03 15 00 00 00 01 00 02 de b5 15 00 00 00 01 00 02 df 03 15 00 00 00 01 00 02 e0 c0 15 00 00 00 01 00 02 e1 03 15 00 00 00 01 00 02 e2 c9 15 00 00 00 01 00 02 e3 03 15 00 00 00 01 00 02 e4 d0 15 00 00 00 01 00 02 e5 03 15 00 00 00 01 00 02 e6 d5 15 00 00 00 01 00 02 e7 03 15 00 00 00 01 00 02 e8 d8 15 00 00 00 01 00 02 e9 03 15 00 00 00 01 00 02 ea d9 15 00 00 00 01 00 02 fb 01 15 01 00 00 01 00 02 ff 10];
        qcom,mdss-dsi-dispparam-papermode3-state = "dsi_hs_mode";
        qcom,mdss-dsi-dispparam-papermode4-command = [15 01 00 00 78 00 02 ff 20 15 00 00 00 01 00 02 fb 01 15 00 00 00 01 00 02 75 00 15 00 00 00 01 00 02 76 c8 15 00 00 00 01 00 02 77 00 15 00 00 00 01 00 02 78 d6 15 00 00 00 01 00 02 79 00 15 00 00 00 01 00 02 7a ed 15 00 00 00 01 00 02 7b 01 15 00 00 00 01 00 02 7c 00 15 00 00 00 01 00 02 7d 01 15 00 00 00 01 00 02 7e 10 15 00 00 00 01 00 02 7f 01 15 00 00 00 01 00 02 80 1e 15 00 00 00 01 00 02 81 01 15 00 00 00 01 00 02 82 2b 15 00 00 00 01 00 02 83 01 15 00 00 00 01 00 02 84 37 15 00 00 00 01 00 02 85 01 15 00 00 00 01 00 02 86 42 15 00 00 00 01 00 02 87 01 15 00 00 00 01 00 02 88 66 15 00 00 00 01 00 02 89 01 15 00 00 00 01 00 02 8a 84 15 00 00 00 01 00 02 8b 01 15 00 00 00 01 00 02 8c b4 15 00 00 00 01 00 02 8d 01 15 00 00 00 01 00 02 8e da 15 00 00 00 01 00 02 8f 02 15 00 00 00 01 00 02 90 15 15 00 00 00 01 00 02 91 02 15 00 00 00 01 00 02 92 45 15 00 00 00 01 00 02 93 02 15 00 00 00 01 00 02 94 46 15 00 00 00 01 00 02 95 02 15 00 00 00 01 00 02 96 72 15 00 00 00 01 00 02 97 02 15 00 00 00 01 00 02 98 a2 15 00 00 00 01 00 02 99 02 15 00 00 00 01 00 02 9a c4 15 00 00 00 01 00 02 9b 02 15 00 00 00 01 00 02 9c f0 15 00 00 00 01 00 02 9d 03 15 00 00 00 01 00 02 9e 0b 15 00 00 00 01 00 02 9f 03 15 00 00 00 01 00 02 a0 2d 15 00 00 00 01 00 02 a2 03 15 00 00 00 01 00 02 a3 38 15 00 00 00 01 00 02 a4 03 15 00 00 00 01 00 02 a5 46 15 00 00 00 01 00 02 a6 03 15 00 00 00 01 00 02 a7 5b 15 00 00 00 01 00 02 a9 03 15 00 00 00 01 00 02 aa 84 15 00 00 00 01 00 02 ab 03 15 00 00 00 01 00 02 ac 9e 15 00 00 00 01 00 02 ad 03 15 00 00 00 01 00 02 ae aa 15 00 00 00 01 00 02 af 03 15 00 00 00 01 00 02 b0 af 15 00 00 00 01 00 02 b1 03 15 00 00 00 01 00 02 b2 ff 15 00 00 00 01 00 02 b3 00 15 00 00 00 01 00 02 b4 c8 15 00 00 00 01 00 02 b5 00 15 00 00 00 01 00 02 b6 d6 15 00 00 00 01 00 02 b7 00 15 00 00 00 01 00 02 b8 ed 15 00 00 00 01 00 02 b9 01 15 00 00 00 01 00 02 ba 00 15 00 00 00 01 00 02 bb 01 15 00 00 00 01 00 02 bc 10 15 00 00 00 01 00 02 bd 01 15 00 00 00 01 00 02 be 1e 15 00 00 00 01 00 02 bf 01 15 00 00 00 01 00 02 c0 2b 15 00 00 00 01 00 02 c1 01 15 00 00 00 01 00 02 c2 37 15 00 00 00 01 00 02 c3 01 15 00 00 00 01 00 02 c4 42 15 00 00 00 01 00 02 c5 01 15 00 00 00 01 00 02 c6 66 15 00 00 00 01 00 02 c7 01 15 00 00 00 01 00 02 c8 84 15 00 00 00 01 00 02 c9 01 15 00 00 00 01 00 02 ca b4 15 00 00 00 01 00 02 cb 01 15 00 00 00 01 00 02 cc da 15 00 00 00 01 00 02 cd 02 15 00 00 00 01 00 02 ce 15 15 00 00 00 01 00 02 cf 02 15 00 00 00 01 00 02 d0 45 15 00 00 00 01 00 02 d1 02 15 00 00 00 01 00 02 d2 46 15 00 00 00 01 00 02 d3 02 15 00 00 00 01 00 02 d4 72 15 00 00 00 01 00 02 d5 02 15 00 00 00 01 00 02 d6 a2 15 00 00 00 01 00 02 d7 02 15 00 00 00 01 00 02 d8 c4 15 00 00 00 01 00 02 d9 02 15 00 00 00 01 00 02 da f0 15 00 00 00 01 00 02 db 03 15 00 00 00 01 00 02 dc 0b 15 00 00 00 01 00 02 dd 03 15 00 00 00 01 00 02 de 2d 15 00 00 00 01 00 02 df 03 15 00 00 00 01 00 02 e0 38 15 00 00 00 01 00 02 e1 03 15 00 00 00 01 00 02 e2 46 15 00 00 00 01 00 02 e3 03 15 00 00 00 01 00 02 e4 5b 15 00 00 00 01 00 02 e5 03 15 00 00 00 01 00 02 e6 84 15 00 00 00 01 00 02 e7 03 15 00 00 00 01 00 02 e8 9e 15 00 00 00 01 00 02 e9 03 15 00 00 00 01 00 02 ea aa 15 00 00 00 01 00 02 eb 03 15 00 00 00 01 00 02 ec af 15 00 00 00 01 00 02 ed 03 15 00 00 00 01 00 02 ee ff 15 00 00 00 01 00 02 ef 00 15 00 00 00 01 00 02 f0 9f 15 00 00 00 01 00 02 f1 00 15 00 00 00 01 00 02 f2 b8 15 00 00 00 01 00 02 f3 00 15 00 00 00 01 00 02 f4 d9 15 00 00 00 01 00 02 f5 00 15 00 00 00 01 00 02 f6 f1 15 00 00 00 01 00 02 f7 01 15 00 00 00 01 00 02 f8 05 15 00 00 00 01 00 02 f9 01 15 00 00 00 01 00 02 fa 16 15 00 00 00 01 00 02 ff 21 15 00 00 00 01 00 02 fb 01 15 00 00 00 01 00 02 00 01 15 00 00 00 01 00 02 01 25 15 00 00 00 01 00 02 02 01 15 00 00 00 01 00 02 03 32 15 00 00 00 01 00 02 04 01 15 00 00 00 01 00 02 05 3f 15 00 00 00 01 00 02 06 01 15 00 00 00 01 00 02 07 67 15 00 00 00 01 00 02 08 01 15 00 00 00 01 00 02 09 87 15 00 00 00 01 00 02 0a 01 15 00 00 00 01 00 02 0b ba 15 00 00 00 01 00 02 0c 01 15 00 00 00 01 00 02 0d e2 15 00 00 00 01 00 02 0e 02 15 00 00 00 01 00 02 0f 1f 15 00 00 00 01 00 02 10 02 15 00 00 00 01 00 02 11 50 15 00 00 00 01 00 02 12 02 15 00 00 00 01 00 02 13 51 15 00 00 00 01 00 02 14 02 15 00 00 00 01 00 02 15 7f 15 00 00 00 01 00 02 16 02 15 00 00 00 01 00 02 17 b2 15 00 00 00 01 00 02 18 02 15 00 00 00 01 00 02 19 da 15 00 00 00 01 00 02 1a 03 15 00 00 00 01 00 02 1b 02 15 00 00 00 01 00 02 1c 03 15 00 00 00 01 00 02 1d 1d 15 00 00 00 01 00 02 1e 03 15 00 00 00 01 00 02 1f 59 15 00 00 00 01 00 02 20 03 15 00 00 00 01 00 02 21 9e 15 00 00 00 01 00 02 22 03 15 00 00 00 01 00 02 23 b1 15 00 00 00 01 00 02 24 03 15 00 00 00 01 00 02 25 bd 15 00 00 00 01 00 02 26 03 15 00 00 00 01 00 02 27 c7 15 00 00 00 01 00 02 28 03 15 00 00 00 01 00 02 29 cf 15 00 00 00 01 00 02 2a 03 15 00 00 00 01 00 02 2b d5 15 00 00 00 01 00 02 2d 03 15 00 00 00 01 00 02 2f d8 15 00 00 00 01 00 02 30 03 15 00 00 00 01 00 02 31 d9 15 00 00 00 01 00 02 32 00 15 00 00 00 01 00 02 33 9f 15 00 00 00 01 00 02 34 00 15 00 00 00 01 00 02 35 b8 15 00 00 00 01 00 02 36 00 15 00 00 00 01 00 02 37 d9 15 00 00 00 01 00 02 38 00 15 00 00 00 01 00 02 39 f1 15 00 00 00 01 00 02 3a 01 15 00 00 00 01 00 02 3b 05 15 00 00 00 01 00 02 3d 01 15 00 00 00 01 00 02 3f 16 15 00 00 00 01 00 02 40 01 15 00 00 00 01 00 02 41 25 15 00 00 00 01 00 02 42 01 15 00 00 00 01 00 02 43 32 15 00 00 00 01 00 02 44 01 15 00 00 00 01 00 02 45 3f 15 00 00 00 01 00 02 46 01 15 00 00 00 01 00 02 47 67 15 00 00 00 01 00 02 48 01 15 00 00 00 01 00 02 49 87 15 00 00 00 01 00 02 4a 01 15 00 00 00 01 00 02 4b ba 15 00 00 00 01 00 02 4c 01 15 00 00 00 01 00 02 4d e2 15 00 00 00 01 00 02 4e 02 15 00 00 00 01 00 02 4f 1f 15 00 00 00 01 00 02 50 02 15 00 00 00 01 00 02 51 50 15 00 00 00 01 00 02 52 02 15 00 00 00 01 00 02 53 51 15 00 00 00 01 00 02 54 02 15 00 00 00 01 00 02 55 7f 15 00 00 00 01 00 02 56 02 15 00 00 00 01 00 02 58 b2 15 00 00 00 01 00 02 59 02 15 00 00 00 01 00 02 5a da 15 00 00 00 01 00 02 5b 03 15 00 00 00 01 00 02 5c 02 15 00 00 00 01 00 02 5d 03 15 00 00 00 01 00 02 5e 1d 15 00 00 00 01 00 02 5f 03 15 00 00 00 01 00 02 60 59 15 00 00 00 01 00 02 61 03 15 00 00 00 01 00 02 62 9e 15 00 00 00 01 00 02 63 03 15 00 00 00 01 00 02 64 b1 15 00 00 00 01 00 02 65 03 15 00 00 00 01 00 02 66 bd 15 00 00 00 01 00 02 67 03 15 00 00 00 01 00 02 68 c7 15 00 00 00 01 00 02 69 03 15 00 00 00 01 00 02 6a cf 15 00 00 00 01 00 02 6b 03 15 00 00 00 01 00 02 6c d5 15 00 00 00 01 00 02 6d 03 15 00 00 00 01 00 02 6e d8 15 00 00 00 01 00 02 6f 03 15 00 00 00 01 00 02 70 d9 15 00 00 00 01 00 02 71 01 15 00 00 00 01 00 02 72 d7 15 00 00 00 01 00 02 73 01 15 00 00 00 01 00 02 74 d8 15 00 00 00 01 00 02 75 01 15 00 00 00 01 00 02 76 db 15 00 00 00 01 00 02 77 01 15 00 00 00 01 00 02 78 de 15 00 00 00 01 00 02 79 01 15 00 00 00 01 00 02 7a e1 15 00 00 00 01 00 02 7b 01 15 00 00 00 01 00 02 7c e5 15 00 00 00 01 00 02 7d 01 15 00 00 00 01 00 02 7e e8 15 00 00 00 01 00 02 7f 01 15 00 00 00 01 00 02 80 eb 15 00 00 00 01 00 02 81 01 15 00 00 00 01 00 02 82 ee 15 00 00 00 01 00 02 83 01 15 00 00 00 01 00 02 84 f8 15 00 00 00 01 00 02 85 02 15 00 00 00 01 00 02 86 04 15 00 00 00 01 00 02 87 02 15 00 00 00 01 00 02 88 18 15 00 00 00 01 00 02 89 02 15 00 00 00 01 00 02 8a 2b 15 00 00 00 01 00 02 8b 02 15 00 00 00 01 00 02 8c 4e 15 00 00 00 01 00 02 8d 02 15 00 00 00 01 00 02 8e 6f 15 00 00 00 01 00 02 8f 02 15 00 00 00 01 00 02 90 70 15 00 00 00 01 00 02 91 02 15 00 00 00 01 00 02 92 93 15 00 00 00 01 00 02 93 02 15 00 00 00 01 00 02 94 c2 15 00 00 00 01 00 02 95 02 15 00 00 00 01 00 02 96 e5 15 00 00 00 01 00 02 97 03 15 00 00 00 01 00 02 98 09 15 00 00 00 01 00 02 99 03 15 00 00 00 01 00 02 9a 21 15 00 00 00 01 00 02 9b 03 15 00 00 00 01 00 02 9c 43 15 00 00 00 01 00 02 9d 03 15 00 00 00 01 00 02 9e 51 15 00 00 00 01 00 02 9f 03 15 00 00 00 01 00 02 a0 66 15 00 00 00 01 00 02 a2 03 15 00 00 00 01 00 02 a3 88 15 00 00 00 01 00 02 a4 03 15 00 00 00 01 00 02 a5 9b 15 00 00 00 01 00 02 a6 03 15 00 00 00 01 00 02 a7 a6 15 00 00 00 01 00 02 a9 03 15 00 00 00 01 00 02 aa ac 15 00 00 00 01 00 02 ab 03 15 00 00 00 01 00 02 ac af 15 00 00 00 01 00 02 ad 03 15 00 00 00 01 00 02 ae ff 15 00 00 00 01 00 02 af 01 15 00 00 00 01 00 02 b0 d7 15 00 00 00 01 00 02 b1 01 15 00 00 00 01 00 02 b2 d8 15 00 00 00 01 00 02 b3 01 15 00 00 00 01 00 02 b4 db 15 00 00 00 01 00 02 b5 01 15 00 00 00 01 00 02 b6 de 15 00 00 00 01 00 02 b7 01 15 00 00 00 01 00 02 b8 e1 15 00 00 00 01 00 02 b9 01 15 00 00 00 01 00 02 ba e5 15 00 00 00 01 00 02 bb 01 15 00 00 00 01 00 02 bc e8 15 00 00 00 01 00 02 bd 01 15 00 00 00 01 00 02 be eb 15 00 00 00 01 00 02 bf 01 15 00 00 00 01 00 02 c0 ee 15 00 00 00 01 00 02 c1 01 15 00 00 00 01 00 02 c2 f8 15 00 00 00 01 00 02 c3 02 15 00 00 00 01 00 02 c4 04 15 00 00 00 01 00 02 c5 02 15 00 00 00 01 00 02 c6 18 15 00 00 00 01 00 02 c7 02 15 00 00 00 01 00 02 c8 2b 15 00 00 00 01 00 02 c9 02 15 00 00 00 01 00 02 ca 4e 15 00 00 00 01 00 02 cb 02 15 00 00 00 01 00 02 cc 6f 15 00 00 00 01 00 02 cd 02 15 00 00 00 01 00 02 ce 70 15 00 00 00 01 00 02 cf 02 15 00 00 00 01 00 02 d0 93 15 00 00 00 01 00 02 d1 02 15 00 00 00 01 00 02 d2 c2 15 00 00 00 01 00 02 d3 02 15 00 00 00 01 00 02 d4 e5 15 00 00 00 01 00 02 d5 03 15 00 00 00 01 00 02 d6 09 15 00 00 00 01 00 02 d7 03 15 00 00 00 01 00 02 d8 21 15 00 00 00 01 00 02 d9 03 15 00 00 00 01 00 02 da 43 15 00 00 00 01 00 02 db 03 15 00 00 00 01 00 02 dc 51 15 00 00 00 01 00 02 dd 03 15 00 00 00 01 00 02 de 66 15 00 00 00 01 00 02 df 03 15 00 00 00 01 00 02 e0 88 15 00 00 00 01 00 02 e1 03 15 00 00 00 01 00 02 e2 9b 15 00 00 00 01 00 02 e3 03 15 00 00 00 01 00 02 e4 a6 15 00 00 00 01 00 02 e5 03 15 00 00 00 01 00 02 e6 ac 15 00 00 00 01 00 02 e7 03 15 00 00 00 01 00 02 e8 af 15 00 00 00 01 00 02 e9 03 15 00 00 00 01 00 02 ea ff 15 00 00 00 01 00 02 fb 01 15 01 00 00 01 00 02 ff 10];
        qcom,mdss-dsi-dispparam-papermode4-state = "dsi_hs_mode";
        qcom,mdss-dsi-dispparam-papermode5-command = [15 01 00 00 78 00 02 ff 20 15 00 00 00 01 00 02 fb 01 15 00 00 00 01 00 02 75 00 15 00 00 00 01 00 02 76 c8 15 00 00 00 01 00 02 77 00 15 00 00 00 01 00 02 78 d6 15 00 00 00 01 00 02 79 00 15 00 00 00 01 00 02 7a ed 15 00 00 00 01 00 02 7b 01 15 00 00 00 01 00 02 7c 00 15 00 00 00 01 00 02 7d 01 15 00 00 00 01 00 02 7e 10 15 00 00 00 01 00 02 7f 01 15 00 00 00 01 00 02 80 1e 15 00 00 00 01 00 02 81 01 15 00 00 00 01 00 02 82 2b 15 00 00 00 01 00 02 83 01 15 00 00 00 01 00 02 84 37 15 00 00 00 01 00 02 85 01 15 00 00 00 01 00 02 86 42 15 00 00 00 01 00 02 87 01 15 00 00 00 01 00 02 88 66 15 00 00 00 01 00 02 89 01 15 00 00 00 01 00 02 8a 84 15 00 00 00 01 00 02 8b 01 15 00 00 00 01 00 02 8c b4 15 00 00 00 01 00 02 8d 01 15 00 00 00 01 00 02 8e da 15 00 00 00 01 00 02 8f 02 15 00 00 00 01 00 02 90 15 15 00 00 00 01 00 02 91 02 15 00 00 00 01 00 02 92 45 15 00 00 00 01 00 02 93 02 15 00 00 00 01 00 02 94 46 15 00 00 00 01 00 02 95 02 15 00 00 00 01 00 02 96 72 15 00 00 00 01 00 02 97 02 15 00 00 00 01 00 02 98 a2 15 00 00 00 01 00 02 99 02 15 00 00 00 01 00 02 9a c4 15 00 00 00 01 00 02 9b 02 15 00 00 00 01 00 02 9c f0 15 00 00 00 01 00 02 9d 03 15 00 00 00 01 00 02 9e 0b 15 00 00 00 01 00 02 9f 03 15 00 00 00 01 00 02 a0 2d 15 00 00 00 01 00 02 a2 03 15 00 00 00 01 00 02 a3 38 15 00 00 00 01 00 02 a4 03 15 00 00 00 01 00 02 a5 46 15 00 00 00 01 00 02 a6 03 15 00 00 00 01 00 02 a7 5b 15 00 00 00 01 00 02 a9 03 15 00 00 00 01 00 02 aa 84 15 00 00 00 01 00 02 ab 03 15 00 00 00 01 00 02 ac 9e 15 00 00 00 01 00 02 ad 03 15 00 00 00 01 00 02 ae aa 15 00 00 00 01 00 02 af 03 15 00 00 00 01 00 02 b0 af 15 00 00 00 01 00 02 b1 03 15 00 00 00 01 00 02 b2 ff 15 00 00 00 01 00 02 b3 00 15 00 00 00 01 00 02 b4 c8 15 00 00 00 01 00 02 b5 00 15 00 00 00 01 00 02 b6 d6 15 00 00 00 01 00 02 b7 00 15 00 00 00 01 00 02 b8 ed 15 00 00 00 01 00 02 b9 01 15 00 00 00 01 00 02 ba 00 15 00 00 00 01 00 02 bb 01 15 00 00 00 01 00 02 bc 10 15 00 00 00 01 00 02 bd 01 15 00 00 00 01 00 02 be 1e 15 00 00 00 01 00 02 bf 01 15 00 00 00 01 00 02 c0 2b 15 00 00 00 01 00 02 c1 01 15 00 00 00 01 00 02 c2 37 15 00 00 00 01 00 02 c3 01 15 00 00 00 01 00 02 c4 42 15 00 00 00 01 00 02 c5 01 15 00 00 00 01 00 02 c6 66 15 00 00 00 01 00 02 c7 01 15 00 00 00 01 00 02 c8 84 15 00 00 00 01 00 02 c9 01 15 00 00 00 01 00 02 ca b4 15 00 00 00 01 00 02 cb 01 15 00 00 00 01 00 02 cc da 15 00 00 00 01 00 02 cd 02 15 00 00 00 01 00 02 ce 15 15 00 00 00 01 00 02 cf 02 15 00 00 00 01 00 02 d0 45 15 00 00 00 01 00 02 d1 02 15 00 00 00 01 00 02 d2 46 15 00 00 00 01 00 02 d3 02 15 00 00 00 01 00 02 d4 72 15 00 00 00 01 00 02 d5 02 15 00 00 00 01 00 02 d6 a2 15 00 00 00 01 00 02 d7 02 15 00 00 00 01 00 02 d8 c4 15 00 00 00 01 00 02 d9 02 15 00 00 00 01 00 02 da f0 15 00 00 00 01 00 02 db 03 15 00 00 00 01 00 02 dc 0b 15 00 00 00 01 00 02 dd 03 15 00 00 00 01 00 02 de 2d 15 00 00 00 01 00 02 df 03 15 00 00 00 01 00 02 e0 38 15 00 00 00 01 00 02 e1 03 15 00 00 00 01 00 02 e2 46 15 00 00 00 01 00 02 e3 03 15 00 00 00 01 00 02 e4 5b 15 00 00 00 01 00 02 e5 03 15 00 00 00 01 00 02 e6 84 15 00 00 00 01 00 02 e7 03 15 00 00 00 01 00 02 e8 9e 15 00 00 00 01 00 02 e9 03 15 00 00 00 01 00 02 ea aa 15 00 00 00 01 00 02 eb 03 15 00 00 00 01 00 02 ec af 15 00 00 00 01 00 02 ed 03 15 00 00 00 01 00 02 ee ff 15 00 00 00 01 00 02 ef 00 15 00 00 00 01 00 02 f0 9f 15 00 00 00 01 00 02 f1 00 15 00 00 00 01 00 02 f2 b8 15 00 00 00 01 00 02 f3 00 15 00 00 00 01 00 02 f4 d9 15 00 00 00 01 00 02 f5 00 15 00 00 00 01 00 02 f6 f1 15 00 00 00 01 00 02 f7 01 15 00 00 00 01 00 02 f8 05 15 00 00 00 01 00 02 f9 01 15 00 00 00 01 00 02 fa 16 15 00 00 00 01 00 02 ff 21 15 00 00 00 01 00 02 fb 01 15 00 00 00 01 00 02 00 01 15 00 00 00 01 00 02 01 25 15 00 00 00 01 00 02 02 01 15 00 00 00 01 00 02 03 32 15 00 00 00 01 00 02 04 01 15 00 00 00 01 00 02 05 3f 15 00 00 00 01 00 02 06 01 15 00 00 00 01 00 02 07 67 15 00 00 00 01 00 02 08 01 15 00 00 00 01 00 02 09 87 15 00 00 00 01 00 02 0a 01 15 00 00 00 01 00 02 0b ba 15 00 00 00 01 00 02 0c 01 15 00 00 00 01 00 02 0d e2 15 00 00 00 01 00 02 0e 02 15 00 00 00 01 00 02 0f 1f 15 00 00 00 01 00 02 10 02 15 00 00 00 01 00 02 11 50 15 00 00 00 01 00 02 12 02 15 00 00 00 01 00 02 13 51 15 00 00 00 01 00 02 14 02 15 00 00 00 01 00 02 15 7f 15 00 00 00 01 00 02 16 02 15 00 00 00 01 00 02 17 b2 15 00 00 00 01 00 02 18 02 15 00 00 00 01 00 02 19 da 15 00 00 00 01 00 02 1a 03 15 00 00 00 01 00 02 1b 02 15 00 00 00 01 00 02 1c 03 15 00 00 00 01 00 02 1d 1d 15 00 00 00 01 00 02 1e 03 15 00 00 00 01 00 02 1f 59 15 00 00 00 01 00 02 20 03 15 00 00 00 01 00 02 21 9e 15 00 00 00 01 00 02 22 03 15 00 00 00 01 00 02 23 b1 15 00 00 00 01 00 02 24 03 15 00 00 00 01 00 02 25 bd 15 00 00 00 01 00 02 26 03 15 00 00 00 01 00 02 27 c7 15 00 00 00 01 00 02 28 03 15 00 00 00 01 00 02 29 cf 15 00 00 00 01 00 02 2a 03 15 00 00 00 01 00 02 2b d5 15 00 00 00 01 00 02 2d 03 15 00 00 00 01 00 02 2f d8 15 00 00 00 01 00 02 30 03 15 00 00 00 01 00 02 31 d9 15 00 00 00 01 00 02 32 00 15 00 00 00 01 00 02 33 9f 15 00 00 00 01 00 02 34 00 15 00 00 00 01 00 02 35 b8 15 00 00 00 01 00 02 36 00 15 00 00 00 01 00 02 37 d9 15 00 00 00 01 00 02 38 00 15 00 00 00 01 00 02 39 f1 15 00 00 00 01 00 02 3a 01 15 00 00 00 01 00 02 3b 05 15 00 00 00 01 00 02 3d 01 15 00 00 00 01 00 02 3f 16 15 00 00 00 01 00 02 40 01 15 00 00 00 01 00 02 41 25 15 00 00 00 01 00 02 42 01 15 00 00 00 01 00 02 43 32 15 00 00 00 01 00 02 44 01 15 00 00 00 01 00 02 45 3f 15 00 00 00 01 00 02 46 01 15 00 00 00 01 00 02 47 67 15 00 00 00 01 00 02 48 01 15 00 00 00 01 00 02 49 87 15 00 00 00 01 00 02 4a 01 15 00 00 00 01 00 02 4b ba 15 00 00 00 01 00 02 4c 01 15 00 00 00 01 00 02 4d e2 15 00 00 00 01 00 02 4e 02 15 00 00 00 01 00 02 4f 1f 15 00 00 00 01 00 02 50 02 15 00 00 00 01 00 02 51 50 15 00 00 00 01 00 02 52 02 15 00 00 00 01 00 02 53 51 15 00 00 00 01 00 02 54 02 15 00 00 00 01 00 02 55 7f 15 00 00 00 01 00 02 56 02 15 00 00 00 01 00 02 58 b2 15 00 00 00 01 00 02 59 02 15 00 00 00 01 00 02 5a da 15 00 00 00 01 00 02 5b 03 15 00 00 00 01 00 02 5c 02 15 00 00 00 01 00 02 5d 03 15 00 00 00 01 00 02 5e 1d 15 00 00 00 01 00 02 5f 03 15 00 00 00 01 00 02 60 59 15 00 00 00 01 00 02 61 03 15 00 00 00 01 00 02 62 9e 15 00 00 00 01 00 02 63 03 15 00 00 00 01 00 02 64 b1 15 00 00 00 01 00 02 65 03 15 00 00 00 01 00 02 66 bd 15 00 00 00 01 00 02 67 03 15 00 00 00 01 00 02 68 c7 15 00 00 00 01 00 02 69 03 15 00 00 00 01 00 02 6a cf 15 00 00 00 01 00 02 6b 03 15 00 00 00 01 00 02 6c d5 15 00 00 00 01 00 02 6d 03 15 00 00 00 01 00 02 6e d8 15 00 00 00 01 00 02 6f 03 15 00 00 00 01 00 02 70 d9 15 00 00 00 01 00 02 71 01 15 00 00 00 01 00 02 72 e9 15 00 00 00 01 00 02 73 01 15 00 00 00 01 00 02 74 eb 15 00 00 00 01 00 02 75 01 15 00 00 00 01 00 02 76 ee 15 00 00 00 01 00 02 77 01 15 00 00 00 01 00 02 78 f1 15 00 00 00 01 00 02 79 01 15 00 00 00 01 00 02 7a f3 15 00 00 00 01 00 02 7b 01 15 00 00 00 01 00 02 7c f8 15 00 00 00 01 00 02 7d 01 15 00 00 00 01 00 02 7e fc 15 00 00 00 01 00 02 7f 01 15 00 00 00 01 00 02 80 ff 15 00 00 00 01 00 02 81 02 15 00 00 00 01 00 02 82 02 15 00 00 00 01 00 02 83 02 15 00 00 00 01 00 02 84 0d 15 00 00 00 01 00 02 85 02 15 00 00 00 01 00 02 86 17 15 00 00 00 01 00 02 87 02 15 00 00 00 01 00 02 88 28 15 00 00 00 01 00 02 89 02 15 00 00 00 01 00 02 8a 39 15 00 00 00 01 00 02 8b 02 15 00 00 00 01 00 02 8c 5a 15 00 00 00 01 00 02 8d 02 15 00 00 00 01 00 02 8e 7e 15 00 00 00 01 00 02 8f 02 15 00 00 00 01 00 02 90 80 15 00 00 00 01 00 02 91 02 15 00 00 00 01 00 02 92 a2 15 00 00 00 01 00 02 93 02 15 00 00 00 01 00 02 94 bb 15 00 00 00 01 00 02 95 02 15 00 00 00 01 00 02 96 f7 15 00 00 00 01 00 02 97 03 15 00 00 00 01 00 02 98 22 15 00 00 00 01 00 02 99 03 15 00 00 00 01 00 02 9a 3b 15 00 00 00 01 00 02 9b 03 15 00 00 00 01 00 02 9c 5a 15 00 00 00 01 00 02 9d 03 15 00 00 00 01 00 02 9e 63 15 00 00 00 01 00 02 9f 03 15 00 00 00 01 00 02 a0 6f 15 00 00 00 01 00 02 a2 03 15 00 00 00 01 00 02 a3 7e 15 00 00 00 01 00 02 a4 03 15 00 00 00 01 00 02 a5 9b 15 00 00 00 01 00 02 a6 03 15 00 00 00 01 00 02 a7 bf 15 00 00 00 01 00 02 a9 03 15 00 00 00 01 00 02 aa d0 15 00 00 00 01 00 02 ab 03 15 00 00 00 01 00 02 ac d7 15 00 00 00 01 00 02 ad 03 15 00 00 00 01 00 02 ae d8 15 00 00 00 01 00 02 af 01 15 00 00 00 01 00 02 b0 e9 15 00 00 00 01 00 02 b1 01 15 00 00 00 01 00 02 b2 eb 15 00 00 00 01 00 02 b3 01 15 00 00 00 01 00 02 b4 ee 15 00 00 00 01 00 02 b5 01 15 00 00 00 01 00 02 b6 f1 15 00 00 00 01 00 02 b7 01 15 00 00 00 01 00 02 b8 f3 15 00 00 00 01 00 02 b9 01 15 00 00 00 01 00 02 ba f8 15 00 00 00 01 00 02 bb 01 15 00 00 00 01 00 02 bc fc 15 00 00 00 01 00 02 bd 01 15 00 00 00 01 00 02 be ff 15 00 00 00 01 00 02 bf 02 15 00 00 00 01 00 02 c0 02 15 00 00 00 01 00 02 c1 02 15 00 00 00 01 00 02 c2 0d 15 00 00 00 01 00 02 c3 02 15 00 00 00 01 00 02 c4 17 15 00 00 00 01 00 02 c5 02 15 00 00 00 01 00 02 c6 28 15 00 00 00 01 00 02 c7 02 15 00 00 00 01 00 02 c8 39 15 00 00 00 01 00 02 c9 02 15 00 00 00 01 00 02 ca 5a 15 00 00 00 01 00 02 cb 02 15 00 00 00 01 00 02 cc 7e 15 00 00 00 01 00 02 cd 02 15 00 00 00 01 00 02 ce 80 15 00 00 00 01 00 02 cf 02 15 00 00 00 01 00 02 d0 a2 15 00 00 00 01 00 02 d1 02 15 00 00 00 01 00 02 d2 bb 15 00 00 00 01 00 02 d3 02 15 00 00 00 01 00 02 d4 f7 15 00 00 00 01 00 02 d5 03 15 00 00 00 01 00 02 d6 22 15 00 00 00 01 00 02 d7 03 15 00 00 00 01 00 02 d8 3b 15 00 00 00 01 00 02 d9 03 15 00 00 00 01 00 02 da 5a 15 00 00 00 01 00 02 db 03 15 00 00 00 01 00 02 dc 63 15 00 00 00 01 00 02 dd 03 15 00 00 00 01 00 02 de 6f 15 00 00 00 01 00 02 df 03 15 00 00 00 01 00 02 e0 7e 15 00 00 00 01 00 02 e1 03 15 00 00 00 01 00 02 e2 9b 15 00 00 00 01 00 02 e3 03 15 00 00 00 01 00 02 e4 bf 15 00 00 00 01 00 02 e5 03 15 00 00 00 01 00 02 e6 d0 15 00 00 00 01 00 02 e7 03 15 00 00 00 01 00 02 e8 d7 15 00 00 00 01 00 02 e9 03 15 00 00 00 01 00 02 ea d8 15 00 00 00 01 00 02 fb 01 15 01 00 00 01 00 02 ff 10];
        qcom,mdss-dsi-dispparam-papermode5-state = "dsi_hs_mode";
        qcom,mdss-dsi-dispparam-papermode6-command = [15 01 00 00 78 00 02 ff 20 15 00 00 00 01 00 02 fb 01 15 00 00 00 01 00 02 75 00 15 00 00 00 01 00 02 76 c8 15 00 00 00 01 00 02 77 00 15 00 00 00 01 00 02 78 d6 15 00 00 00 01 00 02 79 00 15 00 00 00 01 00 02 7a ed 15 00 00 00 01 00 02 7b 01 15 00 00 00 01 00 02 7c 00 15 00 00 00 01 00 02 7d 01 15 00 00 00 01 00 02 7e 10 15 00 00 00 01 00 02 7f 01 15 00 00 00 01 00 02 80 1e 15 00 00 00 01 00 02 81 01 15 00 00 00 01 00 02 82 2b 15 00 00 00 01 00 02 83 01 15 00 00 00 01 00 02 84 37 15 00 00 00 01 00 02 85 01 15 00 00 00 01 00 02 86 42 15 00 00 00 01 00 02 87 01 15 00 00 00 01 00 02 88 66 15 00 00 00 01 00 02 89 01 15 00 00 00 01 00 02 8a 84 15 00 00 00 01 00 02 8b 01 15 00 00 00 01 00 02 8c b4 15 00 00 00 01 00 02 8d 01 15 00 00 00 01 00 02 8e da 15 00 00 00 01 00 02 8f 02 15 00 00 00 01 00 02 90 15 15 00 00 00 01 00 02 91 02 15 00 00 00 01 00 02 92 45 15 00 00 00 01 00 02 93 02 15 00 00 00 01 00 02 94 46 15 00 00 00 01 00 02 95 02 15 00 00 00 01 00 02 96 72 15 00 00 00 01 00 02 97 02 15 00 00 00 01 00 02 98 a2 15 00 00 00 01 00 02 99 02 15 00 00 00 01 00 02 9a c4 15 00 00 00 01 00 02 9b 02 15 00 00 00 01 00 02 9c f0 15 00 00 00 01 00 02 9d 03 15 00 00 00 01 00 02 9e 0b 15 00 00 00 01 00 02 9f 03 15 00 00 00 01 00 02 a0 2d 15 00 00 00 01 00 02 a2 03 15 00 00 00 01 00 02 a3 38 15 00 00 00 01 00 02 a4 03 15 00 00 00 01 00 02 a5 46 15 00 00 00 01 00 02 a6 03 15 00 00 00 01 00 02 a7 5b 15 00 00 00 01 00 02 a9 03 15 00 00 00 01 00 02 aa 84 15 00 00 00 01 00 02 ab 03 15 00 00 00 01 00 02 ac 9e 15 00 00 00 01 00 02 ad 03 15 00 00 00 01 00 02 ae aa 15 00 00 00 01 00 02 af 03 15 00 00 00 01 00 02 b0 af 15 00 00 00 01 00 02 b1 03 15 00 00 00 01 00 02 b2 ff 15 00 00 00 01 00 02 b3 00 15 00 00 00 01 00 02 b4 c8 15 00 00 00 01 00 02 b5 00 15 00 00 00 01 00 02 b6 d6 15 00 00 00 01 00 02 b7 00 15 00 00 00 01 00 02 b8 ed 15 00 00 00 01 00 02 b9 01 15 00 00 00 01 00 02 ba 00 15 00 00 00 01 00 02 bb 01 15 00 00 00 01 00 02 bc 10 15 00 00 00 01 00 02 bd 01 15 00 00 00 01 00 02 be 1e 15 00 00 00 01 00 02 bf 01 15 00 00 00 01 00 02 c0 2b 15 00 00 00 01 00 02 c1 01 15 00 00 00 01 00 02 c2 37 15 00 00 00 01 00 02 c3 01 15 00 00 00 01 00 02 c4 42 15 00 00 00 01 00 02 c5 01 15 00 00 00 01 00 02 c6 66 15 00 00 00 01 00 02 c7 01 15 00 00 00 01 00 02 c8 84 15 00 00 00 01 00 02 c9 01 15 00 00 00 01 00 02 ca b4 15 00 00 00 01 00 02 cb 01 15 00 00 00 01 00 02 cc da 15 00 00 00 01 00 02 cd 02 15 00 00 00 01 00 02 ce 15 15 00 00 00 01 00 02 cf 02 15 00 00 00 01 00 02 d0 45 15 00 00 00 01 00 02 d1 02 15 00 00 00 01 00 02 d2 46 15 00 00 00 01 00 02 d3 02 15 00 00 00 01 00 02 d4 72 15 00 00 00 01 00 02 d5 02 15 00 00 00 01 00 02 d6 a2 15 00 00 00 01 00 02 d7 02 15 00 00 00 01 00 02 d8 c4 15 00 00 00 01 00 02 d9 02 15 00 00 00 01 00 02 da f0 15 00 00 00 01 00 02 db 03 15 00 00 00 01 00 02 dc 0b 15 00 00 00 01 00 02 dd 03 15 00 00 00 01 00 02 de 2d 15 00 00 00 01 00 02 df 03 15 00 00 00 01 00 02 e0 38 15 00 00 00 01 00 02 e1 03 15 00 00 00 01 00 02 e2 46 15 00 00 00 01 00 02 e3 03 15 00 00 00 01 00 02 e4 5b 15 00 00 00 01 00 02 e5 03 15 00 00 00 01 00 02 e6 84 15 00 00 00 01 00 02 e7 03 15 00 00 00 01 00 02 e8 9e 15 00 00 00 01 00 02 e9 03 15 00 00 00 01 00 02 ea aa 15 00 00 00 01 00 02 eb 03 15 00 00 00 01 00 02 ec af 15 00 00 00 01 00 02 ed 03 15 00 00 00 01 00 02 ee ff 15 00 00 00 01 00 02 ef 00 15 00 00 00 01 00 02 f0 9f 15 00 00 00 01 00 02 f1 00 15 00 00 00 01 00 02 f2 b8 15 00 00 00 01 00 02 f3 00 15 00 00 00 01 00 02 f4 d9 15 00 00 00 01 00 02 f5 00 15 00 00 00 01 00 02 f6 f1 15 00 00 00 01 00 02 f7 01 15 00 00 00 01 00 02 f8 05 15 00 00 00 01 00 02 f9 01 15 00 00 00 01 00 02 fa 16 15 00 00 00 01 00 02 ff 21 15 00 00 00 01 00 02 fb 01 15 00 00 00 01 00 02 00 01 15 00 00 00 01 00 02 01 25 15 00 00 00 01 00 02 02 01 15 00 00 00 01 00 02 03 32 15 00 00 00 01 00 02 04 01 15 00 00 00 01 00 02 05 3f 15 00 00 00 01 00 02 06 01 15 00 00 00 01 00 02 07 67 15 00 00 00 01 00 02 08 01 15 00 00 00 01 00 02 09 87 15 00 00 00 01 00 02 0a 01 15 00 00 00 01 00 02 0b ba 15 00 00 00 01 00 02 0c 01 15 00 00 00 01 00 02 0d e2 15 00 00 00 01 00 02 0e 02 15 00 00 00 01 00 02 0f 1f 15 00 00 00 01 00 02 10 02 15 00 00 00 01 00 02 11 50 15 00 00 00 01 00 02 12 02 15 00 00 00 01 00 02 13 51 15 00 00 00 01 00 02 14 02 15 00 00 00 01 00 02 15 7f 15 00 00 00 01 00 02 16 02 15 00 00 00 01 00 02 17 b2 15 00 00 00 01 00 02 18 02 15 00 00 00 01 00 02 19 da 15 00 00 00 01 00 02 1a 03 15 00 00 00 01 00 02 1b 02 15 00 00 00 01 00 02 1c 03 15 00 00 00 01 00 02 1d 1d 15 00 00 00 01 00 02 1e 03 15 00 00 00 01 00 02 1f 59 15 00 00 00 01 00 02 20 03 15 00 00 00 01 00 02 21 9e 15 00 00 00 01 00 02 22 03 15 00 00 00 01 00 02 23 b1 15 00 00 00 01 00 02 24 03 15 00 00 00 01 00 02 25 bd 15 00 00 00 01 00 02 26 03 15 00 00 00 01 00 02 27 c7 15 00 00 00 01 00 02 28 03 15 00 00 00 01 00 02 29 cf 15 00 00 00 01 00 02 2a 03 15 00 00 00 01 00 02 2b d5 15 00 00 00 01 00 02 2d 03 15 00 00 00 01 00 02 2f d8 15 00 00 00 01 00 02 30 03 15 00 00 00 01 00 02 31 d9 15 00 00 00 01 00 02 32 00 15 00 00 00 01 00 02 33 9f 15 00 00 00 01 00 02 34 00 15 00 00 00 01 00 02 35 b8 15 00 00 00 01 00 02 36 00 15 00 00 00 01 00 02 37 d9 15 00 00 00 01 00 02 38 00 15 00 00 00 01 00 02 39 f1 15 00 00 00 01 00 02 3a 01 15 00 00 00 01 00 02 3b 05 15 00 00 00 01 00 02 3d 01 15 00 00 00 01 00 02 3f 16 15 00 00 00 01 00 02 40 01 15 00 00 00 01 00 02 41 25 15 00 00 00 01 00 02 42 01 15 00 00 00 01 00 02 43 32 15 00 00 00 01 00 02 44 01 15 00 00 00 01 00 02 45 3f 15 00 00 00 01 00 02 46 01 15 00 00 00 01 00 02 47 67 15 00 00 00 01 00 02 48 01 15 00 00 00 01 00 02 49 87 15 00 00 00 01 00 02 4a 01 15 00 00 00 01 00 02 4b ba 15 00 00 00 01 00 02 4c 01 15 00 00 00 01 00 02 4d e2 15 00 00 00 01 00 02 4e 02 15 00 00 00 01 00 02 4f 1f 15 00 00 00 01 00 02 50 02 15 00 00 00 01 00 02 51 50 15 00 00 00 01 00 02 52 02 15 00 00 00 01 00 02 53 51 15 00 00 00 01 00 02 54 02 15 00 00 00 01 00 02 55 7f 15 00 00 00 01 00 02 56 02 15 00 00 00 01 00 02 58 b2 15 00 00 00 01 00 02 59 02 15 00 00 00 01 00 02 5a da 15 00 00 00 01 00 02 5b 03 15 00 00 00 01 00 02 5c 02 15 00 00 00 01 00 02 5d 03 15 00 00 00 01 00 02 5e 1d 15 00 00 00 01 00 02 5f 03 15 00 00 00 01 00 02 60 59 15 00 00 00 01 00 02 61 03 15 00 00 00 01 00 02 62 9e 15 00 00 00 01 00 02 63 03 15 00 00 00 01 00 02 64 b1 15 00 00 00 01 00 02 65 03 15 00 00 00 01 00 02 66 bd 15 00 00 00 01 00 02 67 03 15 00 00 00 01 00 02 68 c7 15 00 00 00 01 00 02 69 03 15 00 00 00 01 00 02 6a cf 15 00 00 00 01 00 02 6b 03 15 00 00 00 01 00 02 6c d5 15 00 00 00 01 00 02 6d 03 15 00 00 00 01 00 02 6e d8 15 00 00 00 01 00 02 6f 03 15 00 00 00 01 00 02 70 d9 15 00 00 00 01 00 02 71 02 15 00 00 00 01 00 02 72 02 15 00 00 00 01 00 02 73 02 15 00 00 00 01 00 02 74 03 15 00 00 00 01 00 02 75 02 15 00 00 00 01 00 02 76 06 15 00 00 00 01 00 02 77 02 15 00 00 00 01 00 02 78 09 15 00 00 00 01 00 02 79 02 15 00 00 00 01 00 02 7a 0b 15 00 00 00 01 00 02 7b 02 15 00 00 00 01 00 02 7c 0e 15 00 00 00 01 00 02 7d 02 15 00 00 00 01 00 02 7e 10 15 00 00 00 01 00 02 7f 02 15 00 00 00 01 00 02 80 13 15 00 00 00 01 00 02 81 02 15 00 00 00 01 00 02 82 15 15 00 00 00 01 00 02 83 02 15 00 00 00 01 00 02 84 1e 15 00 00 00 01 00 02 85 02 15 00 00 00 01 00 02 86 27 15 00 00 00 01 00 02 87 02 15 00 00 00 01 00 02 88 39 15 00 00 00 01 00 02 89 02 15 00 00 00 01 00 02 8a 49 15 00 00 00 01 00 02 8b 02 15 00 00 00 01 00 02 8c 69 15 00 00 00 01 00 02 8d 02 15 00 00 00 01 00 02 8e 88 15 00 00 00 01 00 02 8f 02 15 00 00 00 01 00 02 90 89 15 00 00 00 01 00 02 91 02 15 00 00 00 01 00 02 92 ad 15 00 00 00 01 00 02 93 02 15 00 00 00 01 00 02 94 e3 15 00 00 00 01 00 02 95 02 15 00 00 00 01 00 02 96 fe 15 00 00 00 01 00 02 97 03 15 00 00 00 01 00 02 98 23 15 00 00 00 01 00 02 99 03 15 00 00 00 01 00 02 9a 47 15 00 00 00 01 00 02 9b 03 15 00 00 00 01 00 02 9c b5 15 00 00 00 01 00 02 9d 03 15 00 00 00 01 00 02 9e be 15 00 00 00 01 00 02 9f 03 15 00 00 00 01 00 02 a0 c5 15 00 00 00 01 00 02 a2 03 15 00 00 00 01 00 02 a3 cb 15 00 00 00 01 00 02 a4 03 15 00 00 00 01 00 02 a5 d0 15 00 00 00 01 00 02 a6 03 15 00 00 00 01 00 02 a7 d4 15 00 00 00 01 00 02 a9 03 15 00 00 00 01 00 02 aa d7 15 00 00 00 01 00 02 ab 03 15 00 00 00 01 00 02 ac d8 15 00 00 00 01 00 02 ad 03 15 00 00 00 01 00 02 ae d9 15 00 00 00 01 00 02 af 02 15 00 00 00 01 00 02 b0 02 15 00 00 00 01 00 02 b1 02 15 00 00 00 01 00 02 b2 03 15 00 00 00 01 00 02 b3 02 15 00 00 00 01 00 02 b4 06 15 00 00 00 01 00 02 b5 02 15 00 00 00 01 00 02 b6 09 15 00 00 00 01 00 02 b7 02 15 00 00 00 01 00 02 b8 0b 15 00 00 00 01 00 02 b9 02 15 00 00 00 01 00 02 ba 0e 15 00 00 00 01 00 02 bb 02 15 00 00 00 01 00 02 bc 10 15 00 00 00 01 00 02 bd 02 15 00 00 00 01 00 02 be 13 15 00 00 00 01 00 02 bf 02 15 00 00 00 01 00 02 c0 15 15 00 00 00 01 00 02 c1 02 15 00 00 00 01 00 02 c2 1e 15 00 00 00 01 00 02 c3 02 15 00 00 00 01 00 02 c4 27 15 00 00 00 01 00 02 c5 02 15 00 00 00 01 00 02 c6 39 15 00 00 00 01 00 02 c7 02 15 00 00 00 01 00 02 c8 49 15 00 00 00 01 00 02 c9 02 15 00 00 00 01 00 02 ca 69 15 00 00 00 01 00 02 cb 02 15 00 00 00 01 00 02 cc 88 15 00 00 00 01 00 02 cd 02 15 00 00 00 01 00 02 ce 89 15 00 00 00 01 00 02 cf 02 15 00 00 00 01 00 02 d0 ad 15 00 00 00 01 00 02 d1 02 15 00 00 00 01 00 02 d2 e3 15 00 00 00 01 00 02 d3 02 15 00 00 00 01 00 02 d4 fe 15 00 00 00 01 00 02 d5 03 15 00 00 00 01 00 02 d6 23 15 00 00 00 01 00 02 d7 03 15 00 00 00 01 00 02 d8 47 15 00 00 00 01 00 02 d9 03 15 00 00 00 01 00 02 da b5 15 00 00 00 01 00 02 db 03 15 00 00 00 01 00 02 dc be 15 00 00 00 01 00 02 dd 03 15 00 00 00 01 00 02 de c5 15 00 00 00 01 00 02 df 03 15 00 00 00 01 00 02 e0 cb 15 00 00 00 01 00 02 e1 03 15 00 00 00 01 00 02 e2 d0 15 00 00 00 01 00 02 e3 03 15 00 00 00 01 00 02 e4 d4 15 00 00 00 01 00 02 e5 03 15 00 00 00 01 00 02 e6 d7 15 00 00 00 01 00 02 e7 03 15 00 00 00 01 00 02 e8 d8 15 00 00 00 01 00 02 e9 03 15 00 00 00 01 00 02 ea d9 15 00 00 00 01 00 02 fb 01 15 01 00 00 01 00 02 ff 10];
        qcom,mdss-dsi-dispparam-papermode6-state = "dsi_hs_mode";
        qcom,mdss-dsi-dispparam-papermode7-command = [15 01 00 00 78 00 02 ff 20 15 00 00 00 01 00 02 fb 01 15 00 00 00 01 00 02 75 00 15 00 00 00 01 00 02 76 c8 15 00 00 00 01 00 02 77 00 15 00 00 00 01 00 02 78 d6 15 00 00 00 01 00 02 79 00 15 00 00 00 01 00 02 7a ed 15 00 00 00 01 00 02 7b 01 15 00 00 00 01 00 02 7c 00 15 00 00 00 01 00 02 7d 01 15 00 00 00 01 00 02 7e 10 15 00 00 00 01 00 02 7f 01 15 00 00 00 01 00 02 80 1e 15 00 00 00 01 00 02 81 01 15 00 00 00 01 00 02 82 2b 15 00 00 00 01 00 02 83 01 15 00 00 00 01 00 02 84 37 15 00 00 00 01 00 02 85 01 15 00 00 00 01 00 02 86 42 15 00 00 00 01 00 02 87 01 15 00 00 00 01 00 02 88 66 15 00 00 00 01 00 02 89 01 15 00 00 00 01 00 02 8a 84 15 00 00 00 01 00 02 8b 01 15 00 00 00 01 00 02 8c b4 15 00 00 00 01 00 02 8d 01 15 00 00 00 01 00 02 8e da 15 00 00 00 01 00 02 8f 02 15 00 00 00 01 00 02 90 15 15 00 00 00 01 00 02 91 02 15 00 00 00 01 00 02 92 45 15 00 00 00 01 00 02 93 02 15 00 00 00 01 00 02 94 46 15 00 00 00 01 00 02 95 02 15 00 00 00 01 00 02 96 72 15 00 00 00 01 00 02 97 02 15 00 00 00 01 00 02 98 a2 15 00 00 00 01 00 02 99 02 15 00 00 00 01 00 02 9a c4 15 00 00 00 01 00 02 9b 02 15 00 00 00 01 00 02 9c f0 15 00 00 00 01 00 02 9d 03 15 00 00 00 01 00 02 9e 0b 15 00 00 00 01 00 02 9f 03 15 00 00 00 01 00 02 a0 2d 15 00 00 00 01 00 02 a2 03 15 00 00 00 01 00 02 a3 38 15 00 00 00 01 00 02 a4 03 15 00 00 00 01 00 02 a5 46 15 00 00 00 01 00 02 a6 03 15 00 00 00 01 00 02 a7 5b 15 00 00 00 01 00 02 a9 03 15 00 00 00 01 00 02 aa 84 15 00 00 00 01 00 02 ab 03 15 00 00 00 01 00 02 ac 9e 15 00 00 00 01 00 02 ad 03 15 00 00 00 01 00 02 ae aa 15 00 00 00 01 00 02 af 03 15 00 00 00 01 00 02 b0 af 15 00 00 00 01 00 02 b1 03 15 00 00 00 01 00 02 b2 ff 15 00 00 00 01 00 02 b3 00 15 00 00 00 01 00 02 b4 c8 15 00 00 00 01 00 02 b5 00 15 00 00 00 01 00 02 b6 d6 15 00 00 00 01 00 02 b7 00 15 00 00 00 01 00 02 b8 ed 15 00 00 00 01 00 02 b9 01 15 00 00 00 01 00 02 ba 00 15 00 00 00 01 00 02 bb 01 15 00 00 00 01 00 02 bc 10 15 00 00 00 01 00 02 bd 01 15 00 00 00 01 00 02 be 1e 15 00 00 00 01 00 02 bf 01 15 00 00 00 01 00 02 c0 2b 15 00 00 00 01 00 02 c1 01 15 00 00 00 01 00 02 c2 37 15 00 00 00 01 00 02 c3 01 15 00 00 00 01 00 02 c4 42 15 00 00 00 01 00 02 c5 01 15 00 00 00 01 00 02 c6 66 15 00 00 00 01 00 02 c7 01 15 00 00 00 01 00 02 c8 84 15 00 00 00 01 00 02 c9 01 15 00 00 00 01 00 02 ca b4 15 00 00 00 01 00 02 cb 01 15 00 00 00 01 00 02 cc da 15 00 00 00 01 00 02 cd 02 15 00 00 00 01 00 02 ce 15 15 00 00 00 01 00 02 cf 02 15 00 00 00 01 00 02 d0 45 15 00 00 00 01 00 02 d1 02 15 00 00 00 01 00 02 d2 46 15 00 00 00 01 00 02 d3 02 15 00 00 00 01 00 02 d4 72 15 00 00 00 01 00 02 d5 02 15 00 00 00 01 00 02 d6 a2 15 00 00 00 01 00 02 d7 02 15 00 00 00 01 00 02 d8 c4 15 00 00 00 01 00 02 d9 02 15 00 00 00 01 00 02 da f0 15 00 00 00 01 00 02 db 03 15 00 00 00 01 00 02 dc 0b 15 00 00 00 01 00 02 dd 03 15 00 00 00 01 00 02 de 2d 15 00 00 00 01 00 02 df 03 15 00 00 00 01 00 02 e0 38 15 00 00 00 01 00 02 e1 03 15 00 00 00 01 00 02 e2 46 15 00 00 00 01 00 02 e3 03 15 00 00 00 01 00 02 e4 5b 15 00 00 00 01 00 02 e5 03 15 00 00 00 01 00 02 e6 84 15 00 00 00 01 00 02 e7 03 15 00 00 00 01 00 02 e8 9e 15 00 00 00 01 00 02 e9 03 15 00 00 00 01 00 02 ea aa 15 00 00 00 01 00 02 eb 03 15 00 00 00 01 00 02 ec af 15 00 00 00 01 00 02 ed 03 15 00 00 00 01 00 02 ee ff 15 00 00 00 01 00 02 ef 00 15 00 00 00 01 00 02 f0 9f 15 00 00 00 01 00 02 f1 00 15 00 00 00 01 00 02 f2 b8 15 00 00 00 01 00 02 f3 00 15 00 00 00 01 00 02 f4 d9 15 00 00 00 01 00 02 f5 00 15 00 00 00 01 00 02 f6 f1 15 00 00 00 01 00 02 f7 01 15 00 00 00 01 00 02 f8 05 15 00 00 00 01 00 02 f9 01 15 00 00 00 01 00 02 fa 16 15 00 00 00 01 00 02 ff 21 15 00 00 00 01 00 02 fb 01 15 00 00 00 01 00 02 00 01 15 00 00 00 01 00 02 01 25 15 00 00 00 01 00 02 02 01 15 00 00 00 01 00 02 03 32 15 00 00 00 01 00 02 04 01 15 00 00 00 01 00 02 05 3f 15 00 00 00 01 00 02 06 01 15 00 00 00 01 00 02 07 67 15 00 00 00 01 00 02 08 01 15 00 00 00 01 00 02 09 87 15 00 00 00 01 00 02 0a 01 15 00 00 00 01 00 02 0b ba 15 00 00 00 01 00 02 0c 01 15 00 00 00 01 00 02 0d e2 15 00 00 00 01 00 02 0e 02 15 00 00 00 01 00 02 0f 1f 15 00 00 00 01 00 02 10 02 15 00 00 00 01 00 02 11 50 15 00 00 00 01 00 02 12 02 15 00 00 00 01 00 02 13 51 15 00 00 00 01 00 02 14 02 15 00 00 00 01 00 02 15 7f 15 00 00 00 01 00 02 16 02 15 00 00 00 01 00 02 17 b2 15 00 00 00 01 00 02 18 02 15 00 00 00 01 00 02 19 da 15 00 00 00 01 00 02 1a 03 15 00 00 00 01 00 02 1b 02 15 00 00 00 01 00 02 1c 03 15 00 00 00 01 00 02 1d 1d 15 00 00 00 01 00 02 1e 03 15 00 00 00 01 00 02 1f 59 15 00 00 00 01 00 02 20 03 15 00 00 00 01 00 02 21 9e 15 00 00 00 01 00 02 22 03 15 00 00 00 01 00 02 23 b1 15 00 00 00 01 00 02 24 03 15 00 00 00 01 00 02 25 bd 15 00 00 00 01 00 02 26 03 15 00 00 00 01 00 02 27 c7 15 00 00 00 01 00 02 28 03 15 00 00 00 01 00 02 29 cf 15 00 00 00 01 00 02 2a 03 15 00 00 00 01 00 02 2b d5 15 00 00 00 01 00 02 2d 03 15 00 00 00 01 00 02 2f d8 15 00 00 00 01 00 02 30 03 15 00 00 00 01 00 02 31 d9 15 00 00 00 01 00 02 32 00 15 00 00 00 01 00 02 33 9f 15 00 00 00 01 00 02 34 00 15 00 00 00 01 00 02 35 b8 15 00 00 00 01 00 02 36 00 15 00 00 00 01 00 02 37 d9 15 00 00 00 01 00 02 38 00 15 00 00 00 01 00 02 39 f1 15 00 00 00 01 00 02 3a 01 15 00 00 00 01 00 02 3b 05 15 00 00 00 01 00 02 3d 01 15 00 00 00 01 00 02 3f 16 15 00 00 00 01 00 02 40 01 15 00 00 00 01 00 02 41 25 15 00 00 00 01 00 02 42 01 15 00 00 00 01 00 02 43 32 15 00 00 00 01 00 02 44 01 15 00 00 00 01 00 02 45 3f 15 00 00 00 01 00 02 46 01 15 00 00 00 01 00 02 47 67 15 00 00 00 01 00 02 48 01 15 00 00 00 01 00 02 49 87 15 00 00 00 01 00 02 4a 01 15 00 00 00 01 00 02 4b ba 15 00 00 00 01 00 02 4c 01 15 00 00 00 01 00 02 4d e2 15 00 00 00 01 00 02 4e 02 15 00 00 00 01 00 02 4f 1f 15 00 00 00 01 00 02 50 02 15 00 00 00 01 00 02 51 50 15 00 00 00 01 00 02 52 02 15 00 00 00 01 00 02 53 51 15 00 00 00 01 00 02 54 02 15 00 00 00 01 00 02 55 7f 15 00 00 00 01 00 02 56 02 15 00 00 00 01 00 02 58 b2 15 00 00 00 01 00 02 59 02 15 00 00 00 01 00 02 5a da 15 00 00 00 01 00 02 5b 03 15 00 00 00 01 00 02 5c 02 15 00 00 00 01 00 02 5d 03 15 00 00 00 01 00 02 5e 1d 15 00 00 00 01 00 02 5f 03 15 00 00 00 01 00 02 60 59 15 00 00 00 01 00 02 61 03 15 00 00 00 01 00 02 62 9e 15 00 00 00 01 00 02 63 03 15 00 00 00 01 00 02 64 b1 15 00 00 00 01 00 02 65 03 15 00 00 00 01 00 02 66 bd 15 00 00 00 01 00 02 67 03 15 00 00 00 01 00 02 68 c7 15 00 00 00 01 00 02 69 03 15 00 00 00 01 00 02 6a cf 15 00 00 00 01 00 02 6b 03 15 00 00 00 01 00 02 6c d5 15 00 00 00 01 00 02 6d 03 15 00 00 00 01 00 02 6e d8 15 00 00 00 01 00 02 6f 03 15 00 00 00 01 00 02 70 d9 15 00 00 00 01 00 02 71 02 15 00 00 00 01 00 02 72 16 15 00 00 00 01 00 02 73 02 15 00 00 00 01 00 02 74 19 15 00 00 00 01 00 02 75 02 15 00 00 00 01 00 02 76 1b 15 00 00 00 01 00 02 77 02 15 00 00 00 01 00 02 78 1d 15 00 00 00 01 00 02 79 02 15 00 00 00 01 00 02 7a 1f 15 00 00 00 01 00 02 7b 02 15 00 00 00 01 00 02 7c 21 15 00 00 00 01 00 02 7d 02 15 00 00 00 01 00 02 7e 23 15 00 00 00 01 00 02 7f 02 15 00 00 00 01 00 02 80 25 15 00 00 00 01 00 02 81 02 15 00 00 00 01 00 02 82 27 15 00 00 00 01 00 02 83 02 15 00 00 00 01 00 02 84 2e 15 00 00 00 01 00 02 85 02 15 00 00 00 01 00 02 86 35 15 00 00 00 01 00 02 87 02 15 00 00 00 01 00 02 88 43 15 00 00 00 01 00 02 89 02 15 00 00 00 01 00 02 8a 51 15 00 00 00 01 00 02 8b 02 15 00 00 00 01 00 02 8c 6d 15 00 00 00 01 00 02 8d 02 15 00 00 00 01 00 02 8e 89 15 00 00 00 01 00 02 8f 02 15 00 00 00 01 00 02 90 8a 15 00 00 00 01 00 02 91 02 15 00 00 00 01 00 02 92 aa 15 00 00 00 01 00 02 93 02 15 00 00 00 01 00 02 94 dc 15 00 00 00 01 00 02 95 02 15 00 00 00 01 00 02 96 f6 15 00 00 00 01 00 02 97 03 15 00 00 00 01 00 02 98 19 15 00 00 00 01 00 02 99 03 15 00 00 00 01 00 02 9a 31 15 00 00 00 01 00 02 9b 03 15 00 00 00 01 00 02 9c 57 15 00 00 00 01 00 02 9d 03 15 00 00 00 01 00 02 9e 6d 15 00 00 00 01 00 02 9f 03 15 00 00 00 01 00 02 a0 88 15 00 00 00 01 00 02 a2 03 15 00 00 00 01 00 02 a3 99 15 00 00 00 01 00 02 a4 03 15 00 00 00 01 00 02 a5 a3 15 00 00 00 01 00 02 a6 03 15 00 00 00 01 00 02 a7 aa 15 00 00 00 01 00 02 a9 03 15 00 00 00 01 00 02 aa ad 15 00 00 00 01 00 02 ab 03 15 00 00 00 01 00 02 ac af 15 00 00 00 01 00 02 ad 03 15 00 00 00 01 00 02 ae ff 15 00 00 00 01 00 02 af 02 15 00 00 00 01 00 02 b0 16 15 00 00 00 01 00 02 b1 02 15 00 00 00 01 00 02 b2 19 15 00 00 00 01 00 02 b3 02 15 00 00 00 01 00 02 b4 1b 15 00 00 00 01 00 02 b5 02 15 00 00 00 01 00 02 b6 1d 15 00 00 00 01 00 02 b7 02 15 00 00 00 01 00 02 b8 1f 15 00 00 00 01 00 02 b9 02 15 00 00 00 01 00 02 ba 21 15 00 00 00 01 00 02 bb 02 15 00 00 00 01 00 02 bc 23 15 00 00 00 01 00 02 bd 02 15 00 00 00 01 00 02 be 25 15 00 00 00 01 00 02 bf 02 15 00 00 00 01 00 02 c0 27 15 00 00 00 01 00 02 c1 02 15 00 00 00 01 00 02 c2 2e 15 00 00 00 01 00 02 c3 02 15 00 00 00 01 00 02 c4 35 15 00 00 00 01 00 02 c5 02 15 00 00 00 01 00 02 c6 43 15 00 00 00 01 00 02 c7 02 15 00 00 00 01 00 02 c8 51 15 00 00 00 01 00 02 c9 02 15 00 00 00 01 00 02 ca 6d 15 00 00 00 01 00 02 cb 02 15 00 00 00 01 00 02 cc 89 15 00 00 00 01 00 02 cd 02 15 00 00 00 01 00 02 ce 8a 15 00 00 00 01 00 02 cf 02 15 00 00 00 01 00 02 d0 aa 15 00 00 00 01 00 02 d1 02 15 00 00 00 01 00 02 d2 dc 15 00 00 00 01 00 02 d3 02 15 00 00 00 01 00 02 d4 f6 15 00 00 00 01 00 02 d5 03 15 00 00 00 01 00 02 d6 19 15 00 00 00 01 00 02 d7 03 15 00 00 00 01 00 02 d8 31 15 00 00 00 01 00 02 d9 03 15 00 00 00 01 00 02 da 57 15 00 00 00 01 00 02 db 03 15 00 00 00 01 00 02 dc 6d 15 00 00 00 01 00 02 dd 03 15 00 00 00 01 00 02 de 88 15 00 00 00 01 00 02 df 03 15 00 00 00 01 00 02 e0 99 15 00 00 00 01 00 02 e1 03 15 00 00 00 01 00 02 e2 a3 15 00 00 00 01 00 02 e3 03 15 00 00 00 01 00 02 e4 aa 15 00 00 00 01 00 02 e5 03 15 00 00 00 01 00 02 e6 ad 15 00 00 00 01 00 02 e7 03 15 00 00 00 01 00 02 e8 af 15 00 00 00 01 00 02 e9 03 15 00 00 00 01 00 02 ea ff 15 00 00 00 01 00 02 fb 01 15 01 00 00 01 00 02 ff 10];
        qcom,mdss-dsi-dispparam-papermode7-state = "dsi_hs_mode";
        qcom,mdss-dsi-dispparam-scon-command = [15 01 00 00 01 00 02 ff 22 15 01 00 00 01 00 02 fb 01 15 01 00 00 01 00 02 68 00 15 01 00 00 01 00 02 56 77 15 01 00 00 01 00 02 58 0e 15 01 00 00 01 00 02 59 12 15 01 00 00 01 00 02 5a 0c 15 01 00 00 01 00 02 5b 14 15 01 00 00 01 00 02 5c 0a 15 01 00 00 01 00 02 5d 16 15 01 00 00 01 00 02 5e 08 15 01 00 00 01 00 02 5f 18 15 01 00 00 01 00 02 60 06 15 01 00 00 01 00 02 61 1a 15 01 00 00 01 00 02 62 04 15 01 00 00 01 00 02 63 1c 15 01 00 00 01 00 02 64 20 15 01 00 00 01 00 02 ff 10];
        qcom,mdss-dsi-dispparam-sreon-command = [15 01 00 00 01 00 02 ff 22 15 01 00 00 01 00 02 fb 01 15 01 00 00 01 00 02 68 00 15 01 00 00 01 00 02 56 77 15 01 00 00 01 00 02 58 12 15 01 00 00 01 00 02 59 0e 15 01 00 00 01 00 02 5a 14 15 01 00 00 01 00 02 5b 0e 15 01 00 00 01 00 02 5c 16 15 01 00 00 01 00 02 5d 0e 15 01 00 00 01 00 02 5e 18 15 01 00 00 01 00 02 5f 0e 15 01 00 00 01 00 02 60 1a 15 01 00 00 01 00 02 61 0e 15 01 00 00 01 00 02 62 1c 15 01 00 00 01 00 02 63 0e 15 01 00 00 01 00 02 64 2f 15 01 00 00 01 00 02 ff 10];
        qcom,mdss-dsi-dispparam-sreoff-command = <0x15010000 0x10002ff 0x22150100 0x10002 0xfb011501 0x100 0x2560015 0x1000001 0x2ff10>;
        qcom,mdss-dsi-dispparam-vividweak-command = <0x15010000 0x100002ff 0x22150100 0x100002 0xfb011501 0x1000 0x2000015 0x1000010 0x20104 0x15010000 0x10000202 0x8150100 0x100002 0x30c1501 0x1000 0x2041015 0x1000010 0x20514 0x15010000 0x10000206 0x18150100 0x100002 0x7201501 0x1000 0x2082415 0x1000010 0x20928 0x15010000 0x1000020a 0x30150100 0x100002 0xb381501 0x1000 0x20c3815 0x1000010 0x20d30 0x15010000 0x1000020e 0x28150100 0x100002 0xf201501 0x1000 0x2101015 0x1000010 0x21100 0x15010000 0x10000212 0x150100 0x100002 0x13001501 0x1000 0x2141015 0x1000010 0x21518 0x15010000 0x10000216 0x20150100 0x100002 0x17281501 0x1000 0x2183015 0x1000010 0x21938 0x15010000 0x1000021a 0x77150100 0x100002 0x53001501 0x1000 0x2680015 0x1000010 0x2ff10>;
        qcom,mdss-dsi-dispparam-vividstrong-command = [15 01 00 00 01 00 02 ff 22 15 01 00 00 01 00 02 fb 01 15 01 00 00 01 00 02 00 28 15 01 00 00 01 00 02 01 2c 15 01 00 00 01 00 02 02 30 15 01 00 00 01 00 02 03 34 15 01 00 00 01 00 02 04 38 15 01 00 00 01 00 02 05 3c 15 01 00 00 01 00 02 06 40 15 01 00 00 01 00 02 07 48 15 01 00 00 01 00 02 08 4c 15 01 00 00 01 00 02 09 50 15 01 00 00 01 00 02 0a 58 15 01 00 00 01 00 02 0b 60 15 01 00 00 01 00 02 0c 60 15 01 00 00 01 00 02 0d 58 15 01 00 00 01 00 02 0e 50 15 01 00 00 01 00 02 0f 48 15 01 00 00 01 00 02 10 38 15 01 00 00 01 00 02 11 28 15 01 00 00 01 00 02 12 28 15 01 00 00 01 00 02 13 28 15 01 00 00 01 00 02 32 00 15 01 00 00 01 00 02 33 00 15 01 00 00 01 00 02 34 00 15 01 00 00 01 00 02 35 02 15 01 00 00 01 00 02 36 04 15 01 00 00 01 00 02 37 06 15 01 00 00 01 00 02 38 08 15 01 00 00 01 00 02 39 0a 15 01 00 00 01 00 02 3a 0c 15 01 00 00 01 00 02 3b 0e 15 01 00 00 01 00 02 3f 10 15 01 00 00 01 00 02 40 12 15 01 00 00 01 00 02 41 14 15 01 00 00 01 00 02 42 14 15 01 00 00 01 00 02 43 12 15 01 00 00 01 00 02 44 10 15 01 00 00 01 00 02 45 0e 15 01 00 00 01 00 02 46 0c 15 01 00 00 01 00 02 47 0a 15 01 00 00 01 00 02 48 08 15 01 00 00 01 00 02 49 06 15 01 00 00 01 00 02 4a 04 15 01 00 00 01 00 02 4b 02 15 01 00 00 01 00 02 4c 00 15 01 00 00 01 00 02 4d 08 15 01 00 00 01 00 02 4e 08 15 01 00 00 01 00 02 4f 08 15 01 00 00 01 00 02 50 08 15 01 00 00 01 00 02 51 08 15 01 00 00 01 00 02 52 08 15 01 00 00 01 00 02 1a 00 15 01 00 00 01 00 02 53 00 15 01 00 00 01 00 02 56 00 15 01 00 00 01 00 02 58 12 15 01 00 00 01 00 02 59 0e 15 01 00 00 01 00 02 5a 14 15 01 00 00 01 00 02 5b 0e 15 01 00 00 01 00 02 5c 16 15 01 00 00 01 00 02 5d 0e 15 01 00 00 01 00 02 5e 18 15 01 00 00 01 00 02 5f 0e 15 01 00 00 01 00 02 60 1a 15 01 00 00 01 00 02 61 0e 15 01 00 00 01 00 02 62 1c 15 01 00 00 01 00 02 63 0e 15 01 00 00 01 00 02 64 2f 15 01 00 00 01 00 02 68 00 15 01 00 00 01 00 02 ff 10 15 01 00 00 01 00 02 55 80];
        qcom,mdss-dsi-dispparam-vividoff-command = [15 01 00 00 10 00 02 ff 22 15 01 00 00 10 00 02 fb 01 15 01 00 00 10 00 02 1a 00 15 01 00 00 10 00 02 53 00 15 01 00 00 10 00 02 68 00 15 01 00 00 10 00 02 ff 10];
        qcom,mdss-dsi-dispparam-smartweak-command = [15 00 00 00 01 00 02 ff 22 15 00 00 00 01 00 02 fb 01 15 00 00 00 01 00 02 00 28 15 00 00 00 01 00 02 01 2c 15 00 00 00 01 00 02 02 30 15 00 00 00 01 00 02 03 34 15 00 00 00 01 00 02 04 38 15 00 00 00 01 00 02 05 3c 15 00 00 00 01 00 02 06 40 15 00 00 00 01 00 02 07 48 15 00 00 00 01 00 02 08 4c 15 00 00 00 01 00 02 09 50 15 00 00 00 01 00 02 0a 58 15 00 00 00 01 00 02 0b 60 15 00 00 00 01 00 02 0c 60 15 00 00 00 01 00 02 0d 58 15 00 00 00 01 00 02 0e 50 15 00 00 00 01 00 02 0f 48 15 00 00 00 01 00 02 10 38 15 00 00 00 01 00 02 11 28 15 00 00 00 01 00 02 12 28 15 00 00 00 01 00 02 13 28 15 00 00 00 01 00 02 32 00 15 00 00 00 01 00 02 33 00 15 00 00 00 01 00 02 34 00 15 00 00 00 01 00 02 35 02 15 00 00 00 01 00 02 36 04 15 00 00 00 01 00 02 37 06 15 00 00 00 01 00 02 38 08 15 00 00 00 01 00 02 39 0a 15 00 00 00 01 00 02 3a 0c 15 00 00 00 01 00 02 3b 0e 15 00 00 00 01 00 02 3f 10 15 00 00 00 01 00 02 40 12 15 00 00 00 01 00 02 41 14 15 00 00 00 01 00 02 42 14 15 00 00 00 01 00 02 43 12 15 00 00 00 01 00 02 44 10 15 00 00 00 01 00 02 45 0e 15 00 00 00 01 00 02 46 0c 15 00 00 00 01 00 02 47 0a 15 00 00 00 01 00 02 48 08 15 00 00 00 01 00 02 49 06 15 00 00 00 01 00 02 4a 04 15 00 00 00 01 00 02 4b 02 15 00 00 00 01 00 02 4c 00 15 00 00 00 01 00 02 4d 00 15 00 00 00 01 00 02 4e 08 15 00 00 00 01 00 02 4f 10 15 00 00 00 01 00 02 50 18 15 00 00 00 01 00 02 51 20 15 00 00 00 01 00 02 52 28 15 00 00 00 01 00 02 1a 00 15 00 00 00 01 00 02 53 77 15 00 00 00 01 00 02 56 00 15 00 00 00 01 00 02 68 00 15 01 00 00 01 00 02 ff 10];
        qcom,mdss-dsi-dispparam-smartstrong-command = [15 00 00 00 01 00 02 ff 22 15 00 00 00 01 00 02 fb 01 15 00 00 00 01 00 02 00 28 15 00 00 00 01 00 02 01 2c 15 00 00 00 01 00 02 02 30 15 00 00 00 01 00 02 03 34 15 00 00 00 01 00 02 04 38 15 00 00 00 01 00 02 05 3c 15 00 00 00 01 00 02 06 40 15 00 00 00 01 00 02 07 48 15 00 00 00 01 00 02 08 4c 15 00 00 00 01 00 02 09 50 15 00 00 00 01 00 02 0a 58 15 00 00 00 01 00 02 0b 60 15 00 00 00 01 00 02 0c 60 15 00 00 00 01 00 02 0d 58 15 00 00 00 01 00 02 0e 50 15 00 00 00 01 00 02 0f 48 15 00 00 00 01 00 02 10 38 15 00 00 00 01 00 02 11 28 15 00 00 00 01 00 02 12 28 15 00 00 00 01 00 02 13 28 15 00 00 00 01 00 02 32 00 15 00 00 00 01 00 02 33 00 15 00 00 00 01 00 02 34 00 15 00 00 00 01 00 02 35 03 15 00 00 00 01 00 02 36 06 15 00 00 00 01 00 02 37 09 15 00 00 00 01 00 02 38 0c 15 00 00 00 01 00 02 39 0f 15 00 00 00 01 00 02 3a 12 15 00 00 00 01 00 02 3b 15 15 00 00 00 01 00 02 3f 18 15 00 00 00 01 00 02 40 1b 15 00 00 00 01 00 02 41 1e 15 00 00 00 01 00 02 42 1e 15 00 00 00 01 00 02 43 1b 15 00 00 00 01 00 02 44 18 15 00 00 00 01 00 02 45 15 15 00 00 00 01 00 02 46 12 15 00 00 00 01 00 02 47 0f 15 00 00 00 01 00 02 48 0c 15 00 00 00 01 00 02 49 09 15 00 00 00 01 00 02 4a 06 15 00 00 00 01 00 02 4b 03 15 00 00 00 01 00 02 4c 00 15 00 00 00 01 00 02 4d 00 15 00 00 00 01 00 02 4e 08 15 00 00 00 01 00 02 4f 10 15 00 00 00 01 00 02 50 18 15 00 00 00 01 00 02 51 20 15 00 00 00 01 00 02 52 28 15 00 00 00 01 00 02 1a 00 15 00 00 00 01 00 02 53 77 15 00 00 00 01 00 02 56 00 15 00 00 00 01 00 02 68 00 15 01 00 00 01 00 02 ff 10];
        qcom,mdss-dsi-dispparam-smartoff-command = [15 01 00 00 01 00 02 ff 22 15 01 00 00 01 00 02 53 77 15 01 00 00 01 00 02 ff 10];
        qcom,mdss-dsi-dispparam-level0-command = [15 01 00 00 10 00 02 ff 22 15 01 00 00 10 00 02 56 00 15 01 00 00 10 00 02 ff 10];
        qcom,mdss-dsi-dispparam-level1-command = [15 01 00 00 10 00 02 ff 22 15 01 00 00 10 00 02 58 12 15 01 00 00 10 00 02 59 0e 15 01 00 00 10 00 02 56 01 15 01 00 00 10 00 02 ff 10];
        qcom,mdss-dsi-dispparam-level2-command = [15 01 00 00 10 00 02 ff 22 15 01 00 00 10 00 02 58 14 15 01 00 00 10 00 02 59 0e 15 01 00 00 10 00 02 56 01 15 01 00 00 10 00 02 ff 10];
        qcom,mdss-dsi-dispparam-level3-command = [15 01 00 00 10 00 02 ff 22 15 01 00 00 10 00 02 58 16 15 01 00 00 10 00 02 59 0e 15 01 00 00 10 00 02 56 01 15 01 00 00 10 00 02 ff 10];
        qcom,mdss-dsi-dispparam-level4-command = [15 01 00 00 10 00 02 ff 22 15 01 00 00 10 00 02 58 18 15 01 00 00 10 00 02 59 0e 15 01 00 00 10 00 02 56 01 15 01 00 00 10 00 02 ff 10];
        qcom,mdss-dsi-dispparam-level5-command = [15 01 00 00 10 00 02 ff 22 15 01 00 00 10 00 02 58 1a 15 01 00 00 10 00 02 59 0e 15 01 00 00 10 00 02 56 01 15 01 00 00 10 00 02 ff 10];
        qcom,mdss-dsi-dispparam-level6-command = [15 01 00 00 10 00 02 ff 22 15 01 00 00 10 00 02 58 1c 15 01 00 00 10 00 02 59 0e 15 01 00 00 10 00 02 56 01 15 01 00 00 10 00 02 ff 10];
        qcom,mdss-dsi-dispparam-idleon-command = [15 01 00 00 10 00 02 ff 10 15 01 00 00 10 00 02 39 00];
        qcom,mdss-dsi-dispparam-idleoff-command = [15 01 00 00 10 00 02 ff 10 15 01 00 00 10 00 02 38 00];
        qcom,mdss-dsi-dispparam-test-command = [15 01 00 00 10 00 02 ff 20];
        qcom,mdss-dsi-dispparam-test-command-state = "dsi_hs_mode";
	};
};
