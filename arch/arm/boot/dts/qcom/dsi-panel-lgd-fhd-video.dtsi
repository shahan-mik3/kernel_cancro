/* Copyright (c) 2012-2013, The Linux Foundation. All rights reserved.
 *
 * This program is free software; you can redistribute it and/or modify
 * it under the terms of the GNU General Public License version 2 and
 * only version 2 as published by the Free Software Foundation.
 *
 * This program is distributed in the hope that it will be useful,
 * but WITHOUT ANY WARRANTY; without even the implied warranty of
 * MERCHANTABILITY or FITNESS FOR A PARTICULAR PURPOSE.  See the
 * GNU General Public License for more details.
 */

/*---------------------------------------------------------------------------
 * This file is autogenerated file using gcdb parser. Please do not edit it.
 * Update input XML file to add a new entry or update variable in this file
 * VERSION = "1.0"
 *---------------------------------------------------------------------------*/
&soc {
	dsi_lgd_fhd_vid: qcom,mdss_dsi_lgd_fhd_video {
		compatible = "qcom,mdss-dsi-panel";
		status = "okay";
		qcom,mdss-dsi-panel-name = "lgd fhd video mode dsi panel";
		qcom,mdss-dsi-panel-id = <1>;
		qcom,mdss-dsi-panel-controller = <&mdss_dsi0>;
		qcom,mdss-dsi-panel-type = "dsi_video_mode";
		qcom,mdss-dsi-panel-destination = "display_1";
		qcom,mdss-dsi-panel-framerate = <60>;
		qcom,mdss-dsi-virtual-channel-id = <0>;
		qcom,mdss-dsi-stream = <0>;
		qcom,mdss-dsi-panel-width = <1080>;
		qcom,mdss-dsi-panel-height = <1920>;
		qcom,mdss-dsi-h-front-porch = <100>;
		qcom,mdss-dsi-h-back-porch = <50>;
		qcom,mdss-dsi-h-pulse-width = <10>;
		qcom,mdss-dsi-h-sync-skew = <0>;
		qcom,mdss-dsi-v-back-porch = <4>;
		qcom,mdss-dsi-v-front-porch = <4>;
		qcom,mdss-dsi-v-pulse-width = <2>;
		qcom,mdss-dsi-h-left-border = <0>;
		qcom,mdss-dsi-h-right-border = <0>;
		qcom,mdss-dsi-v-top-border = <0>;
		qcom,mdss-dsi-v-bottom-border = <0>;
		qcom,mdss-dsi-bpp = <24>;
		qcom,mdss-dsi-color-order = <0>;
		qcom,mdss-dsi-underflow-color = <0xff>;
		qcom,mdss-dsi-border-color = <0>;
		qcom,mdss-dsi-on-command = [
				15 01 00 00 01 00 02 34 00
				39 01 00 00 01 00 03 51 0d e0
				15 01 00 00 01 00 02 53 2c
				15 01 00 00 01 00 02 55 01
				05 01 00 00 14 00 02 29 00
				05 01 00 00 78 00 02 11 00];
		qcom,mdss-dsi-off-command = [05 01 00 00 32 00 02 28 00
				 05 01 00 00 78 00 02 10 00];
		qcom,mdss-dsi-on-command-state = "dsi_lp_mode";
		qcom,mdss-dsi-off-command-state = "dsi_hs_mode";
		qcom,mdss-dsi-h-sync-pulse = <0>;
		qcom,mdss-dsi-traffic-mode = <1>;
		qcom,mdss-dsi-lane-map = <0>;
		qcom,mdss-dsi-bllp-eof-power-mode;
		qcom,mdss-dsi-bllp-power-mode;
		qcom,mdss-dsi-lane-0-state;
		qcom,mdss-dsi-lane-1-state;
		qcom,mdss-dsi-lane-2-state;
		qcom,mdss-dsi-lane-3-state;
		qcom,mdss-dsi-panel-timings = [b0 23 1b 00 94 93 1e 25  15 03 04 00];
		qcom,mdss-dsi-t-clk-post = <0x04>;
		qcom,mdss-dsi-t-clk-pre = <0x1b>;
		qcom,mdss-dsi-bl-min-level = <10>;
		qcom,mdss-dsi-bl-max-level = <4095>;
		qcom,mdss-dsi-dma-trigger = <0x04>;
		qcom,mdss-dsi-mdp-trigger = <0x0>;
		qcom,mdss-dsi-bl-pmic-control-type = "bl_ctrl_wled";
		qcom,mdss-dsi-reset-sequence = <1 20>, <0 20>, <1 20>;
		qcom,mdss-pan-physical-width-dimension = <61>;
		qcom,mdss-pan-physical-height-dimension = <109>;
        qcom,dispparam-enabled;
        qcom,mdss-dsi-dispparam-ceon-command = [39 01 00 00 21 00 02 00 00 29 01 00 00 00 00 02 b0 04 29 01 00 00 00 00 02 d6 01 29 01 00 00 00 00 02 ca 01 29 01 00 00 00 00 02 b0 03];
        qcom,mdss-dsi-dispparam-ceon-command-state = "dsi_hs_mode";
        qcom,mdss-dsi-dispparam-ceoff-command = [39 01 00 00 21 00 02 00 00 29 01 00 00 00 00 02 b0 04 29 01 00 00 00 00 02 d6 01 29 01 00 00 00 00 02 ca 00 29 01 00 00 00 00 02 b0 03];
        qcom,mdss-dsi-dispparam-ceoff-command-state = "dsi_hs_mode";
        qcom,mdss-dsi-dispparam-cabcon-command = [39 01 00 00 00 00 02 55 01];
        qcom,mdss-dsi-dispparam-cabcon-command-state = "dsi_hs_mode";
        qcom,mdss-dsi-dispparam-cabcoff-command = [39 01 00 00 00 00 02 55 00];
        qcom,mdss-dsi-dispparam-cabcoff-command-state = "dsi_hs_mode";
        qcom,mdss-dsi-dispparam-warm-command = <0x39010000 0x21000200 0x290100 0x2 0xb0042901 0x0 0x2d60129 0x1000000 0x19c700 0x50f1b26 0x3f36505f 0x676e7500 0x50f1a27 0x4037505f 0x676e7529 0x1000000 0x19c800 0x50f1b27 0x3d36505f 0x676e7500 0x50f1a27 0x4036505f 0x676e7529 0x1000000 0x19c912 0x1519202a 0x41375666 0x6c707513 0x1519202a 0x41385666 0x6c707529 0x1000000 0x2b003>;
        qcom,mdss-dsi-dispparam-warm-command-state = "dsi_hs_mode";
        qcom,mdss-dsi-dispparam-default-command = [29 01 00 00 00 00 02 b0 04 29 01 00 00 00 00 02 d6 01 29 01 00 00 00 00 19 c7 16 19 1e 23 2c 41 37 51 5f 67 6e 75 16 1a 1d 23 2d 40 37 51 5f 67 6e 75 29 01 00 00 00 00 19 c8 00 05 0f 18 25 3e 36 51 5f 67 6e 75 00 05 0e 19 25 3e 35 51 5f 67 6e 75 29 01 00 00 00 00 19 c9 00 06 0d 15 22 3b 35 51 5f 68 6e 75 00 06 0d 15 22 3c 34 51 5f 68 6e 75 29 01 00 00 00 00 02 b0 03];
        qcom,mdss-dsi-dispparam-default-command-state = "dsi_hs_mode";
        qcom,mdss-dsi-dispparam-cold-command = <0x39010000 0x21000200 0x290100 0x2 0xb0042901 0x0 0x2d60129 0x1000000 0x19c712 0x161a222c 0x4237525f 0x676e7512 0x161a232c 0x4237535f 0x676e7529 0x1000000 0x19c813 0x161a232d 0x4137525f 0x676e7513 0x161a232d 0x4038515f 0x676e7529 0x1000000 0x19c900 0x50f1723 0x3d37505f 0x686e7500 0x50f1926 0x4035505f 0x686e7529 0x1000000 0x2b003>;
        qcom,mdss-dsi-dispparam-cold-command-state = "dsi_hs_mode";
	};
};
