/* Copyright (c) 2012-2013, The Linux Foundation. All rights reserved.
 *
 * This program is free software; you can redistribute it and/or modify
 * it under the terms of the GNU General Public License version 2 and
 * only version 2 as published by the Free Software Foundation.
 *
 * This program is distributed in the hope that it will be useful,
 * but WITHOUT ANY WARRANTY; without even the implied warranty of
 * MERCHANTABILITY or FITNESS FOR A PARTICULAR PURPOSE.  See the
 * GNU General Public License for more details.
 */

/*---------------------------------------------------------------------------
 * This file is autogenerated file using gcdb parser. Please do not edit it.
 * Update input XML file to add a new entry or update variable in this file
 * VERSION = "1.0"
 *---------------------------------------------------------------------------*/
&soc {
	dsi_jdi_fhd_xcmd: qcom,mdss_dsi_jdi_fhd_xcmd {
		compatible = "qcom,mdss-dsi-panel";
		status = "okay";
		qcom,mdss-dsi-panel-name = "jdi fhd cmd incell dsi panel";
		qcom,mdss-dsi-panel-id = <2>;
		qcom,mdss-dsi-panel-sleepwrmod = <0>;
		qcom,mdss-dsi-panel-controller = <&mdss_dsi0>;
		qcom,mdss-dsi-panel-type = "dsi_cmd_mode";
		qcom,mdss-dsi-panel-destination = "display_1";
		qcom,mdss-dsi-panel-framerate = <60>;
		qcom,mdss-dsi-virtual-channel-id = <0>;
		qcom,mdss-dsi-stream = <0>;
		qcom,mdss-dsi-panel-width = <1080>;
		qcom,mdss-dsi-panel-height = <1920>;
		qcom,mdss-dsi-h-front-porch = <80>;
		qcom,mdss-dsi-h-back-porch = <40>;
		qcom,mdss-dsi-h-pulse-width = <10>;
		qcom,mdss-dsi-h-sync-skew = <0>;
		qcom,mdss-dsi-v-back-porch = <4>;
		qcom,mdss-dsi-v-front-porch = <4>;
		qcom,mdss-dsi-v-pulse-width = <2>;
		qcom,mdss-dsi-h-left-border = <0>;
		qcom,mdss-dsi-h-right-border = <0>;
		qcom,mdss-dsi-v-top-border = <0>;
		qcom,mdss-dsi-v-bottom-border = <0>;
		qcom,mdss-dsi-bpp = <24>;
		qcom,mdss-dsi-color-order = <0>;
		qcom,mdss-dsi-underflow-color = <0xff>;
		qcom,mdss-dsi-border-color = <0>;
		qcom,mdss-dsi-on-command = [
				15 00 00 00 00 00 02 FF 10
				15 00 00 00 00 00 02 35 00
				39 00 00 00 00 00 03 44 03 e8
				39 00 00 00 00 00 05 2A 00 00 04 37
				39 00 00 00 00 00 05 2B 00 00 07 7F

				15 00 00 00 00 00 02 FF 23
				15 00 00 00 00 00 02 FB 01
				15 00 00 00 00 00 02 13 FF
				15 00 00 00 00 00 02 14 F8
				15 00 00 00 00 00 02 15 F3
				15 00 00 00 00 00 02 16 EB

				15 00 00 00 00 00 02 17 FF
				15 00 00 00 00 00 02 18 FB
				15 00 00 00 00 00 02 19 F4
				15 00 00 00 00 00 02 1A EE
				15 00 00 00 00 00 02 1B DD
				15 00 00 00 00 00 02 1C C0
				15 00 00 00 00 00 02 1D C0
				15 00 00 00 00 00 02 1E A4
				15 00 00 00 00 00 02 1F 9B
				15 00 00 00 00 00 02 20 95

				15 00 00 00 00 00 02 39 01
				15 00 00 00 00 00 02 3B 4C
				15 00 00 00 00 00 02 FF 10
				15 00 00 00 00 00 02 FB 01

				15 01 00 00 00 00 02 FF E0
				15 00 00 00 00 00 02 B5 86
				15 00 00 00 00 00 02 B6 77
				15 00 00 00 00 00 02 B8 AD
				15 00 00 00 00 00 02 FB 01
				15 01 00 00 00 00 02 FF 10

				15 00 00 00 00 00 02 51 de
				15 00 00 00 00 00 02 53 2c
				15 01 00 00 00 00 02 55 00
				05 01 00 00 78 00 02 11 00
				05 01 00 00 14 00 02 29 00];
		qcom,mdss-dsi-off-command = [
				15 01 00 00 00 00 02 FF 10
				05 01 00 00 02 00 02 28 00
				05 01 00 00 78 00 02 10 00];
		qcom,mdss-dsi-on-command-state = "dsi_lp_mode";
		qcom,mdss-dsi-off-command-state = "dsi_hs_mode";
		qcom,mdss-dsi-h-sync-pulse = <0>;
		qcom,mdss-dsi-traffic-mode = <1>;
		qcom,mdss-dsi-lane-map = <0>;
		qcom,mdss-dsi-bllp-eof-power-mode;
		qcom,mdss-dsi-bllp-power-mode;
		qcom,mdss-dsi-lane-0-state;
		qcom,mdss-dsi-lane-1-state;
		qcom,mdss-dsi-lane-2-state;
		qcom,mdss-dsi-lane-3-state;
		qcom,mdss-dsi-te-pin-select = <1>;
		qcom,mdss-dsi-te-v-sync-rd-ptr-irq-line = <0x2c>;
		qcom,mdss-dsi-te-v-sync-continues-lines = <0x3c>;
		qcom,mdss-dsi-te-dcs-command = <1>;
		qcom,mdss-dsi-te-check-enable;
		qcom,mdss-dsi-te-using-te-pin;
		qcom,mdss-dsi-panel-timings = [e3 50 36 00 a9 a3 3a 50 3d 03 04 00];
		qcom,mdss-dsi-t-clk-post = <0x20>;
		qcom,mdss-dsi-t-clk-pre = <0x36>;
		qcom,mdss-dsi-bl-min-level = <8>;
		qcom,mdss-dsi-bl-max-level = <4095>;
		qcom,mdss-dsi-dma-trigger = <0x04>;
		qcom,mdss-dsi-mdp-trigger = <0x0>;
		qcom,mdss-dsi-bl-pmic-control-type = "bl_ctrl_wled";
		qcom,mdss-dsi-reset-sequence = <1 10>, <0 1>, <1 10>;
		qcom,mdss-pan-physical-width-dimension = <71>;
		qcom,mdss-pan-physical-height-dimension = <126>;
        qcom,dispparam-enabled;
        qcom,mdss-dsi-dispparam-ceon-command = [15 00 00 00 01 00 02 ff 10 15 01 00 00 10 00 02 55 80];
        qcom,mdss-dsi-dispparam-ceon-command-state = "dsi_hs_mode";
        qcom,mdss-dsi-dispparam-ceoff-command = [15 00 00 00 01 00 02 ff 10 15 01 00 00 10 00 02 55 00];
        qcom,mdss-dsi-dispparam-ceoff-command-state = "dsi_hs_mode";
        qcom,mdss-dsi-dispparam-cabcon-command = <0x15000000 0x10002ff 0x10150000 0x10002 0x51de1500 0x100 0x2532c15 0x1000001 0x25502>;
        qcom,mdss-dsi-dispparam-cabcguion-command = [15 00 00 00 01 00 02 ff 10 15 01 00 00 01 00 02 55 01];
        qcom,mdss-dsi-dispparam-cabcstillon-command = [15 00 00 00 01 00 02 ff 10 15 01 00 00 01 00 02 55 02];
        qcom,mdss-dsi-dispparam-cabcmovieon-command = [15 00 00 00 01 00 02 ff 10 15 01 00 00 01 00 02 55 03];
        qcom,mdss-dsi-dispparam-cabcon-command-state = "dsi_hs_mode";
        qcom,mdss-dsi-dispparam-cabcoff-command = [15 00 00 00 01 00 02 ff 10 15 01 00 00 01 00 02 55 00];
        qcom,mdss-dsi-dispparam-cabcoff-command-state = "dsi_hs_mode";
        qcom,mdss-dsi-dispparam-warm-command = [15 00 00 00 01 00 02 ff 20 15 00 00 00 01 00 02 75 00 15 00 00 00 01 00 02 76 00 15 00 00 00 01 00 02 77 00 15 00 00 00 01 00 02 78 14 15 00 00 00 01 00 02 79 00 15 00 00 00 01 00 02 7a 3d 15 00 00 00 01 00 02 7b 00 15 00 00 00 01 00 02 7c 5c 15 00 00 00 01 00 02 7d 00 15 00 00 00 01 00 02 7e 7a 15 00 00 00 01 00 02 7f 00 15 00 00 00 01 00 02 80 94 15 00 00 00 01 00 02 81 00 15 00 00 00 01 00 02 82 ad 15 00 00 00 01 00 02 83 00 15 00 00 00 01 00 02 84 c1 15 00 00 00 01 00 02 85 00 15 00 00 00 01 00 02 86 d4 15 00 00 00 01 00 02 87 01 15 00 00 00 01 00 02 88 14 15 00 00 00 01 00 02 89 01 15 00 00 00 01 00 02 8a 46 15 00 00 00 01 00 02 8b 01 15 00 00 00 01 00 02 8c 90 15 00 00 00 01 00 02 8d 01 15 00 00 00 01 00 02 8e c6 15 00 00 00 01 00 02 8f 02 15 00 00 00 01 00 02 90 17 15 00 00 00 01 00 02 91 02 15 00 00 00 01 00 02 92 56 15 00 00 00 01 00 02 93 02 15 00 00 00 01 00 02 94 58 15 00 00 00 01 00 02 95 02 15 00 00 00 01 00 02 96 92 15 00 00 00 01 00 02 97 02 15 00 00 00 01 00 02 98 d0 15 00 00 00 01 00 02 99 02 15 00 00 00 01 00 02 9a f6 15 00 00 00 01 00 02 9b 03 15 00 00 00 01 00 02 9c 26 15 00 00 00 01 00 02 9d 03 15 00 00 00 01 00 02 9e 46 15 00 00 00 01 00 02 9f 03 15 00 00 00 01 00 02 a0 72 15 00 00 00 01 00 02 a2 03 15 00 00 00 01 00 02 a3 81 15 00 00 00 01 00 02 a4 03 15 00 00 00 01 00 02 a5 90 15 00 00 00 01 00 02 a6 03 15 00 00 00 01 00 02 a7 a1 15 00 00 00 01 00 02 a9 03 15 00 00 00 01 00 02 aa b3 15 00 00 00 01 00 02 ab 03 15 00 00 00 01 00 02 ac c6 15 00 00 00 01 00 02 ad 03 15 00 00 00 01 00 02 ae dc 15 00 00 00 01 00 02 af 03 15 00 00 00 01 00 02 b0 f4 15 00 00 00 01 00 02 b1 03 15 00 00 00 01 00 02 b2 ff 15 00 00 00 01 00 02 b3 00 15 00 00 00 01 00 02 b4 00 15 00 00 00 01 00 02 b5 00 15 00 00 00 01 00 02 b6 14 15 00 00 00 01 00 02 b7 00 15 00 00 00 01 00 02 b8 3d 15 00 00 00 01 00 02 b9 00 15 00 00 00 01 00 02 ba 5c 15 00 00 00 01 00 02 bb 00 15 00 00 00 01 00 02 bc 7a 15 00 00 00 01 00 02 bd 00 15 00 00 00 01 00 02 be 94 15 00 00 00 01 00 02 bf 00 15 00 00 00 01 00 02 c0 ad 15 00 00 00 01 00 02 c1 00 15 00 00 00 01 00 02 c2 c1 15 00 00 00 01 00 02 c3 00 15 00 00 00 01 00 02 c4 d4 15 00 00 00 01 00 02 c5 01 15 00 00 00 01 00 02 c6 14 15 00 00 00 01 00 02 c7 01 15 00 00 00 01 00 02 c8 46 15 00 00 00 01 00 02 c9 01 15 00 00 00 01 00 02 ca 90 15 00 00 00 01 00 02 cb 01 15 00 00 00 01 00 02 cc c6 15 00 00 00 01 00 02 cd 02 15 00 00 00 01 00 02 ce 17 15 00 00 00 01 00 02 cf 02 15 00 00 00 01 00 02 d0 56 15 00 00 00 01 00 02 d1 02 15 00 00 00 01 00 02 d2 58 15 00 00 00 01 00 02 d3 02 15 00 00 00 01 00 02 d4 92 15 00 00 00 01 00 02 d5 02 15 00 00 00 01 00 02 d6 d0 15 00 00 00 01 00 02 d7 02 15 00 00 00 01 00 02 d8 f6 15 00 00 00 01 00 02 d9 03 15 00 00 00 01 00 02 da 26 15 00 00 00 01 00 02 db 03 15 00 00 00 01 00 02 dc 46 15 00 00 00 01 00 02 dd 03 15 00 00 00 01 00 02 de 72 15 00 00 00 01 00 02 df 03 15 00 00 00 01 00 02 e0 81 15 00 00 00 01 00 02 e1 03 15 00 00 00 01 00 02 e2 90 15 00 00 00 01 00 02 e3 03 15 00 00 00 01 00 02 e4 a1 15 00 00 00 01 00 02 e5 03 15 00 00 00 01 00 02 e6 b3 15 00 00 00 01 00 02 e7 03 15 00 00 00 01 00 02 e8 c6 15 00 00 00 01 00 02 e9 03 15 00 00 00 01 00 02 ea dc 15 00 00 00 01 00 02 eb 03 15 00 00 00 01 00 02 ec f4 15 00 00 00 01 00 02 ed 03 15 00 00 00 01 00 02 ee ff 15 00 00 00 01 00 02 ef 00 15 00 00 00 01 00 02 f0 c7 15 00 00 00 01 00 02 f1 00 15 00 00 00 01 00 02 f2 d0 15 00 00 00 01 00 02 f3 00 15 00 00 00 01 00 02 f4 e2 15 00 00 00 01 00 02 f5 00 15 00 00 00 01 00 02 f6 f2 15 00 00 00 01 00 02 f7 01 15 00 00 00 01 00 02 f8 02 15 00 00 00 01 00 02 f9 01 15 00 00 00 01 00 02 fa 10 15 00 00 00 01 00 02 fb 01 15 00 00 00 01 00 02 ff 21 15 00 00 00 01 00 02 00 01 15 00 00 00 01 00 02 01 1f 15 00 00 00 01 00 02 02 01 15 00 00 00 01 00 02 03 2b 15 00 00 00 01 00 02 04 01 15 00 00 00 01 00 02 05 37 15 00 00 00 01 00 02 06 01 15 00 00 00 01 00 02 07 60 15 00 00 00 01 00 02 08 01 15 00 00 00 01 00 02 09 84 15 00 00 00 01 00 02 0a 01 15 00 00 00 01 00 02 0b bb 15 00 00 00 01 00 02 0c 01 15 00 00 00 01 00 02 0d e7 15 00 00 00 01 00 02 0e 02 15 00 00 00 01 00 02 0f 2c 15 00 00 00 01 00 02 10 02 15 00 00 00 01 00 02 11 66 15 00 00 00 01 00 02 12 02 15 00 00 00 01 00 02 13 68 15 00 00 00 01 00 02 14 02 15 00 00 00 01 00 02 15 9e 15 00 00 00 01 00 02 16 02 15 00 00 00 01 00 02 17 da 15 00 00 00 01 00 02 18 02 15 00 00 00 01 00 02 19 ff 15 00 00 00 01 00 02 1a 03 15 00 00 00 01 00 02 1b 2d 15 00 00 00 01 00 02 1c 03 15 00 00 00 01 00 02 1d 4d 15 00 00 00 01 00 02 1e 03 15 00 00 00 01 00 02 1f 78 15 00 00 00 01 00 02 20 03 15 00 00 00 01 00 02 21 86 15 00 00 00 01 00 02 22 03 15 00 00 00 01 00 02 23 94 15 00 00 00 01 00 02 24 03 15 00 00 00 01 00 02 25 a4 15 00 00 00 01 00 02 26 03 15 00 00 00 01 00 02 27 b5 15 00 00 00 01 00 02 28 03 15 00 00 00 01 00 02 29 c8 15 00 00 00 01 00 02 2a 03 15 00 00 00 01 00 02 2b dd 15 00 00 00 01 00 02 2d 03 15 00 00 00 01 00 02 2f f4 15 00 00 00 01 00 02 30 03 15 00 00 00 01 00 02 31 ff 15 00 00 00 01 00 02 32 00 15 00 00 00 01 00 02 33 c7 15 00 00 00 01 00 02 34 00 15 00 00 00 01 00 02 35 d0 15 00 00 00 01 00 02 36 00 15 00 00 00 01 00 02 37 e2 15 00 00 00 01 00 02 38 00 15 00 00 00 01 00 02 39 f2 15 00 00 00 01 00 02 3a 01 15 00 00 00 01 00 02 3b 02 15 00 00 00 01 00 02 3d 01 15 00 00 00 01 00 02 3f 10 15 00 00 00 01 00 02 40 01 15 00 00 00 01 00 02 41 1f 15 00 00 00 01 00 02 42 01 15 00 00 00 01 00 02 43 2b 15 00 00 00 01 00 02 44 01 15 00 00 00 01 00 02 45 37 15 00 00 00 01 00 02 46 01 15 00 00 00 01 00 02 47 60 15 00 00 00 01 00 02 48 01 15 00 00 00 01 00 02 49 84 15 00 00 00 01 00 02 4a 01 15 00 00 00 01 00 02 4b bb 15 00 00 00 01 00 02 4c 01 15 00 00 00 01 00 02 4d e7 15 00 00 00 01 00 02 4e 02 15 00 00 00 01 00 02 4f 2c 15 00 00 00 01 00 02 50 02 15 00 00 00 01 00 02 51 66 15 00 00 00 01 00 02 52 02 15 00 00 00 01 00 02 53 68 15 00 00 00 01 00 02 54 02 15 00 00 00 01 00 02 55 9e 15 00 00 00 01 00 02 56 02 15 00 00 00 01 00 02 58 da 15 00 00 00 01 00 02 59 02 15 00 00 00 01 00 02 5a ff 15 00 00 00 01 00 02 5b 03 15 00 00 00 01 00 02 5c 2d 15 00 00 00 01 00 02 5d 03 15 00 00 00 01 00 02 5e 4d 15 00 00 00 01 00 02 5f 03 15 00 00 00 01 00 02 60 78 15 00 00 00 01 00 02 61 03 15 00 00 00 01 00 02 62 86 15 00 00 00 01 00 02 63 03 15 00 00 00 01 00 02 64 94 15 00 00 00 01 00 02 65 03 15 00 00 00 01 00 02 66 a4 15 00 00 00 01 00 02 67 03 15 00 00 00 01 00 02 68 b5 15 00 00 00 01 00 02 69 03 15 00 00 00 01 00 02 6a c8 15 00 00 00 01 00 02 6b 03 15 00 00 00 01 00 02 6c dd 15 00 00 00 01 00 02 6d 03 15 00 00 00 01 00 02 6e f4 15 00 00 00 01 00 02 6f 03 15 00 00 00 01 00 02 70 ff 15 00 00 00 01 00 02 71 01 15 00 00 00 01 00 02 72 79 15 00 00 00 01 00 02 73 01 15 00 00 00 01 00 02 74 7d 15 00 00 00 01 00 02 75 01 15 00 00 00 01 00 02 76 84 15 00 00 00 01 00 02 77 01 15 00 00 00 01 00 02 78 8b 15 00 00 00 01 00 02 79 01 15 00 00 00 01 00 02 7a 92 15 00 00 00 01 00 02 7b 01 15 00 00 00 01 00 02 7c 99 15 00 00 00 01 00 02 7d 01 15 00 00 00 01 00 02 7e 9f 15 00 00 00 01 00 02 7f 01 15 00 00 00 01 00 02 80 a5 15 00 00 00 01 00 02 81 01 15 00 00 00 01 00 02 82 ab 15 00 00 00 01 00 02 83 01 15 00 00 00 01 00 02 84 c1 15 00 00 00 01 00 02 85 01 15 00 00 00 01 00 02 86 d6 15 00 00 00 01 00 02 87 01 15 00 00 00 01 00 02 88 f9 15 00 00 00 01 00 02 89 02 15 00 00 00 01 00 02 8a 19 15 00 00 00 01 00 02 8b 02 15 00 00 00 01 00 02 8c 4e 15 00 00 00 01 00 02 8d 02 15 00 00 00 01 00 02 8e 7f 15 00 00 00 01 00 02 8f 02 15 00 00 00 01 00 02 90 80 15 00 00 00 01 00 02 91 02 15 00 00 00 01 00 02 92 b1 15 00 00 00 01 00 02 93 02 15 00 00 00 01 00 02 94 e9 15 00 00 00 01 00 02 95 03 15 00 00 00 01 00 02 96 0e 15 00 00 00 01 00 02 97 03 15 00 00 00 01 00 02 98 3a 15 00 00 00 01 00 02 99 03 15 00 00 00 01 00 02 9a 59 15 00 00 00 01 00 02 9b 03 15 00 00 00 01 00 02 9c 82 15 00 00 00 01 00 02 9d 03 15 00 00 00 01 00 02 9e 8f 15 00 00 00 01 00 02 9f 03 15 00 00 00 01 00 02 a0 9d 15 00 00 00 01 00 02 a2 03 15 00 00 00 01 00 02 a3 ac 15 00 00 00 01 00 02 a4 03 15 00 00 00 01 00 02 a5 bb 15 00 00 00 01 00 02 a6 03 15 00 00 00 01 00 02 a7 cd 15 00 00 00 01 00 02 a9 03 15 00 00 00 01 00 02 aa e0 15 00 00 00 01 00 02 ab 03 15 00 00 00 01 00 02 ac f5 15 00 00 00 01 00 02 ad 03 15 00 00 00 01 00 02 ae ff 15 00 00 00 01 00 02 af 01 15 00 00 00 01 00 02 b0 79 15 00 00 00 01 00 02 b1 01 15 00 00 00 01 00 02 b2 7d 15 00 00 00 01 00 02 b3 01 15 00 00 00 01 00 02 b4 84 15 00 00 00 01 00 02 b5 01 15 00 00 00 01 00 02 b6 8b 15 00 00 00 01 00 02 b7 01 15 00 00 00 01 00 02 b8 92 15 00 00 00 01 00 02 b9 01 15 00 00 00 01 00 02 ba 99 15 00 00 00 01 00 02 bb 01 15 00 00 00 01 00 02 bc 9f 15 00 00 00 01 00 02 bd 01 15 00 00 00 01 00 02 be a5 15 00 00 00 01 00 02 bf 01 15 00 00 00 01 00 02 c0 ab 15 00 00 00 01 00 02 c1 01 15 00 00 00 01 00 02 c2 c1 15 00 00 00 01 00 02 c3 01 15 00 00 00 01 00 02 c4 d6 15 00 00 00 01 00 02 c5 01 15 00 00 00 01 00 02 c6 f9 15 00 00 00 01 00 02 c7 02 15 00 00 00 01 00 02 c8 19 15 00 00 00 01 00 02 c9 02 15 00 00 00 01 00 02 ca 4e 15 00 00 00 01 00 02 cb 02 15 00 00 00 01 00 02 cc 7f 15 00 00 00 01 00 02 cd 02 15 00 00 00 01 00 02 ce 80 15 00 00 00 01 00 02 cf 02 15 00 00 00 01 00 02 d0 b1 15 00 00 00 01 00 02 d1 02 15 00 00 00 01 00 02 d2 e9 15 00 00 00 01 00 02 d3 03 15 00 00 00 01 00 02 d4 0e 15 00 00 00 01 00 02 d5 03 15 00 00 00 01 00 02 d6 3a 15 00 00 00 01 00 02 d7 03 15 00 00 00 01 00 02 d8 59 15 00 00 00 01 00 02 d9 03 15 00 00 00 01 00 02 da 82 15 00 00 00 01 00 02 db 03 15 00 00 00 01 00 02 dc 8f 15 00 00 00 01 00 02 dd 03 15 00 00 00 01 00 02 de 9d 15 00 00 00 01 00 02 df 03 15 00 00 00 01 00 02 e0 ac 15 00 00 00 01 00 02 e1 03 15 00 00 00 01 00 02 e2 bb 15 00 00 00 01 00 02 e3 03 15 00 00 00 01 00 02 e4 cd 15 00 00 00 01 00 02 e5 03 15 00 00 00 01 00 02 e6 e0 15 00 00 00 01 00 02 e7 03 15 00 00 00 01 00 02 e8 f5 15 00 00 00 01 00 02 e9 03 15 00 00 00 01 00 02 ea ff 15 00 00 00 01 00 02 fb 01 15 01 00 00 01 00 02 ff 10];
        qcom,mdss-dsi-dispparam-warm-command-state = "dsi_hs_mode";
        qcom,mdss-dsi-dispparam-default-command = [15 00 00 00 01 00 02 ff 20 15 00 00 00 01 00 02 75 00 15 00 00 00 01 00 02 76 00 15 00 00 00 01 00 02 77 00 15 00 00 00 01 00 02 78 13 15 00 00 00 01 00 02 79 00 15 00 00 00 01 00 02 7a 3d 15 00 00 00 01 00 02 7b 00 15 00 00 00 01 00 02 7c 5e 15 00 00 00 01 00 02 7d 00 15 00 00 00 01 00 02 7e 7f 15 00 00 00 01 00 02 7f 00 15 00 00 00 01 00 02 80 97 15 00 00 00 01 00 02 81 00 15 00 00 00 01 00 02 82 b0 15 00 00 00 01 00 02 83 00 15 00 00 00 01 00 02 84 c3 15 00 00 00 01 00 02 85 00 15 00 00 00 01 00 02 86 d8 15 00 00 00 01 00 02 87 01 15 00 00 00 01 00 02 88 17 15 00 00 00 01 00 02 89 01 15 00 00 00 01 00 02 8a 48 15 00 00 00 01 00 02 8b 01 15 00 00 00 01 00 02 8c 91 15 00 00 00 01 00 02 8d 01 15 00 00 00 01 00 02 8e c8 15 00 00 00 01 00 02 8f 02 15 00 00 00 01 00 02 90 18 15 00 00 00 01 00 02 91 02 15 00 00 00 01 00 02 92 57 15 00 00 00 01 00 02 93 02 15 00 00 00 01 00 02 94 59 15 00 00 00 01 00 02 95 02 15 00 00 00 01 00 02 96 93 15 00 00 00 01 00 02 97 02 15 00 00 00 01 00 02 98 d0 15 00 00 00 01 00 02 99 02 15 00 00 00 01 00 02 9a f8 15 00 00 00 01 00 02 9b 03 15 00 00 00 01 00 02 9c 28 15 00 00 00 01 00 02 9d 03 15 00 00 00 01 00 02 9e 4a 15 00 00 00 01 00 02 9f 03 15 00 00 00 01 00 02 a0 7a 15 00 00 00 01 00 02 a2 03 15 00 00 00 01 00 02 a3 88 15 00 00 00 01 00 02 a4 03 15 00 00 00 01 00 02 a5 97 15 00 00 00 01 00 02 a6 03 15 00 00 00 01 00 02 a7 a7 15 00 00 00 01 00 02 a9 03 15 00 00 00 01 00 02 aa b9 15 00 00 00 01 00 02 ab 03 15 00 00 00 01 00 02 ac cb 15 00 00 00 01 00 02 ad 03 15 00 00 00 01 00 02 ae df 15 00 00 00 01 00 02 af 03 15 00 00 00 01 00 02 b0 f5 15 00 00 00 01 00 02 b1 03 15 00 00 00 01 00 02 b2 ff 15 00 00 00 01 00 02 b3 00 15 00 00 00 01 00 02 b4 00 15 00 00 00 01 00 02 b5 00 15 00 00 00 01 00 02 b6 13 15 00 00 00 01 00 02 b7 00 15 00 00 00 01 00 02 b8 3d 15 00 00 00 01 00 02 b9 00 15 00 00 00 01 00 02 ba 5e 15 00 00 00 01 00 02 bb 00 15 00 00 00 01 00 02 bc 7f 15 00 00 00 01 00 02 bd 00 15 00 00 00 01 00 02 be 97 15 00 00 00 01 00 02 bf 00 15 00 00 00 01 00 02 c0 b0 15 00 00 00 01 00 02 c1 00 15 00 00 00 01 00 02 c2 c3 15 00 00 00 01 00 02 c3 00 15 00 00 00 01 00 02 c4 d8 15 00 00 00 01 00 02 c5 01 15 00 00 00 01 00 02 c6 17 15 00 00 00 01 00 02 c7 01 15 00 00 00 01 00 02 c8 48 15 00 00 00 01 00 02 c9 01 15 00 00 00 01 00 02 ca 91 15 00 00 00 01 00 02 cb 01 15 00 00 00 01 00 02 cc c8 15 00 00 00 01 00 02 cd 02 15 00 00 00 01 00 02 ce 18 15 00 00 00 01 00 02 cf 02 15 00 00 00 01 00 02 d0 57 15 00 00 00 01 00 02 d1 02 15 00 00 00 01 00 02 d2 59 15 00 00 00 01 00 02 d3 02 15 00 00 00 01 00 02 d4 93 15 00 00 00 01 00 02 d5 02 15 00 00 00 01 00 02 d6 d0 15 00 00 00 01 00 02 d7 02 15 00 00 00 01 00 02 d8 f8 15 00 00 00 01 00 02 d9 03 15 00 00 00 01 00 02 da 28 15 00 00 00 01 00 02 db 03 15 00 00 00 01 00 02 dc 4a 15 00 00 00 01 00 02 dd 03 15 00 00 00 01 00 02 de 7a 15 00 00 00 01 00 02 df 03 15 00 00 00 01 00 02 e0 88 15 00 00 00 01 00 02 e1 03 15 00 00 00 01 00 02 e2 97 15 00 00 00 01 00 02 e3 03 15 00 00 00 01 00 02 e4 a7 15 00 00 00 01 00 02 e5 03 15 00 00 00 01 00 02 e6 b9 15 00 00 00 01 00 02 e7 03 15 00 00 00 01 00 02 e8 cb 15 00 00 00 01 00 02 e9 03 15 00 00 00 01 00 02 ea df 15 00 00 00 01 00 02 eb 03 15 00 00 00 01 00 02 ec f5 15 00 00 00 01 00 02 ed 03 15 00 00 00 01 00 02 ee ff 15 00 00 00 01 00 02 ef 00 15 00 00 00 01 00 02 f0 64 15 00 00 00 01 00 02 f1 00 15 00 00 00 01 00 02 f2 73 15 00 00 00 01 00 02 f3 00 15 00 00 00 01 00 02 f4 91 15 00 00 00 01 00 02 f5 00 15 00 00 00 01 00 02 f6 a9 15 00 00 00 01 00 02 f7 00 15 00 00 00 01 00 02 f8 c0 15 00 00 00 01 00 02 f9 00 15 00 00 00 01 00 02 fa d4 15 00 00 00 01 00 02 fb 01 15 00 00 00 01 00 02 ff 21 15 00 00 00 01 00 02 00 00 15 00 00 00 01 00 02 01 e7 15 00 00 00 01 00 02 02 00 15 00 00 00 01 00 02 03 f7 15 00 00 00 01 00 02 04 01 15 00 00 00 01 00 02 05 08 15 00 00 00 01 00 02 06 01 15 00 00 00 01 00 02 07 3d 15 00 00 00 01 00 02 08 01 15 00 00 00 01 00 02 09 67 15 00 00 00 01 00 02 0a 01 15 00 00 00 01 00 02 0b a7 15 00 00 00 01 00 02 0c 01 15 00 00 00 01 00 02 0d da 15 00 00 00 01 00 02 0e 02 15 00 00 00 01 00 02 0f 25 15 00 00 00 01 00 02 10 02 15 00 00 00 01 00 02 11 60 15 00 00 00 01 00 02 12 02 15 00 00 00 01 00 02 13 62 15 00 00 00 01 00 02 14 02 15 00 00 00 01 00 02 15 9a 15 00 00 00 01 00 02 16 02 15 00 00 00 01 00 02 17 d7 15 00 00 00 01 00 02 18 02 15 00 00 00 01 00 02 19 fc 15 00 00 00 01 00 02 1a 03 15 00 00 00 01 00 02 1b 2b 15 00 00 00 01 00 02 1c 03 15 00 00 00 01 00 02 1d 4b 15 00 00 00 01 00 02 1e 03 15 00 00 00 01 00 02 1f 76 15 00 00 00 01 00 02 20 03 15 00 00 00 01 00 02 21 85 15 00 00 00 01 00 02 22 03 15 00 00 00 01 00 02 23 94 15 00 00 00 01 00 02 24 03 15 00 00 00 01 00 02 25 a4 15 00 00 00 01 00 02 26 03 15 00 00 00 01 00 02 27 b5 15 00 00 00 01 00 02 28 03 15 00 00 00 01 00 02 29 c8 15 00 00 00 01 00 02 2a 03 15 00 00 00 01 00 02 2b dd 15 00 00 00 01 00 02 2d 03 15 00 00 00 01 00 02 2f f4 15 00 00 00 01 00 02 30 03 15 00 00 00 01 00 02 31 ff 15 00 00 00 01 00 02 32 00 15 00 00 00 01 00 02 33 64 15 00 00 00 01 00 02 34 00 15 00 00 00 01 00 02 35 73 15 00 00 00 01 00 02 36 00 15 00 00 00 01 00 02 37 91 15 00 00 00 01 00 02 38 00 15 00 00 00 01 00 02 39 a9 15 00 00 00 01 00 02 3a 00 15 00 00 00 01 00 02 3b c0 15 00 00 00 01 00 02 3d 00 15 00 00 00 01 00 02 3f d4 15 00 00 00 01 00 02 40 00 15 00 00 00 01 00 02 41 e7 15 00 00 00 01 00 02 42 00 15 00 00 00 01 00 02 43 f7 15 00 00 00 01 00 02 44 01 15 00 00 00 01 00 02 45 08 15 00 00 00 01 00 02 46 01 15 00 00 00 01 00 02 47 3d 15 00 00 00 01 00 02 48 01 15 00 00 00 01 00 02 49 67 15 00 00 00 01 00 02 4a 01 15 00 00 00 01 00 02 4b a7 15 00 00 00 01 00 02 4c 01 15 00 00 00 01 00 02 4d da 15 00 00 00 01 00 02 4e 02 15 00 00 00 01 00 02 4f 25 15 00 00 00 01 00 02 50 02 15 00 00 00 01 00 02 51 60 15 00 00 00 01 00 02 52 02 15 00 00 00 01 00 02 53 62 15 00 00 00 01 00 02 54 02 15 00 00 00 01 00 02 55 9a 15 00 00 00 01 00 02 56 02 15 00 00 00 01 00 02 58 d7 15 00 00 00 01 00 02 59 02 15 00 00 00 01 00 02 5a fc 15 00 00 00 01 00 02 5b 03 15 00 00 00 01 00 02 5c 2b 15 00 00 00 01 00 02 5d 03 15 00 00 00 01 00 02 5e 4b 15 00 00 00 01 00 02 5f 03 15 00 00 00 01 00 02 60 76 15 00 00 00 01 00 02 61 03 15 00 00 00 01 00 02 62 85 15 00 00 00 01 00 02 63 03 15 00 00 00 01 00 02 64 94 15 00 00 00 01 00 02 65 03 15 00 00 00 01 00 02 66 a4 15 00 00 00 01 00 02 67 03 15 00 00 00 01 00 02 68 b5 15 00 00 00 01 00 02 69 03 15 00 00 00 01 00 02 6a c8 15 00 00 00 01 00 02 6b 03 15 00 00 00 01 00 02 6c dd 15 00 00 00 01 00 02 6d 03 15 00 00 00 01 00 02 6e f4 15 00 00 00 01 00 02 6f 03 15 00 00 00 01 00 02 70 ff 15 00 00 00 01 00 02 71 01 15 00 00 00 01 00 02 72 1f 15 00 00 00 01 00 02 73 01 15 00 00 00 01 00 02 74 25 15 00 00 00 01 00 02 75 01 15 00 00 00 01 00 02 76 31 15 00 00 00 01 00 02 77 01 15 00 00 00 01 00 02 78 3c 15 00 00 00 01 00 02 79 01 15 00 00 00 01 00 02 7a 48 15 00 00 00 01 00 02 7b 01 15 00 00 00 01 00 02 7c 52 15 00 00 00 01 00 02 7d 01 15 00 00 00 01 00 02 7e 5c 15 00 00 00 01 00 02 7f 01 15 00 00 00 01 00 02 80 65 15 00 00 00 01 00 02 81 01 15 00 00 00 01 00 02 82 6e 15 00 00 00 01 00 02 83 01 15 00 00 00 01 00 02 84 8e 15 00 00 00 01 00 02 85 01 15 00 00 00 01 00 02 86 aa 15 00 00 00 01 00 02 87 01 15 00 00 00 01 00 02 88 d9 15 00 00 00 01 00 02 89 01 15 00 00 00 01 00 02 8a fe 15 00 00 00 01 00 02 8b 02 15 00 00 00 01 00 02 8c 3d 15 00 00 00 01 00 02 8d 02 15 00 00 00 01 00 02 8e 72 15 00 00 00 01 00 02 8f 02 15 00 00 00 01 00 02 90 73 15 00 00 00 01 00 02 91 02 15 00 00 00 01 00 02 92 a7 15 00 00 00 01 00 02 93 02 15 00 00 00 01 00 02 94 e1 15 00 00 00 01 00 02 95 03 15 00 00 00 01 00 02 96 05 15 00 00 00 01 00 02 97 03 15 00 00 00 01 00 02 98 33 15 00 00 00 01 00 02 99 03 15 00 00 00 01 00 02 9a 52 15 00 00 00 01 00 02 9b 03 15 00 00 00 01 00 02 9c 7d 15 00 00 00 01 00 02 9d 03 15 00 00 00 01 00 02 9e 8a 15 00 00 00 01 00 02 9f 03 15 00 00 00 01 00 02 a0 98 15 00 00 00 01 00 02 a2 03 15 00 00 00 01 00 02 a3 a7 15 00 00 00 01 00 02 a4 03 15 00 00 00 01 00 02 a5 b8 15 00 00 00 01 00 02 a6 03 15 00 00 00 01 00 02 a7 ca 15 00 00 00 01 00 02 a9 03 15 00 00 00 01 00 02 aa de 15 00 00 00 01 00 02 ab 03 15 00 00 00 01 00 02 ac f5 15 00 00 00 01 00 02 ad 03 15 00 00 00 01 00 02 ae ff 15 00 00 00 01 00 02 af 01 15 00 00 00 01 00 02 b0 1f 15 00 00 00 01 00 02 b1 01 15 00 00 00 01 00 02 b2 25 15 00 00 00 01 00 02 b3 01 15 00 00 00 01 00 02 b4 31 15 00 00 00 01 00 02 b5 01 15 00 00 00 01 00 02 b6 3c 15 00 00 00 01 00 02 b7 01 15 00 00 00 01 00 02 b8 48 15 00 00 00 01 00 02 b9 01 15 00 00 00 01 00 02 ba 52 15 00 00 00 01 00 02 bb 01 15 00 00 00 01 00 02 bc 5c 15 00 00 00 01 00 02 bd 01 15 00 00 00 01 00 02 be 65 15 00 00 00 01 00 02 bf 01 15 00 00 00 01 00 02 c0 6e 15 00 00 00 01 00 02 c1 01 15 00 00 00 01 00 02 c2 8e 15 00 00 00 01 00 02 c3 01 15 00 00 00 01 00 02 c4 aa 15 00 00 00 01 00 02 c5 01 15 00 00 00 01 00 02 c6 d9 15 00 00 00 01 00 02 c7 01 15 00 00 00 01 00 02 c8 fe 15 00 00 00 01 00 02 c9 02 15 00 00 00 01 00 02 ca 3d 15 00 00 00 01 00 02 cb 02 15 00 00 00 01 00 02 cc 72 15 00 00 00 01 00 02 cd 02 15 00 00 00 01 00 02 ce 73 15 00 00 00 01 00 02 cf 02 15 00 00 00 01 00 02 d0 a7 15 00 00 00 01 00 02 d1 02 15 00 00 00 01 00 02 d2 e1 15 00 00 00 01 00 02 d3 03 15 00 00 00 01 00 02 d4 05 15 00 00 00 01 00 02 d5 03 15 00 00 00 01 00 02 d6 33 15 00 00 00 01 00 02 d7 03 15 00 00 00 01 00 02 d8 52 15 00 00 00 01 00 02 d9 03 15 00 00 00 01 00 02 da 7d 15 00 00 00 01 00 02 db 03 15 00 00 00 01 00 02 dc 8a 15 00 00 00 01 00 02 dd 03 15 00 00 00 01 00 02 de 98 15 00 00 00 01 00 02 df 03 15 00 00 00 01 00 02 e0 a7 15 00 00 00 01 00 02 e1 03 15 00 00 00 01 00 02 e2 b8 15 00 00 00 01 00 02 e3 03 15 00 00 00 01 00 02 e4 ca 15 00 00 00 01 00 02 e5 03 15 00 00 00 01 00 02 e6 de 15 00 00 00 01 00 02 e7 03 15 00 00 00 01 00 02 e8 f5 15 00 00 00 01 00 02 e9 03 15 00 00 00 01 00 02 ea ff 15 00 00 00 01 00 02 fb 01 15 01 00 00 01 00 02 ff 10];
        qcom,mdss-dsi-dispparam-default-command-state = "dsi_hs_mode";
        qcom,mdss-dsi-dispparam-cold-command = [15 00 00 00 01 00 02 ff 20 15 00 00 00 01 00 02 75 00 15 00 00 00 01 00 02 76 73 15 00 00 00 01 00 02 77 00 15 00 00 00 01 00 02 78 82 15 00 00 00 01 00 02 79 00 15 00 00 00 01 00 02 7a 9f 15 00 00 00 01 00 02 7b 00 15 00 00 00 01 00 02 7c b5 15 00 00 00 01 00 02 7d 00 15 00 00 00 01 00 02 7e cb 15 00 00 00 01 00 02 7f 00 15 00 00 00 01 00 02 80 dd 15 00 00 00 01 00 02 81 00 15 00 00 00 01 00 02 82 f0 15 00 00 00 01 00 02 83 01 15 00 00 00 01 00 02 84 00 15 00 00 00 01 00 02 85 01 15 00 00 00 01 00 02 86 10 15 00 00 00 01 00 02 87 01 15 00 00 00 01 00 02 88 46 15 00 00 00 01 00 02 89 01 15 00 00 00 01 00 02 8a 70 15 00 00 00 01 00 02 8b 01 15 00 00 00 01 00 02 8c af 15 00 00 00 01 00 02 8d 01 15 00 00 00 01 00 02 8e e3 15 00 00 00 01 00 02 8f 02 15 00 00 00 01 00 02 90 2e 15 00 00 00 01 00 02 91 02 15 00 00 00 01 00 02 92 6b 15 00 00 00 01 00 02 93 02 15 00 00 00 01 00 02 94 6c 15 00 00 00 01 00 02 95 02 15 00 00 00 01 00 02 96 a6 15 00 00 00 01 00 02 97 02 15 00 00 00 01 00 02 98 e6 15 00 00 00 01 00 02 99 03 15 00 00 00 01 00 02 9a 0c 15 00 00 00 01 00 02 9b 03 15 00 00 00 01 00 02 9c 3f 15 00 00 00 01 00 02 9d 03 15 00 00 00 01 00 02 9e 64 15 00 00 00 01 00 02 9f 03 15 00 00 00 01 00 02 a0 91 15 00 00 00 01 00 02 a2 03 15 00 00 00 01 00 02 a3 9e 15 00 00 00 01 00 02 a4 03 15 00 00 00 01 00 02 a5 ab 15 00 00 00 01 00 02 a6 03 15 00 00 00 01 00 02 a7 b9 15 00 00 00 01 00 02 a9 03 15 00 00 00 01 00 02 aa c7 15 00 00 00 01 00 02 ab 03 15 00 00 00 01 00 02 ac d6 15 00 00 00 01 00 02 ad 03 15 00 00 00 01 00 02 ae e6 15 00 00 00 01 00 02 af 03 15 00 00 00 01 00 02 b0 f7 15 00 00 00 01 00 02 b1 03 15 00 00 00 01 00 02 b2 ff 15 00 00 00 01 00 02 b3 00 15 00 00 00 01 00 02 b4 73 15 00 00 00 01 00 02 b5 00 15 00 00 00 01 00 02 b6 82 15 00 00 00 01 00 02 b7 00 15 00 00 00 01 00 02 b8 9f 15 00 00 00 01 00 02 b9 00 15 00 00 00 01 00 02 ba b5 15 00 00 00 01 00 02 bb 00 15 00 00 00 01 00 02 bc cb 15 00 00 00 01 00 02 bd 00 15 00 00 00 01 00 02 be dd 15 00 00 00 01 00 02 bf 00 15 00 00 00 01 00 02 c0 f0 15 00 00 00 01 00 02 c1 01 15 00 00 00 01 00 02 c2 00 15 00 00 00 01 00 02 c3 01 15 00 00 00 01 00 02 c4 10 15 00 00 00 01 00 02 c5 01 15 00 00 00 01 00 02 c6 46 15 00 00 00 01 00 02 c7 01 15 00 00 00 01 00 02 c8 70 15 00 00 00 01 00 02 c9 01 15 00 00 00 01 00 02 ca af 15 00 00 00 01 00 02 cb 01 15 00 00 00 01 00 02 cc e3 15 00 00 00 01 00 02 cd 02 15 00 00 00 01 00 02 ce 2e 15 00 00 00 01 00 02 cf 02 15 00 00 00 01 00 02 d0 6b 15 00 00 00 01 00 02 d1 02 15 00 00 00 01 00 02 d2 6c 15 00 00 00 01 00 02 d3 02 15 00 00 00 01 00 02 d4 a6 15 00 00 00 01 00 02 d5 02 15 00 00 00 01 00 02 d6 e6 15 00 00 00 01 00 02 d7 03 15 00 00 00 01 00 02 d8 0c 15 00 00 00 01 00 02 d9 03 15 00 00 00 01 00 02 da 3f 15 00 00 00 01 00 02 db 03 15 00 00 00 01 00 02 dc 64 15 00 00 00 01 00 02 dd 03 15 00 00 00 01 00 02 de 91 15 00 00 00 01 00 02 df 03 15 00 00 00 01 00 02 e0 9e 15 00 00 00 01 00 02 e1 03 15 00 00 00 01 00 02 e2 ab 15 00 00 00 01 00 02 e3 03 15 00 00 00 01 00 02 e4 b9 15 00 00 00 01 00 02 e5 03 15 00 00 00 01 00 02 e6 c7 15 00 00 00 01 00 02 e7 03 15 00 00 00 01 00 02 e8 d6 15 00 00 00 01 00 02 e9 03 15 00 00 00 01 00 02 ea e6 15 00 00 00 01 00 02 eb 03 15 00 00 00 01 00 02 ec f7 15 00 00 00 01 00 02 ed 03 15 00 00 00 01 00 02 ee ff 15 00 00 00 01 00 02 ef 00 15 00 00 00 01 00 02 f0 00 15 00 00 00 01 00 02 f1 00 15 00 00 00 01 00 02 f2 18 15 00 00 00 01 00 02 f3 00 15 00 00 00 01 00 02 f4 49 15 00 00 00 01 00 02 f5 00 15 00 00 00 01 00 02 f6 6c 15 00 00 00 01 00 02 f7 00 15 00 00 00 01 00 02 f8 8f 15 00 00 00 01 00 02 f9 00 15 00 00 00 01 00 02 fa a9 15 00 00 00 01 00 02 fb 01 15 00 00 00 01 00 02 ff 21 15 00 00 00 01 00 02 00 00 15 00 00 00 01 00 02 01 c2 15 00 00 00 01 00 02 02 00 15 00 00 00 01 00 02 03 d7 15 00 00 00 01 00 02 04 00 15 00 00 00 01 00 02 05 ed 15 00 00 00 01 00 02 06 01 15 00 00 00 01 00 02 07 2d 15 00 00 00 01 00 02 08 01 15 00 00 00 01 00 02 09 60 15 00 00 00 01 00 02 0a 01 15 00 00 00 01 00 02 0b a8 15 00 00 00 01 00 02 0c 01 15 00 00 00 01 00 02 0d dc 15 00 00 00 01 00 02 0e 02 15 00 00 00 01 00 02 0f 2a 15 00 00 00 01 00 02 10 02 15 00 00 00 01 00 02 11 69 15 00 00 00 01 00 02 12 02 15 00 00 00 01 00 02 13 6a 15 00 00 00 01 00 02 14 02 15 00 00 00 01 00 02 15 a5 15 00 00 00 01 00 02 16 02 15 00 00 00 01 00 02 17 e6 15 00 00 00 01 00 02 18 03 15 00 00 00 01 00 02 19 0c 15 00 00 00 01 00 02 1a 03 15 00 00 00 01 00 02 1b 3c 15 00 00 00 01 00 02 1c 03 15 00 00 00 01 00 02 1d 5d 15 00 00 00 01 00 02 1e 03 15 00 00 00 01 00 02 1f 88 15 00 00 00 01 00 02 20 03 15 00 00 00 01 00 02 21 95 15 00 00 00 01 00 02 22 03 15 00 00 00 01 00 02 23 a2 15 00 00 00 01 00 02 24 03 15 00 00 00 01 00 02 25 b1 15 00 00 00 01 00 02 26 03 15 00 00 00 01 00 02 27 c0 15 00 00 00 01 00 02 28 03 15 00 00 00 01 00 02 29 d1 15 00 00 00 01 00 02 2a 03 15 00 00 00 01 00 02 2b e3 15 00 00 00 01 00 02 2d 03 15 00 00 00 01 00 02 2f f6 15 00 00 00 01 00 02 30 03 15 00 00 00 01 00 02 31 ff 15 00 00 00 01 00 02 32 00 15 00 00 00 01 00 02 33 00 15 00 00 00 01 00 02 34 00 15 00 00 00 01 00 02 35 18 15 00 00 00 01 00 02 36 00 15 00 00 00 01 00 02 37 49 15 00 00 00 01 00 02 38 00 15 00 00 00 01 00 02 39 6c 15 00 00 00 01 00 02 3a 00 15 00 00 00 01 00 02 3b 8f 15 00 00 00 01 00 02 3d 00 15 00 00 00 01 00 02 3f a9 15 00 00 00 01 00 02 40 00 15 00 00 00 01 00 02 41 c2 15 00 00 00 01 00 02 42 00 15 00 00 00 01 00 02 43 d7 15 00 00 00 01 00 02 44 00 15 00 00 00 01 00 02 45 ed 15 00 00 00 01 00 02 46 01 15 00 00 00 01 00 02 47 2d 15 00 00 00 01 00 02 48 01 15 00 00 00 01 00 02 49 60 15 00 00 00 01 00 02 4a 01 15 00 00 00 01 00 02 4b a8 15 00 00 00 01 00 02 4c 01 15 00 00 00 01 00 02 4d dc 15 00 00 00 01 00 02 4e 02 15 00 00 00 01 00 02 4f 2a 15 00 00 00 01 00 02 50 02 15 00 00 00 01 00 02 51 69 15 00 00 00 01 00 02 52 02 15 00 00 00 01 00 02 53 6a 15 00 00 00 01 00 02 54 02 15 00 00 00 01 00 02 55 a5 15 00 00 00 01 00 02 56 02 15 00 00 00 01 00 02 58 e6 15 00 00 00 01 00 02 59 03 15 00 00 00 01 00 02 5a 0c 15 00 00 00 01 00 02 5b 03 15 00 00 00 01 00 02 5c 3c 15 00 00 00 01 00 02 5d 03 15 00 00 00 01 00 02 5e 5d 15 00 00 00 01 00 02 5f 03 15 00 00 00 01 00 02 60 88 15 00 00 00 01 00 02 61 03 15 00 00 00 01 00 02 62 95 15 00 00 00 01 00 02 63 03 15 00 00 00 01 00 02 64 a2 15 00 00 00 01 00 02 65 03 15 00 00 00 01 00 02 66 b1 15 00 00 00 01 00 02 67 03 15 00 00 00 01 00 02 68 c0 15 00 00 00 01 00 02 69 03 15 00 00 00 01 00 02 6a d1 15 00 00 00 01 00 02 6b 03 15 00 00 00 01 00 02 6c e3 15 00 00 00 01 00 02 6d 03 15 00 00 00 01 00 02 6e f6 15 00 00 00 01 00 02 6f 03 15 00 00 00 01 00 02 70 ff 15 00 00 00 01 00 02 71 00 15 00 00 00 01 00 02 72 cf 15 00 00 00 01 00 02 73 00 15 00 00 00 01 00 02 74 d9 15 00 00 00 01 00 02 75 00 15 00 00 00 01 00 02 76 ee 15 00 00 00 01 00 02 77 00 15 00 00 00 01 00 02 78 ff 15 00 00 00 01 00 02 79 01 15 00 00 00 01 00 02 7a 10 15 00 00 00 01 00 02 7b 01 15 00 00 00 01 00 02 7c 1f 15 00 00 00 01 00 02 7d 01 15 00 00 00 01 00 02 7e 2e 15 00 00 00 01 00 02 7f 01 15 00 00 00 01 00 02 80 3a 15 00 00 00 01 00 02 81 01 15 00 00 00 01 00 02 82 48 15 00 00 00 01 00 02 83 01 15 00 00 00 01 00 02 84 72 15 00 00 00 01 00 02 85 01 15 00 00 00 01 00 02 86 95 15 00 00 00 01 00 02 87 01 15 00 00 00 01 00 02 88 cd 15 00 00 00 01 00 02 89 01 15 00 00 00 01 00 02 8a f9 15 00 00 00 01 00 02 8b 02 15 00 00 00 01 00 02 8c 3d 15 00 00 00 01 00 02 8d 02 15 00 00 00 01 00 02 8e 75 15 00 00 00 01 00 02 8f 02 15 00 00 00 01 00 02 90 77 15 00 00 00 01 00 02 91 02 15 00 00 00 01 00 02 92 ae 15 00 00 00 01 00 02 93 02 15 00 00 00 01 00 02 94 ec 15 00 00 00 01 00 02 95 03 15 00 00 00 01 00 02 96 13 15 00 00 00 01 00 02 97 03 15 00 00 00 01 00 02 98 43 15 00 00 00 01 00 02 99 03 15 00 00 00 01 00 02 9a 63 15 00 00 00 01 00 02 9b 03 15 00 00 00 01 00 02 9c 8c 15 00 00 00 01 00 02 9d 03 15 00 00 00 01 00 02 9e 98 15 00 00 00 01 00 02 9f 03 15 00 00 00 01 00 02 a0 a5 15 00 00 00 01 00 02 a2 03 15 00 00 00 01 00 02 a3 b3 15 00 00 00 01 00 02 a4 03 15 00 00 00 01 00 02 a5 c2 15 00 00 00 01 00 02 a6 03 15 00 00 00 01 00 02 a7 d2 15 00 00 00 01 00 02 a9 03 15 00 00 00 01 00 02 aa e3 15 00 00 00 01 00 02 ab 03 15 00 00 00 01 00 02 ac f6 15 00 00 00 01 00 02 ad 03 15 00 00 00 01 00 02 ae ff 15 00 00 00 01 00 02 af 00 15 00 00 00 01 00 02 b0 cf 15 00 00 00 01 00 02 b1 00 15 00 00 00 01 00 02 b2 d9 15 00 00 00 01 00 02 b3 00 15 00 00 00 01 00 02 b4 ee 15 00 00 00 01 00 02 b5 00 15 00 00 00 01 00 02 b6 ff 15 00 00 00 01 00 02 b7 01 15 00 00 00 01 00 02 b8 10 15 00 00 00 01 00 02 b9 01 15 00 00 00 01 00 02 ba 1f 15 00 00 00 01 00 02 bb 01 15 00 00 00 01 00 02 bc 2e 15 00 00 00 01 00 02 bd 01 15 00 00 00 01 00 02 be 3a 15 00 00 00 01 00 02 bf 01 15 00 00 00 01 00 02 c0 48 15 00 00 00 01 00 02 c1 01 15 00 00 00 01 00 02 c2 72 15 00 00 00 01 00 02 c3 01 15 00 00 00 01 00 02 c4 95 15 00 00 00 01 00 02 c5 01 15 00 00 00 01 00 02 c6 cd 15 00 00 00 01 00 02 c7 01 15 00 00 00 01 00 02 c8 f9 15 00 00 00 01 00 02 c9 02 15 00 00 00 01 00 02 ca 3d 15 00 00 00 01 00 02 cb 02 15 00 00 00 01 00 02 cc 75 15 00 00 00 01 00 02 cd 02 15 00 00 00 01 00 02 ce 77 15 00 00 00 01 00 02 cf 02 15 00 00 00 01 00 02 d0 ae 15 00 00 00 01 00 02 d1 02 15 00 00 00 01 00 02 d2 ec 15 00 00 00 01 00 02 d3 03 15 00 00 00 01 00 02 d4 13 15 00 00 00 01 00 02 d5 03 15 00 00 00 01 00 02 d6 43 15 00 00 00 01 00 02 d7 03 15 00 00 00 01 00 02 d8 63 15 00 00 00 01 00 02 d9 03 15 00 00 00 01 00 02 da 8c 15 00 00 00 01 00 02 db 03 15 00 00 00 01 00 02 dc 98 15 00 00 00 01 00 02 dd 03 15 00 00 00 01 00 02 de a5 15 00 00 00 01 00 02 df 03 15 00 00 00 01 00 02 e0 b3 15 00 00 00 01 00 02 e1 03 15 00 00 00 01 00 02 e2 c2 15 00 00 00 01 00 02 e3 03 15 00 00 00 01 00 02 e4 d2 15 00 00 00 01 00 02 e5 03 15 00 00 00 01 00 02 e6 e3 15 00 00 00 01 00 02 e7 03 15 00 00 00 01 00 02 e8 f6 15 00 00 00 01 00 02 e9 03 15 00 00 00 01 00 02 ea ff 15 00 00 00 01 00 02 fb 01 15 01 00 00 01 00 02 ff 10];
        qcom,mdss-dsi-dispparam-cold-command-state = "dsi_hs_mode";
        qcom,mdss-dsi-dispparam-papermode-command = [15 01 00 00 01 00 02 ff 20 15 00 00 00 01 00 02 fb 01 15 00 00 00 01 00 02 75 00 15 00 00 00 01 00 02 76 c8 15 00 00 00 01 00 02 77 00 15 00 00 00 01 00 02 78 d2 15 00 00 00 01 00 02 79 00 15 00 00 00 01 00 02 7a e5 15 00 00 00 01 00 02 7b 00 15 00 00 00 01 00 02 7c f6 15 00 00 00 01 00 02 7d 01 15 00 00 00 01 00 02 7e 06 15 00 00 00 01 00 02 7f 01 15 00 00 00 01 00 02 80 15 15 00 00 00 01 00 02 81 01 15 00 00 00 01 00 02 82 22 15 00 00 00 01 00 02 83 01 15 00 00 00 01 00 02 84 2f 15 00 00 00 01 00 02 85 01 15 00 00 00 01 00 02 86 3c 15 00 00 00 01 00 02 87 01 15 00 00 00 01 00 02 88 66 15 00 00 00 01 00 02 89 01 15 00 00 00 01 00 02 8a 89 15 00 00 00 01 00 02 8b 01 15 00 00 00 01 00 02 8c c2 15 00 00 00 01 00 02 8d 01 15 00 00 00 01 00 02 8e ee 15 00 00 00 01 00 02 8f 02 15 00 00 00 01 00 02 90 34 15 00 00 00 01 00 02 91 02 15 00 00 00 01 00 02 92 6d 15 00 00 00 01 00 02 93 02 15 00 00 00 01 00 02 94 6f 15 00 00 00 01 00 02 95 02 15 00 00 00 01 00 02 96 a6 15 00 00 00 01 00 02 97 02 15 00 00 00 01 00 02 98 e1 15 00 00 00 01 00 02 99 03 15 00 00 00 01 00 02 9a 04 15 00 00 00 01 00 02 9b 03 15 00 00 00 01 00 02 9c 33 15 00 00 00 01 00 02 9d 03 15 00 00 00 01 00 02 9e 4f 15 00 00 00 01 00 02 9f 03 15 00 00 00 01 00 02 a0 72 15 00 00 00 01 00 02 a2 03 15 00 00 00 01 00 02 a3 7c 15 00 00 00 01 00 02 a4 03 15 00 00 00 01 00 02 a5 88 15 00 00 00 01 00 02 a6 03 15 00 00 00 01 00 02 a7 95 15 00 00 00 01 00 02 a9 03 15 00 00 00 01 00 02 aa a3 15 00 00 00 01 00 02 ab 03 15 00 00 00 01 00 02 ac b4 15 00 00 00 01 00 02 ad 03 15 00 00 00 01 00 02 ae c3 15 00 00 00 01 00 02 af 03 15 00 00 00 01 00 02 b0 cd 15 00 00 00 01 00 02 b1 03 15 00 00 00 01 00 02 b2 ff 15 00 00 00 01 00 02 b3 00 15 00 00 00 01 00 02 b4 c8 15 00 00 00 01 00 02 b5 00 15 00 00 00 01 00 02 b6 d2 15 00 00 00 01 00 02 b7 00 15 00 00 00 01 00 02 b8 e5 15 00 00 00 01 00 02 b9 00 15 00 00 00 01 00 02 ba f6 15 00 00 00 01 00 02 bb 01 15 00 00 00 01 00 02 bc 06 15 00 00 00 01 00 02 bd 01 15 00 00 00 01 00 02 be 15 15 00 00 00 01 00 02 bf 01 15 00 00 00 01 00 02 c0 22 15 00 00 00 01 00 02 c1 01 15 00 00 00 01 00 02 c2 2f 15 00 00 00 01 00 02 c3 01 15 00 00 00 01 00 02 c4 3c 15 00 00 00 01 00 02 c5 01 15 00 00 00 01 00 02 c6 66 15 00 00 00 01 00 02 c7 01 15 00 00 00 01 00 02 c8 89 15 00 00 00 01 00 02 c9 01 15 00 00 00 01 00 02 ca c2 15 00 00 00 01 00 02 cb 01 15 00 00 00 01 00 02 cc ee 15 00 00 00 01 00 02 cd 02 15 00 00 00 01 00 02 ce 34 15 00 00 00 01 00 02 cf 02 15 00 00 00 01 00 02 d0 6d 15 00 00 00 01 00 02 d1 02 15 00 00 00 01 00 02 d2 6f 15 00 00 00 01 00 02 d3 02 15 00 00 00 01 00 02 d4 a6 15 00 00 00 01 00 02 d5 02 15 00 00 00 01 00 02 d6 e1 15 00 00 00 01 00 02 d7 03 15 00 00 00 01 00 02 d8 04 15 00 00 00 01 00 02 d9 03 15 00 00 00 01 00 02 da 33 15 00 00 00 01 00 02 db 03 15 00 00 00 01 00 02 dc 4f 15 00 00 00 01 00 02 dd 03 15 00 00 00 01 00 02 de 72 15 00 00 00 01 00 02 df 03 15 00 00 00 01 00 02 e0 7c 15 00 00 00 01 00 02 e1 03 15 00 00 00 01 00 02 e2 88 15 00 00 00 01 00 02 e3 03 15 00 00 00 01 00 02 e4 95 15 00 00 00 01 00 02 e5 03 15 00 00 00 01 00 02 e6 a3 15 00 00 00 01 00 02 e7 03 15 00 00 00 01 00 02 e8 b4 15 00 00 00 01 00 02 e9 03 15 00 00 00 01 00 02 ea c3 15 00 00 00 01 00 02 eb 03 15 00 00 00 01 00 02 ec cd 15 00 00 00 01 00 02 ed 03 15 00 00 00 01 00 02 ee ff 15 00 00 00 01 00 02 ef 00 15 00 00 00 01 00 02 f0 c8 15 00 00 00 01 00 02 f1 00 15 00 00 00 01 00 02 f2 d3 15 00 00 00 01 00 02 f3 00 15 00 00 00 01 00 02 f4 e6 15 00 00 00 01 00 02 f5 00 15 00 00 00 01 00 02 f6 f8 15 00 00 00 01 00 02 f7 01 15 00 00 00 01 00 02 f8 09 15 00 00 00 01 00 02 f9 01 15 00 00 00 01 00 02 fa 18 15 00 00 00 01 00 02 ff 21 15 00 00 00 01 00 02 fb 01 15 00 00 00 01 00 02 00 01 15 00 00 00 01 00 02 01 26 15 00 00 00 01 00 02 02 01 15 00 00 00 01 00 02 03 33 15 00 00 00 01 00 02 04 01 15 00 00 00 01 00 02 05 3f 15 00 00 00 01 00 02 06 01 15 00 00 00 01 00 02 07 6b 15 00 00 00 01 00 02 08 01 15 00 00 00 01 00 02 09 8e 15 00 00 00 01 00 02 0a 01 15 00 00 00 01 00 02 0b c7 15 00 00 00 01 00 02 0c 01 15 00 00 00 01 00 02 0d f2 15 00 00 00 01 00 02 0e 02 15 00 00 00 01 00 02 0f 37 15 00 00 00 01 00 02 10 02 15 00 00 00 01 00 02 11 70 15 00 00 00 01 00 02 12 02 15 00 00 00 01 00 02 13 72 15 00 00 00 01 00 02 14 02 15 00 00 00 01 00 02 15 a8 15 00 00 00 01 00 02 16 02 15 00 00 00 01 00 02 17 e3 15 00 00 00 01 00 02 18 03 15 00 00 00 01 00 02 19 05 15 00 00 00 01 00 02 1a 03 15 00 00 00 01 00 02 1b 34 15 00 00 00 01 00 02 1c 03 15 00 00 00 01 00 02 1d 50 15 00 00 00 01 00 02 1e 03 15 00 00 00 01 00 02 1f 73 15 00 00 00 01 00 02 20 03 15 00 00 00 01 00 02 21 7d 15 00 00 00 01 00 02 22 03 15 00 00 00 01 00 02 23 89 15 00 00 00 01 00 02 24 03 15 00 00 00 01 00 02 25 96 15 00 00 00 01 00 02 26 03 15 00 00 00 01 00 02 27 a5 15 00 00 00 01 00 02 28 03 15 00 00 00 01 00 02 29 b5 15 00 00 00 01 00 02 2a 03 15 00 00 00 01 00 02 2b c3 15 00 00 00 01 00 02 2d 03 15 00 00 00 01 00 02 2f cc 15 00 00 00 01 00 02 30 03 15 00 00 00 01 00 02 31 ff 15 00 00 00 01 00 02 32 00 15 00 00 00 01 00 02 33 c8 15 00 00 00 01 00 02 34 00 15 00 00 00 01 00 02 35 d3 15 00 00 00 01 00 02 36 00 15 00 00 00 01 00 02 37 e6 15 00 00 00 01 00 02 38 00 15 00 00 00 01 00 02 39 f8 15 00 00 00 01 00 02 3a 01 15 00 00 00 01 00 02 3b 09 15 00 00 00 01 00 02 3d 01 15 00 00 00 01 00 02 3f 18 15 00 00 00 01 00 02 40 01 15 00 00 00 01 00 02 41 26 15 00 00 00 01 00 02 42 01 15 00 00 00 01 00 02 43 33 15 00 00 00 01 00 02 44 01 15 00 00 00 01 00 02 45 3f 15 00 00 00 01 00 02 46 01 15 00 00 00 01 00 02 47 6b 15 00 00 00 01 00 02 48 01 15 00 00 00 01 00 02 49 8e 15 00 00 00 01 00 02 4a 01 15 00 00 00 01 00 02 4b c7 15 00 00 00 01 00 02 4c 01 15 00 00 00 01 00 02 4d f2 15 00 00 00 01 00 02 4e 02 15 00 00 00 01 00 02 4f 37 15 00 00 00 01 00 02 50 02 15 00 00 00 01 00 02 51 70 15 00 00 00 01 00 02 52 02 15 00 00 00 01 00 02 53 72 15 00 00 00 01 00 02 54 02 15 00 00 00 01 00 02 55 a8 15 00 00 00 01 00 02 56 02 15 00 00 00 01 00 02 58 e3 15 00 00 00 01 00 02 59 03 15 00 00 00 01 00 02 5a 05 15 00 00 00 01 00 02 5b 03 15 00 00 00 01 00 02 5c 34 15 00 00 00 01 00 02 5d 03 15 00 00 00 01 00 02 5e 50 15 00 00 00 01 00 02 5f 03 15 00 00 00 01 00 02 60 73 15 00 00 00 01 00 02 61 03 15 00 00 00 01 00 02 62 7d 15 00 00 00 01 00 02 63 03 15 00 00 00 01 00 02 64 89 15 00 00 00 01 00 02 65 03 15 00 00 00 01 00 02 66 96 15 00 00 00 01 00 02 67 03 15 00 00 00 01 00 02 68 a5 15 00 00 00 01 00 02 69 03 15 00 00 00 01 00 02 6a b5 15 00 00 00 01 00 02 6b 03 15 00 00 00 01 00 02 6c c3 15 00 00 00 01 00 02 6d 03 15 00 00 00 01 00 02 6e cc 15 00 00 00 01 00 02 6f 03 15 00 00 00 01 00 02 70 ff 15 00 00 00 01 00 02 71 02 15 00 00 00 01 00 02 72 58 15 00 00 00 01 00 02 73 02 15 00 00 00 01 00 02 74 59 15 00 00 00 01 00 02 75 02 15 00 00 00 01 00 02 76 5b 15 00 00 00 01 00 02 77 02 15 00 00 00 01 00 02 78 5d 15 00 00 00 01 00 02 79 02 15 00 00 00 01 00 02 7a 5f 15 00 00 00 01 00 02 7b 02 15 00 00 00 01 00 02 7c 61 15 00 00 00 01 00 02 7d 02 15 00 00 00 01 00 02 7e 63 15 00 00 00 01 00 02 7f 02 15 00 00 00 01 00 02 80 64 15 00 00 00 01 00 02 81 02 15 00 00 00 01 00 02 82 66 15 00 00 00 01 00 02 83 02 15 00 00 00 01 00 02 84 6e 15 00 00 00 01 00 02 85 02 15 00 00 00 01 00 02 86 76 15 00 00 00 01 00 02 87 02 15 00 00 00 01 00 02 88 85 15 00 00 00 01 00 02 89 02 15 00 00 00 01 00 02 8a 94 15 00 00 00 01 00 02 8b 02 15 00 00 00 01 00 02 8c b2 15 00 00 00 01 00 02 8d 02 15 00 00 00 01 00 02 8e d3 15 00 00 00 01 00 02 8f 02 15 00 00 00 01 00 02 90 d4 15 00 00 00 01 00 02 91 02 15 00 00 00 01 00 02 92 f8 15 00 00 00 01 00 02 93 03 15 00 00 00 01 00 02 94 27 15 00 00 00 01 00 02 95 03 15 00 00 00 01 00 02 96 44 15 00 00 00 01 00 02 97 03 15 00 00 00 01 00 02 98 67 15 00 00 00 01 00 02 99 03 15 00 00 00 01 00 02 9a 7d 15 00 00 00 01 00 02 9b 03 15 00 00 00 01 00 02 9c 97 15 00 00 00 01 00 02 9d 03 15 00 00 00 01 00 02 9e 9e 15 00 00 00 01 00 02 9f 03 15 00 00 00 01 00 02 a0 a6 15 00 00 00 01 00 02 a2 03 15 00 00 00 01 00 02 a3 ad 15 00 00 00 01 00 02 a4 03 15 00 00 00 01 00 02 a5 b3 15 00 00 00 01 00 02 a6 03 15 00 00 00 01 00 02 a7 b8 15 00 00 00 01 00 02 a9 03 15 00 00 00 01 00 02 aa bc 15 00 00 00 01 00 02 ab 03 15 00 00 00 01 00 02 ac be 15 00 00 00 01 00 02 ad 03 15 00 00 00 01 00 02 ae ff 15 00 00 00 01 00 02 af 02 15 00 00 00 01 00 02 b0 58 15 00 00 00 01 00 02 b1 02 15 00 00 00 01 00 02 b2 59 15 00 00 00 01 00 02 b3 02 15 00 00 00 01 00 02 b4 5b 15 00 00 00 01 00 02 b5 02 15 00 00 00 01 00 02 b6 5d 15 00 00 00 01 00 02 b7 02 15 00 00 00 01 00 02 b8 5f 15 00 00 00 01 00 02 b9 02 15 00 00 00 01 00 02 ba 61 15 00 00 00 01 00 02 bb 02 15 00 00 00 01 00 02 bc 63 15 00 00 00 01 00 02 bd 02 15 00 00 00 01 00 02 be 64 15 00 00 00 01 00 02 bf 02 15 00 00 00 01 00 02 c0 66 15 00 00 00 01 00 02 c1 02 15 00 00 00 01 00 02 c2 6e 15 00 00 00 01 00 02 c3 02 15 00 00 00 01 00 02 c4 76 15 00 00 00 01 00 02 c5 02 15 00 00 00 01 00 02 c6 85 15 00 00 00 01 00 02 c7 02 15 00 00 00 01 00 02 c8 94 15 00 00 00 01 00 02 c9 02 15 00 00 00 01 00 02 ca b2 15 00 00 00 01 00 02 cb 02 15 00 00 00 01 00 02 cc d3 15 00 00 00 01 00 02 cd 02 15 00 00 00 01 00 02 ce d4 15 00 00 00 01 00 02 cf 02 15 00 00 00 01 00 02 d0 f8 15 00 00 00 01 00 02 d1 03 15 00 00 00 01 00 02 d2 27 15 00 00 00 01 00 02 d3 03 15 00 00 00 01 00 02 d4 44 15 00 00 00 01 00 02 d5 03 15 00 00 00 01 00 02 d6 67 15 00 00 00 01 00 02 d7 03 15 00 00 00 01 00 02 d8 7d 15 00 00 00 01 00 02 d9 03 15 00 00 00 01 00 02 da 97 15 00 00 00 01 00 02 db 03 15 00 00 00 01 00 02 dc 9e 15 00 00 00 01 00 02 dd 03 15 00 00 00 01 00 02 de a6 15 00 00 00 01 00 02 df 03 15 00 00 00 01 00 02 e0 ad 15 00 00 00 01 00 02 e1 03 15 00 00 00 01 00 02 e2 b3 15 00 00 00 01 00 02 e3 03 15 00 00 00 01 00 02 e4 b8 15 00 00 00 01 00 02 e5 03 15 00 00 00 01 00 02 e6 bc 15 00 00 00 01 00 02 e7 03 15 00 00 00 01 00 02 e8 be 15 00 00 00 01 00 02 e9 03 15 00 00 00 01 00 02 ea ff 15 00 00 00 01 00 02 fb 01 15 01 00 00 01 00 02 ff 10];
        qcom,mdss-dsi-dispparam-papermode-state = "dsi_hs_mode";
        qcom,mdss-dsi-dispparam-papermode1-command = [15 01 00 00 78 00 02 ff 20 15 00 00 00 01 00 02 fb 01 15 00 00 00 01 00 02 75 00 15 00 00 00 01 00 02 76 c8 15 00 00 00 01 00 02 77 00 15 00 00 00 01 00 02 78 d2 15 00 00 00 01 00 02 79 00 15 00 00 00 01 00 02 7a e5 15 00 00 00 01 00 02 7b 00 15 00 00 00 01 00 02 7c f6 15 00 00 00 01 00 02 7d 01 15 00 00 00 01 00 02 7e 06 15 00 00 00 01 00 02 7f 01 15 00 00 00 01 00 02 80 15 15 00 00 00 01 00 02 81 01 15 00 00 00 01 00 02 82 22 15 00 00 00 01 00 02 83 01 15 00 00 00 01 00 02 84 2f 15 00 00 00 01 00 02 85 01 15 00 00 00 01 00 02 86 3c 15 00 00 00 01 00 02 87 01 15 00 00 00 01 00 02 88 66 15 00 00 00 01 00 02 89 01 15 00 00 00 01 00 02 8a 89 15 00 00 00 01 00 02 8b 01 15 00 00 00 01 00 02 8c c2 15 00 00 00 01 00 02 8d 01 15 00 00 00 01 00 02 8e ee 15 00 00 00 01 00 02 8f 02 15 00 00 00 01 00 02 90 34 15 00 00 00 01 00 02 91 02 15 00 00 00 01 00 02 92 6d 15 00 00 00 01 00 02 93 02 15 00 00 00 01 00 02 94 6f 15 00 00 00 01 00 02 95 02 15 00 00 00 01 00 02 96 a6 15 00 00 00 01 00 02 97 02 15 00 00 00 01 00 02 98 e1 15 00 00 00 01 00 02 99 03 15 00 00 00 01 00 02 9a 04 15 00 00 00 01 00 02 9b 03 15 00 00 00 01 00 02 9c 33 15 00 00 00 01 00 02 9d 03 15 00 00 00 01 00 02 9e 4f 15 00 00 00 01 00 02 9f 03 15 00 00 00 01 00 02 a0 72 15 00 00 00 01 00 02 a2 03 15 00 00 00 01 00 02 a3 7c 15 00 00 00 01 00 02 a4 03 15 00 00 00 01 00 02 a5 88 15 00 00 00 01 00 02 a6 03 15 00 00 00 01 00 02 a7 95 15 00 00 00 01 00 02 a9 03 15 00 00 00 01 00 02 aa a3 15 00 00 00 01 00 02 ab 03 15 00 00 00 01 00 02 ac b4 15 00 00 00 01 00 02 ad 03 15 00 00 00 01 00 02 ae c3 15 00 00 00 01 00 02 af 03 15 00 00 00 01 00 02 b0 cd 15 00 00 00 01 00 02 b1 03 15 00 00 00 01 00 02 b2 ff 15 00 00 00 01 00 02 b3 00 15 00 00 00 01 00 02 b4 c8 15 00 00 00 01 00 02 b5 00 15 00 00 00 01 00 02 b6 d2 15 00 00 00 01 00 02 b7 00 15 00 00 00 01 00 02 b8 e5 15 00 00 00 01 00 02 b9 00 15 00 00 00 01 00 02 ba f6 15 00 00 00 01 00 02 bb 01 15 00 00 00 01 00 02 bc 06 15 00 00 00 01 00 02 bd 01 15 00 00 00 01 00 02 be 15 15 00 00 00 01 00 02 bf 01 15 00 00 00 01 00 02 c0 22 15 00 00 00 01 00 02 c1 01 15 00 00 00 01 00 02 c2 2f 15 00 00 00 01 00 02 c3 01 15 00 00 00 01 00 02 c4 3c 15 00 00 00 01 00 02 c5 01 15 00 00 00 01 00 02 c6 66 15 00 00 00 01 00 02 c7 01 15 00 00 00 01 00 02 c8 89 15 00 00 00 01 00 02 c9 01 15 00 00 00 01 00 02 ca c2 15 00 00 00 01 00 02 cb 01 15 00 00 00 01 00 02 cc ee 15 00 00 00 01 00 02 cd 02 15 00 00 00 01 00 02 ce 34 15 00 00 00 01 00 02 cf 02 15 00 00 00 01 00 02 d0 6d 15 00 00 00 01 00 02 d1 02 15 00 00 00 01 00 02 d2 6f 15 00 00 00 01 00 02 d3 02 15 00 00 00 01 00 02 d4 a6 15 00 00 00 01 00 02 d5 02 15 00 00 00 01 00 02 d6 e1 15 00 00 00 01 00 02 d7 03 15 00 00 00 01 00 02 d8 04 15 00 00 00 01 00 02 d9 03 15 00 00 00 01 00 02 da 33 15 00 00 00 01 00 02 db 03 15 00 00 00 01 00 02 dc 4f 15 00 00 00 01 00 02 dd 03 15 00 00 00 01 00 02 de 72 15 00 00 00 01 00 02 df 03 15 00 00 00 01 00 02 e0 7c 15 00 00 00 01 00 02 e1 03 15 00 00 00 01 00 02 e2 88 15 00 00 00 01 00 02 e3 03 15 00 00 00 01 00 02 e4 95 15 00 00 00 01 00 02 e5 03 15 00 00 00 01 00 02 e6 a3 15 00 00 00 01 00 02 e7 03 15 00 00 00 01 00 02 e8 b4 15 00 00 00 01 00 02 e9 03 15 00 00 00 01 00 02 ea c3 15 00 00 00 01 00 02 eb 03 15 00 00 00 01 00 02 ec cd 15 00 00 00 01 00 02 ed 03 15 00 00 00 01 00 02 ee ff 15 00 00 00 01 00 02 ef 00 15 00 00 00 01 00 02 f0 c8 15 00 00 00 01 00 02 f1 00 15 00 00 00 01 00 02 f2 d3 15 00 00 00 01 00 02 f3 00 15 00 00 00 01 00 02 f4 e6 15 00 00 00 01 00 02 f5 00 15 00 00 00 01 00 02 f6 f8 15 00 00 00 01 00 02 f7 01 15 00 00 00 01 00 02 f8 09 15 00 00 00 01 00 02 f9 01 15 00 00 00 01 00 02 fa 18 15 00 00 00 01 00 02 ff 21 15 00 00 00 01 00 02 fb 01 15 00 00 00 01 00 02 00 01 15 00 00 00 01 00 02 01 26 15 00 00 00 01 00 02 02 01 15 00 00 00 01 00 02 03 33 15 00 00 00 01 00 02 04 01 15 00 00 00 01 00 02 05 3f 15 00 00 00 01 00 02 06 01 15 00 00 00 01 00 02 07 6b 15 00 00 00 01 00 02 08 01 15 00 00 00 01 00 02 09 8e 15 00 00 00 01 00 02 0a 01 15 00 00 00 01 00 02 0b c7 15 00 00 00 01 00 02 0c 01 15 00 00 00 01 00 02 0d f2 15 00 00 00 01 00 02 0e 02 15 00 00 00 01 00 02 0f 37 15 00 00 00 01 00 02 10 02 15 00 00 00 01 00 02 11 70 15 00 00 00 01 00 02 12 02 15 00 00 00 01 00 02 13 72 15 00 00 00 01 00 02 14 02 15 00 00 00 01 00 02 15 a8 15 00 00 00 01 00 02 16 02 15 00 00 00 01 00 02 17 e3 15 00 00 00 01 00 02 18 03 15 00 00 00 01 00 02 19 05 15 00 00 00 01 00 02 1a 03 15 00 00 00 01 00 02 1b 34 15 00 00 00 01 00 02 1c 03 15 00 00 00 01 00 02 1d 50 15 00 00 00 01 00 02 1e 03 15 00 00 00 01 00 02 1f 73 15 00 00 00 01 00 02 20 03 15 00 00 00 01 00 02 21 7d 15 00 00 00 01 00 02 22 03 15 00 00 00 01 00 02 23 89 15 00 00 00 01 00 02 24 03 15 00 00 00 01 00 02 25 96 15 00 00 00 01 00 02 26 03 15 00 00 00 01 00 02 27 a5 15 00 00 00 01 00 02 28 03 15 00 00 00 01 00 02 29 b5 15 00 00 00 01 00 02 2a 03 15 00 00 00 01 00 02 2b c3 15 00 00 00 01 00 02 2d 03 15 00 00 00 01 00 02 2f cc 15 00 00 00 01 00 02 30 03 15 00 00 00 01 00 02 31 ff 15 00 00 00 01 00 02 32 00 15 00 00 00 01 00 02 33 c8 15 00 00 00 01 00 02 34 00 15 00 00 00 01 00 02 35 d3 15 00 00 00 01 00 02 36 00 15 00 00 00 01 00 02 37 e6 15 00 00 00 01 00 02 38 00 15 00 00 00 01 00 02 39 f8 15 00 00 00 01 00 02 3a 01 15 00 00 00 01 00 02 3b 09 15 00 00 00 01 00 02 3d 01 15 00 00 00 01 00 02 3f 18 15 00 00 00 01 00 02 40 01 15 00 00 00 01 00 02 41 26 15 00 00 00 01 00 02 42 01 15 00 00 00 01 00 02 43 33 15 00 00 00 01 00 02 44 01 15 00 00 00 01 00 02 45 3f 15 00 00 00 01 00 02 46 01 15 00 00 00 01 00 02 47 6b 15 00 00 00 01 00 02 48 01 15 00 00 00 01 00 02 49 8e 15 00 00 00 01 00 02 4a 01 15 00 00 00 01 00 02 4b c7 15 00 00 00 01 00 02 4c 01 15 00 00 00 01 00 02 4d f2 15 00 00 00 01 00 02 4e 02 15 00 00 00 01 00 02 4f 37 15 00 00 00 01 00 02 50 02 15 00 00 00 01 00 02 51 70 15 00 00 00 01 00 02 52 02 15 00 00 00 01 00 02 53 72 15 00 00 00 01 00 02 54 02 15 00 00 00 01 00 02 55 a8 15 00 00 00 01 00 02 56 02 15 00 00 00 01 00 02 58 e3 15 00 00 00 01 00 02 59 03 15 00 00 00 01 00 02 5a 05 15 00 00 00 01 00 02 5b 03 15 00 00 00 01 00 02 5c 34 15 00 00 00 01 00 02 5d 03 15 00 00 00 01 00 02 5e 50 15 00 00 00 01 00 02 5f 03 15 00 00 00 01 00 02 60 73 15 00 00 00 01 00 02 61 03 15 00 00 00 01 00 02 62 7d 15 00 00 00 01 00 02 63 03 15 00 00 00 01 00 02 64 89 15 00 00 00 01 00 02 65 03 15 00 00 00 01 00 02 66 96 15 00 00 00 01 00 02 67 03 15 00 00 00 01 00 02 68 a5 15 00 00 00 01 00 02 69 03 15 00 00 00 01 00 02 6a b5 15 00 00 00 01 00 02 6b 03 15 00 00 00 01 00 02 6c c3 15 00 00 00 01 00 02 6d 03 15 00 00 00 01 00 02 6e cc 15 00 00 00 01 00 02 6f 03 15 00 00 00 01 00 02 70 ff 15 00 00 00 01 00 02 71 01 15 00 00 00 01 00 02 72 90 15 00 00 00 01 00 02 73 01 15 00 00 00 01 00 02 74 93 15 00 00 00 01 00 02 75 01 15 00 00 00 01 00 02 76 9a 15 00 00 00 01 00 02 77 01 15 00 00 00 01 00 02 78 a1 15 00 00 00 01 00 02 79 01 15 00 00 00 01 00 02 7a a7 15 00 00 00 01 00 02 7b 01 15 00 00 00 01 00 02 7c ad 15 00 00 00 01 00 02 7d 01 15 00 00 00 01 00 02 7e b3 15 00 00 00 01 00 02 7f 01 15 00 00 00 01 00 02 80 b9 15 00 00 00 01 00 02 81 01 15 00 00 00 01 00 02 82 bf 15 00 00 00 01 00 02 83 01 15 00 00 00 01 00 02 84 d4 15 00 00 00 01 00 02 85 01 15 00 00 00 01 00 02 86 e7 15 00 00 00 01 00 02 87 02 15 00 00 00 01 00 02 88 0a 15 00 00 00 01 00 02 89 02 15 00 00 00 01 00 02 8a 27 15 00 00 00 01 00 02 8b 02 15 00 00 00 01 00 02 8c 5a 15 00 00 00 01 00 02 8d 02 15 00 00 00 01 00 02 8e 8b 15 00 00 00 01 00 02 8f 02 15 00 00 00 01 00 02 90 8c 15 00 00 00 01 00 02 91 02 15 00 00 00 01 00 02 92 bd 15 00 00 00 01 00 02 93 02 15 00 00 00 01 00 02 94 f3 15 00 00 00 01 00 02 95 03 15 00 00 00 01 00 02 96 14 15 00 00 00 01 00 02 97 03 15 00 00 00 01 00 02 98 41 15 00 00 00 01 00 02 99 03 15 00 00 00 01 00 02 9a 5b 15 00 00 00 01 00 02 9b 03 15 00 00 00 01 00 02 9c 7c 15 00 00 00 01 00 02 9d 03 15 00 00 00 01 00 02 9e 86 15 00 00 00 01 00 02 9f 03 15 00 00 00 01 00 02 a0 91 15 00 00 00 01 00 02 a2 03 15 00 00 00 01 00 02 a3 9e 15 00 00 00 01 00 02 a4 03 15 00 00 00 01 00 02 a5 ab 15 00 00 00 01 00 02 a6 03 15 00 00 00 01 00 02 a7 b9 15 00 00 00 01 00 02 a9 03 15 00 00 00 01 00 02 aa c5 15 00 00 00 01 00 02 ab 03 15 00 00 00 01 00 02 ac cc 15 00 00 00 01 00 02 ad 03 15 00 00 00 01 00 02 ae ff 15 00 00 00 01 00 02 af 01 15 00 00 00 01 00 02 b0 90 15 00 00 00 01 00 02 b1 01 15 00 00 00 01 00 02 b2 93 15 00 00 00 01 00 02 b3 01 15 00 00 00 01 00 02 b4 9a 15 00 00 00 01 00 02 b5 01 15 00 00 00 01 00 02 b6 a1 15 00 00 00 01 00 02 b7 01 15 00 00 00 01 00 02 b8 a7 15 00 00 00 01 00 02 b9 01 15 00 00 00 01 00 02 ba ad 15 00 00 00 01 00 02 bb 01 15 00 00 00 01 00 02 bc b3 15 00 00 00 01 00 02 bd 01 15 00 00 00 01 00 02 be b9 15 00 00 00 01 00 02 bf 01 15 00 00 00 01 00 02 c0 bf 15 00 00 00 01 00 02 c1 01 15 00 00 00 01 00 02 c2 d4 15 00 00 00 01 00 02 c3 01 15 00 00 00 01 00 02 c4 e7 15 00 00 00 01 00 02 c5 02 15 00 00 00 01 00 02 c6 0a 15 00 00 00 01 00 02 c7 02 15 00 00 00 01 00 02 c8 27 15 00 00 00 01 00 02 c9 02 15 00 00 00 01 00 02 ca 5a 15 00 00 00 01 00 02 cb 02 15 00 00 00 01 00 02 cc 8b 15 00 00 00 01 00 02 cd 02 15 00 00 00 01 00 02 ce 8c 15 00 00 00 01 00 02 cf 02 15 00 00 00 01 00 02 d0 bd 15 00 00 00 01 00 02 d1 02 15 00 00 00 01 00 02 d2 f3 15 00 00 00 01 00 02 d3 03 15 00 00 00 01 00 02 d4 14 15 00 00 00 01 00 02 d5 03 15 00 00 00 01 00 02 d6 41 15 00 00 00 01 00 02 d7 03 15 00 00 00 01 00 02 d8 5b 15 00 00 00 01 00 02 d9 03 15 00 00 00 01 00 02 da 7c 15 00 00 00 01 00 02 db 03 15 00 00 00 01 00 02 dc 86 15 00 00 00 01 00 02 dd 03 15 00 00 00 01 00 02 de 91 15 00 00 00 01 00 02 df 03 15 00 00 00 01 00 02 e0 9e 15 00 00 00 01 00 02 e1 03 15 00 00 00 01 00 02 e2 ab 15 00 00 00 01 00 02 e3 03 15 00 00 00 01 00 02 e4 b9 15 00 00 00 01 00 02 e5 03 15 00 00 00 01 00 02 e6 c5 15 00 00 00 01 00 02 e7 03 15 00 00 00 01 00 02 e8 cc 15 00 00 00 01 00 02 e9 03 15 00 00 00 01 00 02 ea ff 15 00 00 00 01 00 02 fb 01 15 01 00 00 01 00 02 ff 10];
        qcom,mdss-dsi-dispparam-papermode1-state = "dsi_hs_mode";
        qcom,mdss-dsi-dispparam-papermode2-command = [15 01 00 00 78 00 02 ff 20 15 00 00 00 01 00 02 fb 01 15 00 00 00 01 00 02 75 00 15 00 00 00 01 00 02 76 c8 15 00 00 00 01 00 02 77 00 15 00 00 00 01 00 02 78 d2 15 00 00 00 01 00 02 79 00 15 00 00 00 01 00 02 7a e5 15 00 00 00 01 00 02 7b 00 15 00 00 00 01 00 02 7c f6 15 00 00 00 01 00 02 7d 01 15 00 00 00 01 00 02 7e 06 15 00 00 00 01 00 02 7f 01 15 00 00 00 01 00 02 80 15 15 00 00 00 01 00 02 81 01 15 00 00 00 01 00 02 82 22 15 00 00 00 01 00 02 83 01 15 00 00 00 01 00 02 84 2f 15 00 00 00 01 00 02 85 01 15 00 00 00 01 00 02 86 3c 15 00 00 00 01 00 02 87 01 15 00 00 00 01 00 02 88 66 15 00 00 00 01 00 02 89 01 15 00 00 00 01 00 02 8a 89 15 00 00 00 01 00 02 8b 01 15 00 00 00 01 00 02 8c c2 15 00 00 00 01 00 02 8d 01 15 00 00 00 01 00 02 8e ee 15 00 00 00 01 00 02 8f 02 15 00 00 00 01 00 02 90 34 15 00 00 00 01 00 02 91 02 15 00 00 00 01 00 02 92 6d 15 00 00 00 01 00 02 93 02 15 00 00 00 01 00 02 94 6f 15 00 00 00 01 00 02 95 02 15 00 00 00 01 00 02 96 a6 15 00 00 00 01 00 02 97 02 15 00 00 00 01 00 02 98 e1 15 00 00 00 01 00 02 99 03 15 00 00 00 01 00 02 9a 04 15 00 00 00 01 00 02 9b 03 15 00 00 00 01 00 02 9c 33 15 00 00 00 01 00 02 9d 03 15 00 00 00 01 00 02 9e 4f 15 00 00 00 01 00 02 9f 03 15 00 00 00 01 00 02 a0 72 15 00 00 00 01 00 02 a2 03 15 00 00 00 01 00 02 a3 7c 15 00 00 00 01 00 02 a4 03 15 00 00 00 01 00 02 a5 88 15 00 00 00 01 00 02 a6 03 15 00 00 00 01 00 02 a7 95 15 00 00 00 01 00 02 a9 03 15 00 00 00 01 00 02 aa a3 15 00 00 00 01 00 02 ab 03 15 00 00 00 01 00 02 ac b4 15 00 00 00 01 00 02 ad 03 15 00 00 00 01 00 02 ae c3 15 00 00 00 01 00 02 af 03 15 00 00 00 01 00 02 b0 cd 15 00 00 00 01 00 02 b1 03 15 00 00 00 01 00 02 b2 ff 15 00 00 00 01 00 02 b3 00 15 00 00 00 01 00 02 b4 c8 15 00 00 00 01 00 02 b5 00 15 00 00 00 01 00 02 b6 d2 15 00 00 00 01 00 02 b7 00 15 00 00 00 01 00 02 b8 e5 15 00 00 00 01 00 02 b9 00 15 00 00 00 01 00 02 ba f6 15 00 00 00 01 00 02 bb 01 15 00 00 00 01 00 02 bc 06 15 00 00 00 01 00 02 bd 01 15 00 00 00 01 00 02 be 15 15 00 00 00 01 00 02 bf 01 15 00 00 00 01 00 02 c0 22 15 00 00 00 01 00 02 c1 01 15 00 00 00 01 00 02 c2 2f 15 00 00 00 01 00 02 c3 01 15 00 00 00 01 00 02 c4 3c 15 00 00 00 01 00 02 c5 01 15 00 00 00 01 00 02 c6 66 15 00 00 00 01 00 02 c7 01 15 00 00 00 01 00 02 c8 89 15 00 00 00 01 00 02 c9 01 15 00 00 00 01 00 02 ca c2 15 00 00 00 01 00 02 cb 01 15 00 00 00 01 00 02 cc ee 15 00 00 00 01 00 02 cd 02 15 00 00 00 01 00 02 ce 34 15 00 00 00 01 00 02 cf 02 15 00 00 00 01 00 02 d0 6d 15 00 00 00 01 00 02 d1 02 15 00 00 00 01 00 02 d2 6f 15 00 00 00 01 00 02 d3 02 15 00 00 00 01 00 02 d4 a6 15 00 00 00 01 00 02 d5 02 15 00 00 00 01 00 02 d6 e1 15 00 00 00 01 00 02 d7 03 15 00 00 00 01 00 02 d8 04 15 00 00 00 01 00 02 d9 03 15 00 00 00 01 00 02 da 33 15 00 00 00 01 00 02 db 03 15 00 00 00 01 00 02 dc 4f 15 00 00 00 01 00 02 dd 03 15 00 00 00 01 00 02 de 72 15 00 00 00 01 00 02 df 03 15 00 00 00 01 00 02 e0 7c 15 00 00 00 01 00 02 e1 03 15 00 00 00 01 00 02 e2 88 15 00 00 00 01 00 02 e3 03 15 00 00 00 01 00 02 e4 95 15 00 00 00 01 00 02 e5 03 15 00 00 00 01 00 02 e6 a3 15 00 00 00 01 00 02 e7 03 15 00 00 00 01 00 02 e8 b4 15 00 00 00 01 00 02 e9 03 15 00 00 00 01 00 02 ea c3 15 00 00 00 01 00 02 eb 03 15 00 00 00 01 00 02 ec cd 15 00 00 00 01 00 02 ed 03 15 00 00 00 01 00 02 ee ff 15 00 00 00 01 00 02 ef 00 15 00 00 00 01 00 02 f0 c8 15 00 00 00 01 00 02 f1 00 15 00 00 00 01 00 02 f2 d3 15 00 00 00 01 00 02 f3 00 15 00 00 00 01 00 02 f4 e6 15 00 00 00 01 00 02 f5 00 15 00 00 00 01 00 02 f6 f8 15 00 00 00 01 00 02 f7 01 15 00 00 00 01 00 02 f8 09 15 00 00 00 01 00 02 f9 01 15 00 00 00 01 00 02 fa 18 15 00 00 00 01 00 02 ff 21 15 00 00 00 01 00 02 fb 01 15 00 00 00 01 00 02 00 01 15 00 00 00 01 00 02 01 26 15 00 00 00 01 00 02 02 01 15 00 00 00 01 00 02 03 33 15 00 00 00 01 00 02 04 01 15 00 00 00 01 00 02 05 3f 15 00 00 00 01 00 02 06 01 15 00 00 00 01 00 02 07 6b 15 00 00 00 01 00 02 08 01 15 00 00 00 01 00 02 09 8e 15 00 00 00 01 00 02 0a 01 15 00 00 00 01 00 02 0b c7 15 00 00 00 01 00 02 0c 01 15 00 00 00 01 00 02 0d f2 15 00 00 00 01 00 02 0e 02 15 00 00 00 01 00 02 0f 37 15 00 00 00 01 00 02 10 02 15 00 00 00 01 00 02 11 70 15 00 00 00 01 00 02 12 02 15 00 00 00 01 00 02 13 72 15 00 00 00 01 00 02 14 02 15 00 00 00 01 00 02 15 a8 15 00 00 00 01 00 02 16 02 15 00 00 00 01 00 02 17 e3 15 00 00 00 01 00 02 18 03 15 00 00 00 01 00 02 19 05 15 00 00 00 01 00 02 1a 03 15 00 00 00 01 00 02 1b 34 15 00 00 00 01 00 02 1c 03 15 00 00 00 01 00 02 1d 50 15 00 00 00 01 00 02 1e 03 15 00 00 00 01 00 02 1f 73 15 00 00 00 01 00 02 20 03 15 00 00 00 01 00 02 21 7d 15 00 00 00 01 00 02 22 03 15 00 00 00 01 00 02 23 89 15 00 00 00 01 00 02 24 03 15 00 00 00 01 00 02 25 96 15 00 00 00 01 00 02 26 03 15 00 00 00 01 00 02 27 a5 15 00 00 00 01 00 02 28 03 15 00 00 00 01 00 02 29 b5 15 00 00 00 01 00 02 2a 03 15 00 00 00 01 00 02 2b c3 15 00 00 00 01 00 02 2d 03 15 00 00 00 01 00 02 2f cc 15 00 00 00 01 00 02 30 03 15 00 00 00 01 00 02 31 ff 15 00 00 00 01 00 02 32 00 15 00 00 00 01 00 02 33 c8 15 00 00 00 01 00 02 34 00 15 00 00 00 01 00 02 35 d3 15 00 00 00 01 00 02 36 00 15 00 00 00 01 00 02 37 e6 15 00 00 00 01 00 02 38 00 15 00 00 00 01 00 02 39 f8 15 00 00 00 01 00 02 3a 01 15 00 00 00 01 00 02 3b 09 15 00 00 00 01 00 02 3d 01 15 00 00 00 01 00 02 3f 18 15 00 00 00 01 00 02 40 01 15 00 00 00 01 00 02 41 26 15 00 00 00 01 00 02 42 01 15 00 00 00 01 00 02 43 33 15 00 00 00 01 00 02 44 01 15 00 00 00 01 00 02 45 3f 15 00 00 00 01 00 02 46 01 15 00 00 00 01 00 02 47 6b 15 00 00 00 01 00 02 48 01 15 00 00 00 01 00 02 49 8e 15 00 00 00 01 00 02 4a 01 15 00 00 00 01 00 02 4b c7 15 00 00 00 01 00 02 4c 01 15 00 00 00 01 00 02 4d f2 15 00 00 00 01 00 02 4e 02 15 00 00 00 01 00 02 4f 37 15 00 00 00 01 00 02 50 02 15 00 00 00 01 00 02 51 70 15 00 00 00 01 00 02 52 02 15 00 00 00 01 00 02 53 72 15 00 00 00 01 00 02 54 02 15 00 00 00 01 00 02 55 a8 15 00 00 00 01 00 02 56 02 15 00 00 00 01 00 02 58 e3 15 00 00 00 01 00 02 59 03 15 00 00 00 01 00 02 5a 05 15 00 00 00 01 00 02 5b 03 15 00 00 00 01 00 02 5c 34 15 00 00 00 01 00 02 5d 03 15 00 00 00 01 00 02 5e 50 15 00 00 00 01 00 02 5f 03 15 00 00 00 01 00 02 60 73 15 00 00 00 01 00 02 61 03 15 00 00 00 01 00 02 62 7d 15 00 00 00 01 00 02 63 03 15 00 00 00 01 00 02 64 89 15 00 00 00 01 00 02 65 03 15 00 00 00 01 00 02 66 96 15 00 00 00 01 00 02 67 03 15 00 00 00 01 00 02 68 a5 15 00 00 00 01 00 02 69 03 15 00 00 00 01 00 02 6a b5 15 00 00 00 01 00 02 6b 03 15 00 00 00 01 00 02 6c c3 15 00 00 00 01 00 02 6d 03 15 00 00 00 01 00 02 6e cc 15 00 00 00 01 00 02 6f 03 15 00 00 00 01 00 02 70 ff 15 00 00 00 01 00 02 71 01 15 00 00 00 01 00 02 72 c2 15 00 00 00 01 00 02 73 01 15 00 00 00 01 00 02 74 c5 15 00 00 00 01 00 02 75 01 15 00 00 00 01 00 02 76 ca 15 00 00 00 01 00 02 77 01 15 00 00 00 01 00 02 78 ce 15 00 00 00 01 00 02 79 01 15 00 00 00 01 00 02 7a d3 15 00 00 00 01 00 02 7b 01 15 00 00 00 01 00 02 7c d8 15 00 00 00 01 00 02 7d 01 15 00 00 00 01 00 02 7e dc 15 00 00 00 01 00 02 7f 01 15 00 00 00 01 00 02 80 e1 15 00 00 00 01 00 02 81 01 15 00 00 00 01 00 02 82 e5 15 00 00 00 01 00 02 83 01 15 00 00 00 01 00 02 84 f6 15 00 00 00 01 00 02 85 02 15 00 00 00 01 00 02 86 06 15 00 00 00 01 00 02 87 02 15 00 00 00 01 00 02 88 22 15 00 00 00 01 00 02 89 02 15 00 00 00 01 00 02 8a 3b 15 00 00 00 01 00 02 8b 02 15 00 00 00 01 00 02 8c 6a 15 00 00 00 01 00 02 8d 02 15 00 00 00 01 00 02 8e 97 15 00 00 00 01 00 02 8f 02 15 00 00 00 01 00 02 90 98 15 00 00 00 01 00 02 91 02 15 00 00 00 01 00 02 92 c7 15 00 00 00 01 00 02 93 02 15 00 00 00 01 00 02 94 fb 15 00 00 00 01 00 02 95 03 15 00 00 00 01 00 02 96 1a 15 00 00 00 01 00 02 97 03 15 00 00 00 01 00 02 98 47 15 00 00 00 01 00 02 99 03 15 00 00 00 01 00 02 9a 61 15 00 00 00 01 00 02 9b 03 15 00 00 00 01 00 02 9c 81 15 00 00 00 01 00 02 9d 03 15 00 00 00 01 00 02 9e 8b 15 00 00 00 01 00 02 9f 03 15 00 00 00 01 00 02 a0 96 15 00 00 00 01 00 02 a2 03 15 00 00 00 01 00 02 a3 a2 15 00 00 00 01 00 02 a4 03 15 00 00 00 01 00 02 a5 ae 15 00 00 00 01 00 02 a6 03 15 00 00 00 01 00 02 a7 bb 15 00 00 00 01 00 02 a9 03 15 00 00 00 01 00 02 aa c6 15 00 00 00 01 00 02 ab 03 15 00 00 00 01 00 02 ac cc 15 00 00 00 01 00 02 ad 03 15 00 00 00 01 00 02 ae ff 15 00 00 00 01 00 02 af 01 15 00 00 00 01 00 02 b0 c2 15 00 00 00 01 00 02 b1 01 15 00 00 00 01 00 02 b2 c5 15 00 00 00 01 00 02 b3 01 15 00 00 00 01 00 02 b4 ca 15 00 00 00 01 00 02 b5 01 15 00 00 00 01 00 02 b6 ce 15 00 00 00 01 00 02 b7 01 15 00 00 00 01 00 02 b8 d3 15 00 00 00 01 00 02 b9 01 15 00 00 00 01 00 02 ba d8 15 00 00 00 01 00 02 bb 01 15 00 00 00 01 00 02 bc dc 15 00 00 00 01 00 02 bd 01 15 00 00 00 01 00 02 be e1 15 00 00 00 01 00 02 bf 01 15 00 00 00 01 00 02 c0 e5 15 00 00 00 01 00 02 c1 01 15 00 00 00 01 00 02 c2 f6 15 00 00 00 01 00 02 c3 02 15 00 00 00 01 00 02 c4 06 15 00 00 00 01 00 02 c5 02 15 00 00 00 01 00 02 c6 22 15 00 00 00 01 00 02 c7 02 15 00 00 00 01 00 02 c8 3b 15 00 00 00 01 00 02 c9 02 15 00 00 00 01 00 02 ca 6a 15 00 00 00 01 00 02 cb 02 15 00 00 00 01 00 02 cc 97 15 00 00 00 01 00 02 cd 02 15 00 00 00 01 00 02 ce 98 15 00 00 00 01 00 02 cf 02 15 00 00 00 01 00 02 d0 c7 15 00 00 00 01 00 02 d1 02 15 00 00 00 01 00 02 d2 fb 15 00 00 00 01 00 02 d3 03 15 00 00 00 01 00 02 d4 1a 15 00 00 00 01 00 02 d5 03 15 00 00 00 01 00 02 d6 47 15 00 00 00 01 00 02 d7 03 15 00 00 00 01 00 02 d8 61 15 00 00 00 01 00 02 d9 03 15 00 00 00 01 00 02 da 81 15 00 00 00 01 00 02 db 03 15 00 00 00 01 00 02 dc 8b 15 00 00 00 01 00 02 dd 03 15 00 00 00 01 00 02 de 96 15 00 00 00 01 00 02 df 03 15 00 00 00 01 00 02 e0 a2 15 00 00 00 01 00 02 e1 03 15 00 00 00 01 00 02 e2 ae 15 00 00 00 01 00 02 e3 03 15 00 00 00 01 00 02 e4 bb 15 00 00 00 01 00 02 e5 03 15 00 00 00 01 00 02 e6 c6 15 00 00 00 01 00 02 e7 03 15 00 00 00 01 00 02 e8 cc 15 00 00 00 01 00 02 e9 03 15 00 00 00 01 00 02 ea ff 15 00 00 00 01 00 02 fb 01 15 01 00 00 01 00 02 ff 10];
        qcom,mdss-dsi-dispparam-papermode2-state = "dsi_hs_mode";
        qcom,mdss-dsi-dispparam-papermode3-command = [15 01 00 00 78 00 02 ff 20 15 00 00 00 01 00 02 fb 01 15 00 00 00 01 00 02 75 00 15 00 00 00 01 00 02 76 c8 15 00 00 00 01 00 02 77 00 15 00 00 00 01 00 02 78 d2 15 00 00 00 01 00 02 79 00 15 00 00 00 01 00 02 7a e5 15 00 00 00 01 00 02 7b 00 15 00 00 00 01 00 02 7c f6 15 00 00 00 01 00 02 7d 01 15 00 00 00 01 00 02 7e 06 15 00 00 00 01 00 02 7f 01 15 00 00 00 01 00 02 80 15 15 00 00 00 01 00 02 81 01 15 00 00 00 01 00 02 82 22 15 00 00 00 01 00 02 83 01 15 00 00 00 01 00 02 84 2f 15 00 00 00 01 00 02 85 01 15 00 00 00 01 00 02 86 3c 15 00 00 00 01 00 02 87 01 15 00 00 00 01 00 02 88 66 15 00 00 00 01 00 02 89 01 15 00 00 00 01 00 02 8a 89 15 00 00 00 01 00 02 8b 01 15 00 00 00 01 00 02 8c c2 15 00 00 00 01 00 02 8d 01 15 00 00 00 01 00 02 8e ee 15 00 00 00 01 00 02 8f 02 15 00 00 00 01 00 02 90 34 15 00 00 00 01 00 02 91 02 15 00 00 00 01 00 02 92 6d 15 00 00 00 01 00 02 93 02 15 00 00 00 01 00 02 94 6f 15 00 00 00 01 00 02 95 02 15 00 00 00 01 00 02 96 a6 15 00 00 00 01 00 02 97 02 15 00 00 00 01 00 02 98 e1 15 00 00 00 01 00 02 99 03 15 00 00 00 01 00 02 9a 04 15 00 00 00 01 00 02 9b 03 15 00 00 00 01 00 02 9c 33 15 00 00 00 01 00 02 9d 03 15 00 00 00 01 00 02 9e 4f 15 00 00 00 01 00 02 9f 03 15 00 00 00 01 00 02 a0 72 15 00 00 00 01 00 02 a2 03 15 00 00 00 01 00 02 a3 7c 15 00 00 00 01 00 02 a4 03 15 00 00 00 01 00 02 a5 88 15 00 00 00 01 00 02 a6 03 15 00 00 00 01 00 02 a7 95 15 00 00 00 01 00 02 a9 03 15 00 00 00 01 00 02 aa a3 15 00 00 00 01 00 02 ab 03 15 00 00 00 01 00 02 ac b4 15 00 00 00 01 00 02 ad 03 15 00 00 00 01 00 02 ae c3 15 00 00 00 01 00 02 af 03 15 00 00 00 01 00 02 b0 cd 15 00 00 00 01 00 02 b1 03 15 00 00 00 01 00 02 b2 ff 15 00 00 00 01 00 02 b3 00 15 00 00 00 01 00 02 b4 c8 15 00 00 00 01 00 02 b5 00 15 00 00 00 01 00 02 b6 d2 15 00 00 00 01 00 02 b7 00 15 00 00 00 01 00 02 b8 e5 15 00 00 00 01 00 02 b9 00 15 00 00 00 01 00 02 ba f6 15 00 00 00 01 00 02 bb 01 15 00 00 00 01 00 02 bc 06 15 00 00 00 01 00 02 bd 01 15 00 00 00 01 00 02 be 15 15 00 00 00 01 00 02 bf 01 15 00 00 00 01 00 02 c0 22 15 00 00 00 01 00 02 c1 01 15 00 00 00 01 00 02 c2 2f 15 00 00 00 01 00 02 c3 01 15 00 00 00 01 00 02 c4 3c 15 00 00 00 01 00 02 c5 01 15 00 00 00 01 00 02 c6 66 15 00 00 00 01 00 02 c7 01 15 00 00 00 01 00 02 c8 89 15 00 00 00 01 00 02 c9 01 15 00 00 00 01 00 02 ca c2 15 00 00 00 01 00 02 cb 01 15 00 00 00 01 00 02 cc ee 15 00 00 00 01 00 02 cd 02 15 00 00 00 01 00 02 ce 34 15 00 00 00 01 00 02 cf 02 15 00 00 00 01 00 02 d0 6d 15 00 00 00 01 00 02 d1 02 15 00 00 00 01 00 02 d2 6f 15 00 00 00 01 00 02 d3 02 15 00 00 00 01 00 02 d4 a6 15 00 00 00 01 00 02 d5 02 15 00 00 00 01 00 02 d6 e1 15 00 00 00 01 00 02 d7 03 15 00 00 00 01 00 02 d8 04 15 00 00 00 01 00 02 d9 03 15 00 00 00 01 00 02 da 33 15 00 00 00 01 00 02 db 03 15 00 00 00 01 00 02 dc 4f 15 00 00 00 01 00 02 dd 03 15 00 00 00 01 00 02 de 72 15 00 00 00 01 00 02 df 03 15 00 00 00 01 00 02 e0 7c 15 00 00 00 01 00 02 e1 03 15 00 00 00 01 00 02 e2 88 15 00 00 00 01 00 02 e3 03 15 00 00 00 01 00 02 e4 95 15 00 00 00 01 00 02 e5 03 15 00 00 00 01 00 02 e6 a3 15 00 00 00 01 00 02 e7 03 15 00 00 00 01 00 02 e8 b4 15 00 00 00 01 00 02 e9 03 15 00 00 00 01 00 02 ea c3 15 00 00 00 01 00 02 eb 03 15 00 00 00 01 00 02 ec cd 15 00 00 00 01 00 02 ed 03 15 00 00 00 01 00 02 ee ff 15 00 00 00 01 00 02 ef 00 15 00 00 00 01 00 02 f0 c8 15 00 00 00 01 00 02 f1 00 15 00 00 00 01 00 02 f2 d3 15 00 00 00 01 00 02 f3 00 15 00 00 00 01 00 02 f4 e6 15 00 00 00 01 00 02 f5 00 15 00 00 00 01 00 02 f6 f8 15 00 00 00 01 00 02 f7 01 15 00 00 00 01 00 02 f8 09 15 00 00 00 01 00 02 f9 01 15 00 00 00 01 00 02 fa 18 15 00 00 00 01 00 02 ff 21 15 00 00 00 01 00 02 fb 01 15 00 00 00 01 00 02 00 01 15 00 00 00 01 00 02 01 26 15 00 00 00 01 00 02 02 01 15 00 00 00 01 00 02 03 33 15 00 00 00 01 00 02 04 01 15 00 00 00 01 00 02 05 3f 15 00 00 00 01 00 02 06 01 15 00 00 00 01 00 02 07 6b 15 00 00 00 01 00 02 08 01 15 00 00 00 01 00 02 09 8e 15 00 00 00 01 00 02 0a 01 15 00 00 00 01 00 02 0b c7 15 00 00 00 01 00 02 0c 01 15 00 00 00 01 00 02 0d f2 15 00 00 00 01 00 02 0e 02 15 00 00 00 01 00 02 0f 37 15 00 00 00 01 00 02 10 02 15 00 00 00 01 00 02 11 70 15 00 00 00 01 00 02 12 02 15 00 00 00 01 00 02 13 72 15 00 00 00 01 00 02 14 02 15 00 00 00 01 00 02 15 a8 15 00 00 00 01 00 02 16 02 15 00 00 00 01 00 02 17 e3 15 00 00 00 01 00 02 18 03 15 00 00 00 01 00 02 19 05 15 00 00 00 01 00 02 1a 03 15 00 00 00 01 00 02 1b 34 15 00 00 00 01 00 02 1c 03 15 00 00 00 01 00 02 1d 50 15 00 00 00 01 00 02 1e 03 15 00 00 00 01 00 02 1f 73 15 00 00 00 01 00 02 20 03 15 00 00 00 01 00 02 21 7d 15 00 00 00 01 00 02 22 03 15 00 00 00 01 00 02 23 89 15 00 00 00 01 00 02 24 03 15 00 00 00 01 00 02 25 96 15 00 00 00 01 00 02 26 03 15 00 00 00 01 00 02 27 a5 15 00 00 00 01 00 02 28 03 15 00 00 00 01 00 02 29 b5 15 00 00 00 01 00 02 2a 03 15 00 00 00 01 00 02 2b c3 15 00 00 00 01 00 02 2d 03 15 00 00 00 01 00 02 2f cc 15 00 00 00 01 00 02 30 03 15 00 00 00 01 00 02 31 ff 15 00 00 00 01 00 02 32 00 15 00 00 00 01 00 02 33 c8 15 00 00 00 01 00 02 34 00 15 00 00 00 01 00 02 35 d3 15 00 00 00 01 00 02 36 00 15 00 00 00 01 00 02 37 e6 15 00 00 00 01 00 02 38 00 15 00 00 00 01 00 02 39 f8 15 00 00 00 01 00 02 3a 01 15 00 00 00 01 00 02 3b 09 15 00 00 00 01 00 02 3d 01 15 00 00 00 01 00 02 3f 18 15 00 00 00 01 00 02 40 01 15 00 00 00 01 00 02 41 26 15 00 00 00 01 00 02 42 01 15 00 00 00 01 00 02 43 33 15 00 00 00 01 00 02 44 01 15 00 00 00 01 00 02 45 3f 15 00 00 00 01 00 02 46 01 15 00 00 00 01 00 02 47 6b 15 00 00 00 01 00 02 48 01 15 00 00 00 01 00 02 49 8e 15 00 00 00 01 00 02 4a 01 15 00 00 00 01 00 02 4b c7 15 00 00 00 01 00 02 4c 01 15 00 00 00 01 00 02 4d f2 15 00 00 00 01 00 02 4e 02 15 00 00 00 01 00 02 4f 37 15 00 00 00 01 00 02 50 02 15 00 00 00 01 00 02 51 70 15 00 00 00 01 00 02 52 02 15 00 00 00 01 00 02 53 72 15 00 00 00 01 00 02 54 02 15 00 00 00 01 00 02 55 a8 15 00 00 00 01 00 02 56 02 15 00 00 00 01 00 02 58 e3 15 00 00 00 01 00 02 59 03 15 00 00 00 01 00 02 5a 05 15 00 00 00 01 00 02 5b 03 15 00 00 00 01 00 02 5c 34 15 00 00 00 01 00 02 5d 03 15 00 00 00 01 00 02 5e 50 15 00 00 00 01 00 02 5f 03 15 00 00 00 01 00 02 60 73 15 00 00 00 01 00 02 61 03 15 00 00 00 01 00 02 62 7d 15 00 00 00 01 00 02 63 03 15 00 00 00 01 00 02 64 89 15 00 00 00 01 00 02 65 03 15 00 00 00 01 00 02 66 96 15 00 00 00 01 00 02 67 03 15 00 00 00 01 00 02 68 a5 15 00 00 00 01 00 02 69 03 15 00 00 00 01 00 02 6a b5 15 00 00 00 01 00 02 6b 03 15 00 00 00 01 00 02 6c c3 15 00 00 00 01 00 02 6d 03 15 00 00 00 01 00 02 6e cc 15 00 00 00 01 00 02 6f 03 15 00 00 00 01 00 02 70 ff 15 00 00 00 01 00 02 71 01 15 00 00 00 01 00 02 72 e0 15 00 00 00 01 00 02 73 01 15 00 00 00 01 00 02 74 e2 15 00 00 00 01 00 02 75 01 15 00 00 00 01 00 02 76 e6 15 00 00 00 01 00 02 77 01 15 00 00 00 01 00 02 78 ea 15 00 00 00 01 00 02 79 01 15 00 00 00 01 00 02 7a ee 15 00 00 00 01 00 02 7b 01 15 00 00 00 01 00 02 7c f2 15 00 00 00 01 00 02 7d 01 15 00 00 00 01 00 02 7e f6 15 00 00 00 01 00 02 7f 01 15 00 00 00 01 00 02 80 fa 15 00 00 00 01 00 02 81 01 15 00 00 00 01 00 02 82 fe 15 00 00 00 01 00 02 83 02 15 00 00 00 01 00 02 84 0d 15 00 00 00 01 00 02 85 02 15 00 00 00 01 00 02 86 1a 15 00 00 00 01 00 02 87 02 15 00 00 00 01 00 02 88 33 15 00 00 00 01 00 02 89 02 15 00 00 00 01 00 02 8a 4a 15 00 00 00 01 00 02 8b 02 15 00 00 00 01 00 02 8c 75 15 00 00 00 01 00 02 8d 02 15 00 00 00 01 00 02 8e a0 15 00 00 00 01 00 02 8f 02 15 00 00 00 01 00 02 90 a1 15 00 00 00 01 00 02 91 02 15 00 00 00 01 00 02 92 ce 15 00 00 00 01 00 02 93 03 15 00 00 00 01 00 02 94 00 15 00 00 00 01 00 02 95 03 15 00 00 00 01 00 02 96 23 15 00 00 00 01 00 02 97 03 15 00 00 00 01 00 02 98 4c 15 00 00 00 01 00 02 99 03 15 00 00 00 01 00 02 9a 65 15 00 00 00 01 00 02 9b 03 15 00 00 00 01 00 02 9c 85 15 00 00 00 01 00 02 9d 03 15 00 00 00 01 00 02 9e 8e 15 00 00 00 01 00 02 9f 03 15 00 00 00 01 00 02 a0 99 15 00 00 00 01 00 02 a2 03 15 00 00 00 01 00 02 a3 a4 15 00 00 00 01 00 02 a4 03 15 00 00 00 01 00 02 a5 b1 15 00 00 00 01 00 02 a6 03 15 00 00 00 01 00 02 a7 bd 15 00 00 00 01 00 02 a9 03 15 00 00 00 01 00 02 aa c7 15 00 00 00 01 00 02 ab 03 15 00 00 00 01 00 02 ac cc 15 00 00 00 01 00 02 ad 03 15 00 00 00 01 00 02 ae ff 15 00 00 00 01 00 02 af 01 15 00 00 00 01 00 02 b0 e0 15 00 00 00 01 00 02 b1 01 15 00 00 00 01 00 02 b2 e2 15 00 00 00 01 00 02 b3 01 15 00 00 00 01 00 02 b4 e6 15 00 00 00 01 00 02 b5 01 15 00 00 00 01 00 02 b6 ea 15 00 00 00 01 00 02 b7 01 15 00 00 00 01 00 02 b8 ee 15 00 00 00 01 00 02 b9 01 15 00 00 00 01 00 02 ba f2 15 00 00 00 01 00 02 bb 01 15 00 00 00 01 00 02 bc f6 15 00 00 00 01 00 02 bd 01 15 00 00 00 01 00 02 be fa 15 00 00 00 01 00 02 bf 01 15 00 00 00 01 00 02 c0 fe 15 00 00 00 01 00 02 c1 02 15 00 00 00 01 00 02 c2 0d 15 00 00 00 01 00 02 c3 02 15 00 00 00 01 00 02 c4 1a 15 00 00 00 01 00 02 c5 02 15 00 00 00 01 00 02 c6 33 15 00 00 00 01 00 02 c7 02 15 00 00 00 01 00 02 c8 4a 15 00 00 00 01 00 02 c9 02 15 00 00 00 01 00 02 ca 75 15 00 00 00 01 00 02 cb 02 15 00 00 00 01 00 02 cc a0 15 00 00 00 01 00 02 cd 02 15 00 00 00 01 00 02 ce a1 15 00 00 00 01 00 02 cf 02 15 00 00 00 01 00 02 d0 ce 15 00 00 00 01 00 02 d1 03 15 00 00 00 01 00 02 d2 00 15 00 00 00 01 00 02 d3 03 15 00 00 00 01 00 02 d4 23 15 00 00 00 01 00 02 d5 03 15 00 00 00 01 00 02 d6 4c 15 00 00 00 01 00 02 d7 03 15 00 00 00 01 00 02 d8 65 15 00 00 00 01 00 02 d9 03 15 00 00 00 01 00 02 da 85 15 00 00 00 01 00 02 db 03 15 00 00 00 01 00 02 dc 8e 15 00 00 00 01 00 02 dd 03 15 00 00 00 01 00 02 de 99 15 00 00 00 01 00 02 df 03 15 00 00 00 01 00 02 e0 a4 15 00 00 00 01 00 02 e1 03 15 00 00 00 01 00 02 e2 b1 15 00 00 00 01 00 02 e3 03 15 00 00 00 01 00 02 e4 bd 15 00 00 00 01 00 02 e5 03 15 00 00 00 01 00 02 e6 c7 15 00 00 00 01 00 02 e7 03 15 00 00 00 01 00 02 e8 cc 15 00 00 00 01 00 02 e9 03 15 00 00 00 01 00 02 ea ff 15 00 00 00 01 00 02 fb 01 15 01 00 00 01 00 02 ff 10];
        qcom,mdss-dsi-dispparam-papermode3-state = "dsi_hs_mode";
        qcom,mdss-dsi-dispparam-papermode4-command = [15 01 00 00 78 00 02 ff 20 15 00 00 00 01 00 02 fb 01 15 00 00 00 01 00 02 75 00 15 00 00 00 01 00 02 76 c8 15 00 00 00 01 00 02 77 00 15 00 00 00 01 00 02 78 d2 15 00 00 00 01 00 02 79 00 15 00 00 00 01 00 02 7a e5 15 00 00 00 01 00 02 7b 00 15 00 00 00 01 00 02 7c f6 15 00 00 00 01 00 02 7d 01 15 00 00 00 01 00 02 7e 06 15 00 00 00 01 00 02 7f 01 15 00 00 00 01 00 02 80 15 15 00 00 00 01 00 02 81 01 15 00 00 00 01 00 02 82 22 15 00 00 00 01 00 02 83 01 15 00 00 00 01 00 02 84 2f 15 00 00 00 01 00 02 85 01 15 00 00 00 01 00 02 86 3c 15 00 00 00 01 00 02 87 01 15 00 00 00 01 00 02 88 66 15 00 00 00 01 00 02 89 01 15 00 00 00 01 00 02 8a 89 15 00 00 00 01 00 02 8b 01 15 00 00 00 01 00 02 8c c2 15 00 00 00 01 00 02 8d 01 15 00 00 00 01 00 02 8e ee 15 00 00 00 01 00 02 8f 02 15 00 00 00 01 00 02 90 34 15 00 00 00 01 00 02 91 02 15 00 00 00 01 00 02 92 6d 15 00 00 00 01 00 02 93 02 15 00 00 00 01 00 02 94 6f 15 00 00 00 01 00 02 95 02 15 00 00 00 01 00 02 96 a6 15 00 00 00 01 00 02 97 02 15 00 00 00 01 00 02 98 e1 15 00 00 00 01 00 02 99 03 15 00 00 00 01 00 02 9a 04 15 00 00 00 01 00 02 9b 03 15 00 00 00 01 00 02 9c 33 15 00 00 00 01 00 02 9d 03 15 00 00 00 01 00 02 9e 4f 15 00 00 00 01 00 02 9f 03 15 00 00 00 01 00 02 a0 72 15 00 00 00 01 00 02 a2 03 15 00 00 00 01 00 02 a3 7c 15 00 00 00 01 00 02 a4 03 15 00 00 00 01 00 02 a5 88 15 00 00 00 01 00 02 a6 03 15 00 00 00 01 00 02 a7 95 15 00 00 00 01 00 02 a9 03 15 00 00 00 01 00 02 aa a3 15 00 00 00 01 00 02 ab 03 15 00 00 00 01 00 02 ac b4 15 00 00 00 01 00 02 ad 03 15 00 00 00 01 00 02 ae c3 15 00 00 00 01 00 02 af 03 15 00 00 00 01 00 02 b0 cd 15 00 00 00 01 00 02 b1 03 15 00 00 00 01 00 02 b2 ff 15 00 00 00 01 00 02 b3 00 15 00 00 00 01 00 02 b4 c8 15 00 00 00 01 00 02 b5 00 15 00 00 00 01 00 02 b6 d2 15 00 00 00 01 00 02 b7 00 15 00 00 00 01 00 02 b8 e5 15 00 00 00 01 00 02 b9 00 15 00 00 00 01 00 02 ba f6 15 00 00 00 01 00 02 bb 01 15 00 00 00 01 00 02 bc 06 15 00 00 00 01 00 02 bd 01 15 00 00 00 01 00 02 be 15 15 00 00 00 01 00 02 bf 01 15 00 00 00 01 00 02 c0 22 15 00 00 00 01 00 02 c1 01 15 00 00 00 01 00 02 c2 2f 15 00 00 00 01 00 02 c3 01 15 00 00 00 01 00 02 c4 3c 15 00 00 00 01 00 02 c5 01 15 00 00 00 01 00 02 c6 66 15 00 00 00 01 00 02 c7 01 15 00 00 00 01 00 02 c8 89 15 00 00 00 01 00 02 c9 01 15 00 00 00 01 00 02 ca c2 15 00 00 00 01 00 02 cb 01 15 00 00 00 01 00 02 cc ee 15 00 00 00 01 00 02 cd 02 15 00 00 00 01 00 02 ce 34 15 00 00 00 01 00 02 cf 02 15 00 00 00 01 00 02 d0 6d 15 00 00 00 01 00 02 d1 02 15 00 00 00 01 00 02 d2 6f 15 00 00 00 01 00 02 d3 02 15 00 00 00 01 00 02 d4 a6 15 00 00 00 01 00 02 d5 02 15 00 00 00 01 00 02 d6 e1 15 00 00 00 01 00 02 d7 03 15 00 00 00 01 00 02 d8 04 15 00 00 00 01 00 02 d9 03 15 00 00 00 01 00 02 da 33 15 00 00 00 01 00 02 db 03 15 00 00 00 01 00 02 dc 4f 15 00 00 00 01 00 02 dd 03 15 00 00 00 01 00 02 de 72 15 00 00 00 01 00 02 df 03 15 00 00 00 01 00 02 e0 7c 15 00 00 00 01 00 02 e1 03 15 00 00 00 01 00 02 e2 88 15 00 00 00 01 00 02 e3 03 15 00 00 00 01 00 02 e4 95 15 00 00 00 01 00 02 e5 03 15 00 00 00 01 00 02 e6 a3 15 00 00 00 01 00 02 e7 03 15 00 00 00 01 00 02 e8 b4 15 00 00 00 01 00 02 e9 03 15 00 00 00 01 00 02 ea c3 15 00 00 00 01 00 02 eb 03 15 00 00 00 01 00 02 ec cd 15 00 00 00 01 00 02 ed 03 15 00 00 00 01 00 02 ee ff 15 00 00 00 01 00 02 ef 00 15 00 00 00 01 00 02 f0 c8 15 00 00 00 01 00 02 f1 00 15 00 00 00 01 00 02 f2 d3 15 00 00 00 01 00 02 f3 00 15 00 00 00 01 00 02 f4 e6 15 00 00 00 01 00 02 f5 00 15 00 00 00 01 00 02 f6 f8 15 00 00 00 01 00 02 f7 01 15 00 00 00 01 00 02 f8 09 15 00 00 00 01 00 02 f9 01 15 00 00 00 01 00 02 fa 18 15 00 00 00 01 00 02 ff 21 15 00 00 00 01 00 02 fb 01 15 00 00 00 01 00 02 00 01 15 00 00 00 01 00 02 01 26 15 00 00 00 01 00 02 02 01 15 00 00 00 01 00 02 03 33 15 00 00 00 01 00 02 04 01 15 00 00 00 01 00 02 05 3f 15 00 00 00 01 00 02 06 01 15 00 00 00 01 00 02 07 6b 15 00 00 00 01 00 02 08 01 15 00 00 00 01 00 02 09 8e 15 00 00 00 01 00 02 0a 01 15 00 00 00 01 00 02 0b c7 15 00 00 00 01 00 02 0c 01 15 00 00 00 01 00 02 0d f2 15 00 00 00 01 00 02 0e 02 15 00 00 00 01 00 02 0f 37 15 00 00 00 01 00 02 10 02 15 00 00 00 01 00 02 11 70 15 00 00 00 01 00 02 12 02 15 00 00 00 01 00 02 13 72 15 00 00 00 01 00 02 14 02 15 00 00 00 01 00 02 15 a8 15 00 00 00 01 00 02 16 02 15 00 00 00 01 00 02 17 e3 15 00 00 00 01 00 02 18 03 15 00 00 00 01 00 02 19 05 15 00 00 00 01 00 02 1a 03 15 00 00 00 01 00 02 1b 34 15 00 00 00 01 00 02 1c 03 15 00 00 00 01 00 02 1d 50 15 00 00 00 01 00 02 1e 03 15 00 00 00 01 00 02 1f 73 15 00 00 00 01 00 02 20 03 15 00 00 00 01 00 02 21 7d 15 00 00 00 01 00 02 22 03 15 00 00 00 01 00 02 23 89 15 00 00 00 01 00 02 24 03 15 00 00 00 01 00 02 25 96 15 00 00 00 01 00 02 26 03 15 00 00 00 01 00 02 27 a5 15 00 00 00 01 00 02 28 03 15 00 00 00 01 00 02 29 b5 15 00 00 00 01 00 02 2a 03 15 00 00 00 01 00 02 2b c3 15 00 00 00 01 00 02 2d 03 15 00 00 00 01 00 02 2f cc 15 00 00 00 01 00 02 30 03 15 00 00 00 01 00 02 31 ff 15 00 00 00 01 00 02 32 00 15 00 00 00 01 00 02 33 c8 15 00 00 00 01 00 02 34 00 15 00 00 00 01 00 02 35 d3 15 00 00 00 01 00 02 36 00 15 00 00 00 01 00 02 37 e6 15 00 00 00 01 00 02 38 00 15 00 00 00 01 00 02 39 f8 15 00 00 00 01 00 02 3a 01 15 00 00 00 01 00 02 3b 09 15 00 00 00 01 00 02 3d 01 15 00 00 00 01 00 02 3f 18 15 00 00 00 01 00 02 40 01 15 00 00 00 01 00 02 41 26 15 00 00 00 01 00 02 42 01 15 00 00 00 01 00 02 43 33 15 00 00 00 01 00 02 44 01 15 00 00 00 01 00 02 45 3f 15 00 00 00 01 00 02 46 01 15 00 00 00 01 00 02 47 6b 15 00 00 00 01 00 02 48 01 15 00 00 00 01 00 02 49 8e 15 00 00 00 01 00 02 4a 01 15 00 00 00 01 00 02 4b c7 15 00 00 00 01 00 02 4c 01 15 00 00 00 01 00 02 4d f2 15 00 00 00 01 00 02 4e 02 15 00 00 00 01 00 02 4f 37 15 00 00 00 01 00 02 50 02 15 00 00 00 01 00 02 51 70 15 00 00 00 01 00 02 52 02 15 00 00 00 01 00 02 53 72 15 00 00 00 01 00 02 54 02 15 00 00 00 01 00 02 55 a8 15 00 00 00 01 00 02 56 02 15 00 00 00 01 00 02 58 e3 15 00 00 00 01 00 02 59 03 15 00 00 00 01 00 02 5a 05 15 00 00 00 01 00 02 5b 03 15 00 00 00 01 00 02 5c 34 15 00 00 00 01 00 02 5d 03 15 00 00 00 01 00 02 5e 50 15 00 00 00 01 00 02 5f 03 15 00 00 00 01 00 02 60 73 15 00 00 00 01 00 02 61 03 15 00 00 00 01 00 02 62 7d 15 00 00 00 01 00 02 63 03 15 00 00 00 01 00 02 64 89 15 00 00 00 01 00 02 65 03 15 00 00 00 01 00 02 66 96 15 00 00 00 01 00 02 67 03 15 00 00 00 01 00 02 68 a5 15 00 00 00 01 00 02 69 03 15 00 00 00 01 00 02 6a b5 15 00 00 00 01 00 02 6b 03 15 00 00 00 01 00 02 6c c3 15 00 00 00 01 00 02 6d 03 15 00 00 00 01 00 02 6e cc 15 00 00 00 01 00 02 6f 03 15 00 00 00 01 00 02 70 ff 15 00 00 00 01 00 02 71 01 15 00 00 00 01 00 02 72 f4 15 00 00 00 01 00 02 73 01 15 00 00 00 01 00 02 74 f6 15 00 00 00 01 00 02 75 01 15 00 00 00 01 00 02 76 fa 15 00 00 00 01 00 02 77 01 15 00 00 00 01 00 02 78 fe 15 00 00 00 01 00 02 79 02 15 00 00 00 01 00 02 7a 01 15 00 00 00 01 00 02 7b 02 15 00 00 00 01 00 02 7c 05 15 00 00 00 01 00 02 7d 02 15 00 00 00 01 00 02 7e 08 15 00 00 00 01 00 02 7f 02 15 00 00 00 01 00 02 80 0c 15 00 00 00 01 00 02 81 02 15 00 00 00 01 00 02 82 0f 15 00 00 00 01 00 02 83 02 15 00 00 00 01 00 02 84 1c 15 00 00 00 01 00 02 85 02 15 00 00 00 01 00 02 86 28 15 00 00 00 01 00 02 87 02 15 00 00 00 01 00 02 88 3e 15 00 00 00 01 00 02 89 02 15 00 00 00 01 00 02 8a 54 15 00 00 00 01 00 02 8b 02 15 00 00 00 01 00 02 8c 7d 15 00 00 00 01 00 02 8d 02 15 00 00 00 01 00 02 8e a6 15 00 00 00 01 00 02 8f 02 15 00 00 00 01 00 02 90 a8 15 00 00 00 01 00 02 91 02 15 00 00 00 01 00 02 92 d3 15 00 00 00 01 00 02 93 03 15 00 00 00 01 00 02 94 05 15 00 00 00 01 00 02 95 03 15 00 00 00 01 00 02 96 27 15 00 00 00 01 00 02 97 03 15 00 00 00 01 00 02 98 4f 15 00 00 00 01 00 02 99 03 15 00 00 00 01 00 02 9a 68 15 00 00 00 01 00 02 9b 03 15 00 00 00 01 00 02 9c 87 15 00 00 00 01 00 02 9d 03 15 00 00 00 01 00 02 9e 91 15 00 00 00 01 00 02 9f 03 15 00 00 00 01 00 02 a0 9b 15 00 00 00 01 00 02 a2 03 15 00 00 00 01 00 02 a3 a7 15 00 00 00 01 00 02 a4 03 15 00 00 00 01 00 02 a5 b2 15 00 00 00 01 00 02 a6 03 15 00 00 00 01 00 02 a7 be 15 00 00 00 01 00 02 a9 03 15 00 00 00 01 00 02 aa c7 15 00 00 00 01 00 02 ab 03 15 00 00 00 01 00 02 ac cc 15 00 00 00 01 00 02 ad 03 15 00 00 00 01 00 02 ae ff 15 00 00 00 01 00 02 af 01 15 00 00 00 01 00 02 b0 f4 15 00 00 00 01 00 02 b1 01 15 00 00 00 01 00 02 b2 f6 15 00 00 00 01 00 02 b3 01 15 00 00 00 01 00 02 b4 fa 15 00 00 00 01 00 02 b5 01 15 00 00 00 01 00 02 b6 fe 15 00 00 00 01 00 02 b7 02 15 00 00 00 01 00 02 b8 01 15 00 00 00 01 00 02 b9 02 15 00 00 00 01 00 02 ba 05 15 00 00 00 01 00 02 bb 02 15 00 00 00 01 00 02 bc 08 15 00 00 00 01 00 02 bd 02 15 00 00 00 01 00 02 be 0c 15 00 00 00 01 00 02 bf 02 15 00 00 00 01 00 02 c0 0f 15 00 00 00 01 00 02 c1 02 15 00 00 00 01 00 02 c2 1c 15 00 00 00 01 00 02 c3 02 15 00 00 00 01 00 02 c4 28 15 00 00 00 01 00 02 c5 02 15 00 00 00 01 00 02 c6 3e 15 00 00 00 01 00 02 c7 02 15 00 00 00 01 00 02 c8 54 15 00 00 00 01 00 02 c9 02 15 00 00 00 01 00 02 ca 7d 15 00 00 00 01 00 02 cb 02 15 00 00 00 01 00 02 cc a6 15 00 00 00 01 00 02 cd 02 15 00 00 00 01 00 02 ce a8 15 00 00 00 01 00 02 cf 02 15 00 00 00 01 00 02 d0 d3 15 00 00 00 01 00 02 d1 03 15 00 00 00 01 00 02 d2 05 15 00 00 00 01 00 02 d3 03 15 00 00 00 01 00 02 d4 27 15 00 00 00 01 00 02 d5 03 15 00 00 00 01 00 02 d6 4f 15 00 00 00 01 00 02 d7 03 15 00 00 00 01 00 02 d8 68 15 00 00 00 01 00 02 d9 03 15 00 00 00 01 00 02 da 87 15 00 00 00 01 00 02 db 03 15 00 00 00 01 00 02 dc 91 15 00 00 00 01 00 02 dd 03 15 00 00 00 01 00 02 de 9b 15 00 00 00 01 00 02 df 03 15 00 00 00 01 00 02 e0 a7 15 00 00 00 01 00 02 e1 03 15 00 00 00 01 00 02 e2 b2 15 00 00 00 01 00 02 e3 03 15 00 00 00 01 00 02 e4 be 15 00 00 00 01 00 02 e5 03 15 00 00 00 01 00 02 e6 c7 15 00 00 00 01 00 02 e7 03 15 00 00 00 01 00 02 e8 cc 15 00 00 00 01 00 02 e9 03 15 00 00 00 01 00 02 ea ff 15 00 00 00 01 00 02 fb 01 15 01 00 00 01 00 02 ff 10];
        qcom,mdss-dsi-dispparam-papermode4-state = "dsi_hs_mode";
        qcom,mdss-dsi-dispparam-papermode5-command = [15 01 00 00 78 00 02 ff 20 15 00 00 00 01 00 02 fb 01 15 00 00 00 01 00 02 75 00 15 00 00 00 01 00 02 76 c8 15 00 00 00 01 00 02 77 00 15 00 00 00 01 00 02 78 d2 15 00 00 00 01 00 02 79 00 15 00 00 00 01 00 02 7a e5 15 00 00 00 01 00 02 7b 00 15 00 00 00 01 00 02 7c f6 15 00 00 00 01 00 02 7d 01 15 00 00 00 01 00 02 7e 06 15 00 00 00 01 00 02 7f 01 15 00 00 00 01 00 02 80 15 15 00 00 00 01 00 02 81 01 15 00 00 00 01 00 02 82 22 15 00 00 00 01 00 02 83 01 15 00 00 00 01 00 02 84 2f 15 00 00 00 01 00 02 85 01 15 00 00 00 01 00 02 86 3c 15 00 00 00 01 00 02 87 01 15 00 00 00 01 00 02 88 66 15 00 00 00 01 00 02 89 01 15 00 00 00 01 00 02 8a 89 15 00 00 00 01 00 02 8b 01 15 00 00 00 01 00 02 8c c2 15 00 00 00 01 00 02 8d 01 15 00 00 00 01 00 02 8e ee 15 00 00 00 01 00 02 8f 02 15 00 00 00 01 00 02 90 34 15 00 00 00 01 00 02 91 02 15 00 00 00 01 00 02 92 6d 15 00 00 00 01 00 02 93 02 15 00 00 00 01 00 02 94 6f 15 00 00 00 01 00 02 95 02 15 00 00 00 01 00 02 96 a6 15 00 00 00 01 00 02 97 02 15 00 00 00 01 00 02 98 e1 15 00 00 00 01 00 02 99 03 15 00 00 00 01 00 02 9a 04 15 00 00 00 01 00 02 9b 03 15 00 00 00 01 00 02 9c 33 15 00 00 00 01 00 02 9d 03 15 00 00 00 01 00 02 9e 4f 15 00 00 00 01 00 02 9f 03 15 00 00 00 01 00 02 a0 72 15 00 00 00 01 00 02 a2 03 15 00 00 00 01 00 02 a3 7c 15 00 00 00 01 00 02 a4 03 15 00 00 00 01 00 02 a5 88 15 00 00 00 01 00 02 a6 03 15 00 00 00 01 00 02 a7 95 15 00 00 00 01 00 02 a9 03 15 00 00 00 01 00 02 aa a3 15 00 00 00 01 00 02 ab 03 15 00 00 00 01 00 02 ac b4 15 00 00 00 01 00 02 ad 03 15 00 00 00 01 00 02 ae c3 15 00 00 00 01 00 02 af 03 15 00 00 00 01 00 02 b0 cd 15 00 00 00 01 00 02 b1 03 15 00 00 00 01 00 02 b2 ff 15 00 00 00 01 00 02 b3 00 15 00 00 00 01 00 02 b4 c8 15 00 00 00 01 00 02 b5 00 15 00 00 00 01 00 02 b6 d2 15 00 00 00 01 00 02 b7 00 15 00 00 00 01 00 02 b8 e5 15 00 00 00 01 00 02 b9 00 15 00 00 00 01 00 02 ba f6 15 00 00 00 01 00 02 bb 01 15 00 00 00 01 00 02 bc 06 15 00 00 00 01 00 02 bd 01 15 00 00 00 01 00 02 be 15 15 00 00 00 01 00 02 bf 01 15 00 00 00 01 00 02 c0 22 15 00 00 00 01 00 02 c1 01 15 00 00 00 01 00 02 c2 2f 15 00 00 00 01 00 02 c3 01 15 00 00 00 01 00 02 c4 3c 15 00 00 00 01 00 02 c5 01 15 00 00 00 01 00 02 c6 66 15 00 00 00 01 00 02 c7 01 15 00 00 00 01 00 02 c8 89 15 00 00 00 01 00 02 c9 01 15 00 00 00 01 00 02 ca c2 15 00 00 00 01 00 02 cb 01 15 00 00 00 01 00 02 cc ee 15 00 00 00 01 00 02 cd 02 15 00 00 00 01 00 02 ce 34 15 00 00 00 01 00 02 cf 02 15 00 00 00 01 00 02 d0 6d 15 00 00 00 01 00 02 d1 02 15 00 00 00 01 00 02 d2 6f 15 00 00 00 01 00 02 d3 02 15 00 00 00 01 00 02 d4 a6 15 00 00 00 01 00 02 d5 02 15 00 00 00 01 00 02 d6 e1 15 00 00 00 01 00 02 d7 03 15 00 00 00 01 00 02 d8 04 15 00 00 00 01 00 02 d9 03 15 00 00 00 01 00 02 da 33 15 00 00 00 01 00 02 db 03 15 00 00 00 01 00 02 dc 4f 15 00 00 00 01 00 02 dd 03 15 00 00 00 01 00 02 de 72 15 00 00 00 01 00 02 df 03 15 00 00 00 01 00 02 e0 7c 15 00 00 00 01 00 02 e1 03 15 00 00 00 01 00 02 e2 88 15 00 00 00 01 00 02 e3 03 15 00 00 00 01 00 02 e4 95 15 00 00 00 01 00 02 e5 03 15 00 00 00 01 00 02 e6 a3 15 00 00 00 01 00 02 e7 03 15 00 00 00 01 00 02 e8 b4 15 00 00 00 01 00 02 e9 03 15 00 00 00 01 00 02 ea c3 15 00 00 00 01 00 02 eb 03 15 00 00 00 01 00 02 ec cd 15 00 00 00 01 00 02 ed 03 15 00 00 00 01 00 02 ee ff 15 00 00 00 01 00 02 ef 00 15 00 00 00 01 00 02 f0 c8 15 00 00 00 01 00 02 f1 00 15 00 00 00 01 00 02 f2 d3 15 00 00 00 01 00 02 f3 00 15 00 00 00 01 00 02 f4 e6 15 00 00 00 01 00 02 f5 00 15 00 00 00 01 00 02 f6 f8 15 00 00 00 01 00 02 f7 01 15 00 00 00 01 00 02 f8 09 15 00 00 00 01 00 02 f9 01 15 00 00 00 01 00 02 fa 18 15 00 00 00 01 00 02 ff 21 15 00 00 00 01 00 02 fb 01 15 00 00 00 01 00 02 00 01 15 00 00 00 01 00 02 01 26 15 00 00 00 01 00 02 02 01 15 00 00 00 01 00 02 03 33 15 00 00 00 01 00 02 04 01 15 00 00 00 01 00 02 05 3f 15 00 00 00 01 00 02 06 01 15 00 00 00 01 00 02 07 6b 15 00 00 00 01 00 02 08 01 15 00 00 00 01 00 02 09 8e 15 00 00 00 01 00 02 0a 01 15 00 00 00 01 00 02 0b c7 15 00 00 00 01 00 02 0c 01 15 00 00 00 01 00 02 0d f2 15 00 00 00 01 00 02 0e 02 15 00 00 00 01 00 02 0f 37 15 00 00 00 01 00 02 10 02 15 00 00 00 01 00 02 11 70 15 00 00 00 01 00 02 12 02 15 00 00 00 01 00 02 13 72 15 00 00 00 01 00 02 14 02 15 00 00 00 01 00 02 15 a8 15 00 00 00 01 00 02 16 02 15 00 00 00 01 00 02 17 e3 15 00 00 00 01 00 02 18 03 15 00 00 00 01 00 02 19 05 15 00 00 00 01 00 02 1a 03 15 00 00 00 01 00 02 1b 34 15 00 00 00 01 00 02 1c 03 15 00 00 00 01 00 02 1d 50 15 00 00 00 01 00 02 1e 03 15 00 00 00 01 00 02 1f 73 15 00 00 00 01 00 02 20 03 15 00 00 00 01 00 02 21 7d 15 00 00 00 01 00 02 22 03 15 00 00 00 01 00 02 23 89 15 00 00 00 01 00 02 24 03 15 00 00 00 01 00 02 25 96 15 00 00 00 01 00 02 26 03 15 00 00 00 01 00 02 27 a5 15 00 00 00 01 00 02 28 03 15 00 00 00 01 00 02 29 b5 15 00 00 00 01 00 02 2a 03 15 00 00 00 01 00 02 2b c3 15 00 00 00 01 00 02 2d 03 15 00 00 00 01 00 02 2f cc 15 00 00 00 01 00 02 30 03 15 00 00 00 01 00 02 31 ff 15 00 00 00 01 00 02 32 00 15 00 00 00 01 00 02 33 c8 15 00 00 00 01 00 02 34 00 15 00 00 00 01 00 02 35 d3 15 00 00 00 01 00 02 36 00 15 00 00 00 01 00 02 37 e6 15 00 00 00 01 00 02 38 00 15 00 00 00 01 00 02 39 f8 15 00 00 00 01 00 02 3a 01 15 00 00 00 01 00 02 3b 09 15 00 00 00 01 00 02 3d 01 15 00 00 00 01 00 02 3f 18 15 00 00 00 01 00 02 40 01 15 00 00 00 01 00 02 41 26 15 00 00 00 01 00 02 42 01 15 00 00 00 01 00 02 43 33 15 00 00 00 01 00 02 44 01 15 00 00 00 01 00 02 45 3f 15 00 00 00 01 00 02 46 01 15 00 00 00 01 00 02 47 6b 15 00 00 00 01 00 02 48 01 15 00 00 00 01 00 02 49 8e 15 00 00 00 01 00 02 4a 01 15 00 00 00 01 00 02 4b c7 15 00 00 00 01 00 02 4c 01 15 00 00 00 01 00 02 4d f2 15 00 00 00 01 00 02 4e 02 15 00 00 00 01 00 02 4f 37 15 00 00 00 01 00 02 50 02 15 00 00 00 01 00 02 51 70 15 00 00 00 01 00 02 52 02 15 00 00 00 01 00 02 53 72 15 00 00 00 01 00 02 54 02 15 00 00 00 01 00 02 55 a8 15 00 00 00 01 00 02 56 02 15 00 00 00 01 00 02 58 e3 15 00 00 00 01 00 02 59 03 15 00 00 00 01 00 02 5a 05 15 00 00 00 01 00 02 5b 03 15 00 00 00 01 00 02 5c 34 15 00 00 00 01 00 02 5d 03 15 00 00 00 01 00 02 5e 50 15 00 00 00 01 00 02 5f 03 15 00 00 00 01 00 02 60 73 15 00 00 00 01 00 02 61 03 15 00 00 00 01 00 02 62 7d 15 00 00 00 01 00 02 63 03 15 00 00 00 01 00 02 64 89 15 00 00 00 01 00 02 65 03 15 00 00 00 01 00 02 66 96 15 00 00 00 01 00 02 67 03 15 00 00 00 01 00 02 68 a5 15 00 00 00 01 00 02 69 03 15 00 00 00 01 00 02 6a b5 15 00 00 00 01 00 02 6b 03 15 00 00 00 01 00 02 6c c3 15 00 00 00 01 00 02 6d 03 15 00 00 00 01 00 02 6e cc 15 00 00 00 01 00 02 6f 03 15 00 00 00 01 00 02 70 ff 15 00 00 00 01 00 02 71 02 15 00 00 00 01 00 02 72 0c 15 00 00 00 01 00 02 73 02 15 00 00 00 01 00 02 74 0e 15 00 00 00 01 00 02 75 02 15 00 00 00 01 00 02 76 11 15 00 00 00 01 00 02 77 02 15 00 00 00 01 00 02 78 14 15 00 00 00 01 00 02 79 02 15 00 00 00 01 00 02 7a 17 15 00 00 00 01 00 02 7b 02 15 00 00 00 01 00 02 7c 1a 15 00 00 00 01 00 02 7d 02 15 00 00 00 01 00 02 7e 1d 15 00 00 00 01 00 02 7f 02 15 00 00 00 01 00 02 80 20 15 00 00 00 01 00 02 81 02 15 00 00 00 01 00 02 82 22 15 00 00 00 01 00 02 83 02 15 00 00 00 01 00 02 84 2e 15 00 00 00 01 00 02 85 02 15 00 00 00 01 00 02 86 38 15 00 00 00 01 00 02 87 02 15 00 00 00 01 00 02 88 4d 15 00 00 00 01 00 02 89 02 15 00 00 00 01 00 02 8a 61 15 00 00 00 01 00 02 8b 02 15 00 00 00 01 00 02 8c 88 15 00 00 00 01 00 02 8d 02 15 00 00 00 01 00 02 8e af 15 00 00 00 01 00 02 8f 02 15 00 00 00 01 00 02 90 b0 15 00 00 00 01 00 02 91 02 15 00 00 00 01 00 02 92 da 15 00 00 00 01 00 02 93 03 15 00 00 00 01 00 02 94 0b 15 00 00 00 01 00 02 95 03 15 00 00 00 01 00 02 96 2d 15 00 00 00 01 00 02 97 03 15 00 00 00 01 00 02 98 54 15 00 00 00 01 00 02 99 03 15 00 00 00 01 00 02 9a 6c 15 00 00 00 01 00 02 9b 03 15 00 00 00 01 00 02 9c 8b 15 00 00 00 01 00 02 9d 03 15 00 00 00 01 00 02 9e 94 15 00 00 00 01 00 02 9f 03 15 00 00 00 01 00 02 a0 9e 15 00 00 00 01 00 02 a2 03 15 00 00 00 01 00 02 a3 a9 15 00 00 00 01 00 02 a4 03 15 00 00 00 01 00 02 a5 b5 15 00 00 00 01 00 02 a6 03 15 00 00 00 01 00 02 a7 bf 15 00 00 00 01 00 02 a9 03 15 00 00 00 01 00 02 aa c8 15 00 00 00 01 00 02 ab 03 15 00 00 00 01 00 02 ac ee 15 00 00 00 01 00 02 ad 03 15 00 00 00 01 00 02 ae ff 15 00 00 00 01 00 02 af 02 15 00 00 00 01 00 02 b0 0c 15 00 00 00 01 00 02 b1 02 15 00 00 00 01 00 02 b2 0e 15 00 00 00 01 00 02 b3 02 15 00 00 00 01 00 02 b4 11 15 00 00 00 01 00 02 b5 02 15 00 00 00 01 00 02 b6 14 15 00 00 00 01 00 02 b7 02 15 00 00 00 01 00 02 b8 17 15 00 00 00 01 00 02 b9 02 15 00 00 00 01 00 02 ba 1a 15 00 00 00 01 00 02 bb 02 15 00 00 00 01 00 02 bc 1d 15 00 00 00 01 00 02 bd 02 15 00 00 00 01 00 02 be 20 15 00 00 00 01 00 02 bf 02 15 00 00 00 01 00 02 c0 22 15 00 00 00 01 00 02 c1 02 15 00 00 00 01 00 02 c2 2e 15 00 00 00 01 00 02 c3 02 15 00 00 00 01 00 02 c4 38 15 00 00 00 01 00 02 c5 02 15 00 00 00 01 00 02 c6 4d 15 00 00 00 01 00 02 c7 02 15 00 00 00 01 00 02 c8 61 15 00 00 00 01 00 02 c9 02 15 00 00 00 01 00 02 ca 88 15 00 00 00 01 00 02 cb 02 15 00 00 00 01 00 02 cc af 15 00 00 00 01 00 02 cd 02 15 00 00 00 01 00 02 ce b0 15 00 00 00 01 00 02 cf 02 15 00 00 00 01 00 02 d0 da 15 00 00 00 01 00 02 d1 03 15 00 00 00 01 00 02 d2 0b 15 00 00 00 01 00 02 d3 03 15 00 00 00 01 00 02 d4 2d 15 00 00 00 01 00 02 d5 03 15 00 00 00 01 00 02 d6 54 15 00 00 00 01 00 02 d7 03 15 00 00 00 01 00 02 d8 6c 15 00 00 00 01 00 02 d9 03 15 00 00 00 01 00 02 da 8b 15 00 00 00 01 00 02 db 03 15 00 00 00 01 00 02 dc 94 15 00 00 00 01 00 02 dd 03 15 00 00 00 01 00 02 de 9e 15 00 00 00 01 00 02 df 03 15 00 00 00 01 00 02 e0 a9 15 00 00 00 01 00 02 e1 03 15 00 00 00 01 00 02 e2 b5 15 00 00 00 01 00 02 e3 03 15 00 00 00 01 00 02 e4 bf 15 00 00 00 01 00 02 e5 03 15 00 00 00 01 00 02 e6 c8 15 00 00 00 01 00 02 e7 03 15 00 00 00 01 00 02 e8 ee 15 00 00 00 01 00 02 e9 03 15 00 00 00 01 00 02 ea ff 15 00 00 00 01 00 02 fb 01 15 01 00 00 01 00 02 ff 10];
        qcom,mdss-dsi-dispparam-papermode5-state = "dsi_hs_mode";
        qcom,mdss-dsi-dispparam-papermode6-command = [15 01 00 00 78 00 02 ff 20 15 00 00 00 01 00 02 fb 01 15 00 00 00 01 00 02 75 00 15 00 00 00 01 00 02 76 c8 15 00 00 00 01 00 02 77 00 15 00 00 00 01 00 02 78 d2 15 00 00 00 01 00 02 79 00 15 00 00 00 01 00 02 7a e5 15 00 00 00 01 00 02 7b 00 15 00 00 00 01 00 02 7c f6 15 00 00 00 01 00 02 7d 01 15 00 00 00 01 00 02 7e 06 15 00 00 00 01 00 02 7f 01 15 00 00 00 01 00 02 80 15 15 00 00 00 01 00 02 81 01 15 00 00 00 01 00 02 82 22 15 00 00 00 01 00 02 83 01 15 00 00 00 01 00 02 84 2f 15 00 00 00 01 00 02 85 01 15 00 00 00 01 00 02 86 3c 15 00 00 00 01 00 02 87 01 15 00 00 00 01 00 02 88 66 15 00 00 00 01 00 02 89 01 15 00 00 00 01 00 02 8a 89 15 00 00 00 01 00 02 8b 01 15 00 00 00 01 00 02 8c c2 15 00 00 00 01 00 02 8d 01 15 00 00 00 01 00 02 8e ee 15 00 00 00 01 00 02 8f 02 15 00 00 00 01 00 02 90 34 15 00 00 00 01 00 02 91 02 15 00 00 00 01 00 02 92 6d 15 00 00 00 01 00 02 93 02 15 00 00 00 01 00 02 94 6f 15 00 00 00 01 00 02 95 02 15 00 00 00 01 00 02 96 a6 15 00 00 00 01 00 02 97 02 15 00 00 00 01 00 02 98 e1 15 00 00 00 01 00 02 99 03 15 00 00 00 01 00 02 9a 04 15 00 00 00 01 00 02 9b 03 15 00 00 00 01 00 02 9c 33 15 00 00 00 01 00 02 9d 03 15 00 00 00 01 00 02 9e 4f 15 00 00 00 01 00 02 9f 03 15 00 00 00 01 00 02 a0 72 15 00 00 00 01 00 02 a2 03 15 00 00 00 01 00 02 a3 7c 15 00 00 00 01 00 02 a4 03 15 00 00 00 01 00 02 a5 88 15 00 00 00 01 00 02 a6 03 15 00 00 00 01 00 02 a7 95 15 00 00 00 01 00 02 a9 03 15 00 00 00 01 00 02 aa a3 15 00 00 00 01 00 02 ab 03 15 00 00 00 01 00 02 ac b4 15 00 00 00 01 00 02 ad 03 15 00 00 00 01 00 02 ae c3 15 00 00 00 01 00 02 af 03 15 00 00 00 01 00 02 b0 cd 15 00 00 00 01 00 02 b1 03 15 00 00 00 01 00 02 b2 ff 15 00 00 00 01 00 02 b3 00 15 00 00 00 01 00 02 b4 c8 15 00 00 00 01 00 02 b5 00 15 00 00 00 01 00 02 b6 d2 15 00 00 00 01 00 02 b7 00 15 00 00 00 01 00 02 b8 e5 15 00 00 00 01 00 02 b9 00 15 00 00 00 01 00 02 ba f6 15 00 00 00 01 00 02 bb 01 15 00 00 00 01 00 02 bc 06 15 00 00 00 01 00 02 bd 01 15 00 00 00 01 00 02 be 15 15 00 00 00 01 00 02 bf 01 15 00 00 00 01 00 02 c0 22 15 00 00 00 01 00 02 c1 01 15 00 00 00 01 00 02 c2 2f 15 00 00 00 01 00 02 c3 01 15 00 00 00 01 00 02 c4 3c 15 00 00 00 01 00 02 c5 01 15 00 00 00 01 00 02 c6 66 15 00 00 00 01 00 02 c7 01 15 00 00 00 01 00 02 c8 89 15 00 00 00 01 00 02 c9 01 15 00 00 00 01 00 02 ca c2 15 00 00 00 01 00 02 cb 01 15 00 00 00 01 00 02 cc ee 15 00 00 00 01 00 02 cd 02 15 00 00 00 01 00 02 ce 34 15 00 00 00 01 00 02 cf 02 15 00 00 00 01 00 02 d0 6d 15 00 00 00 01 00 02 d1 02 15 00 00 00 01 00 02 d2 6f 15 00 00 00 01 00 02 d3 02 15 00 00 00 01 00 02 d4 a6 15 00 00 00 01 00 02 d5 02 15 00 00 00 01 00 02 d6 e1 15 00 00 00 01 00 02 d7 03 15 00 00 00 01 00 02 d8 04 15 00 00 00 01 00 02 d9 03 15 00 00 00 01 00 02 da 33 15 00 00 00 01 00 02 db 03 15 00 00 00 01 00 02 dc 4f 15 00 00 00 01 00 02 dd 03 15 00 00 00 01 00 02 de 72 15 00 00 00 01 00 02 df 03 15 00 00 00 01 00 02 e0 7c 15 00 00 00 01 00 02 e1 03 15 00 00 00 01 00 02 e2 88 15 00 00 00 01 00 02 e3 03 15 00 00 00 01 00 02 e4 95 15 00 00 00 01 00 02 e5 03 15 00 00 00 01 00 02 e6 a3 15 00 00 00 01 00 02 e7 03 15 00 00 00 01 00 02 e8 b4 15 00 00 00 01 00 02 e9 03 15 00 00 00 01 00 02 ea c3 15 00 00 00 01 00 02 eb 03 15 00 00 00 01 00 02 ec cd 15 00 00 00 01 00 02 ed 03 15 00 00 00 01 00 02 ee ff 15 00 00 00 01 00 02 ef 00 15 00 00 00 01 00 02 f0 c8 15 00 00 00 01 00 02 f1 00 15 00 00 00 01 00 02 f2 d3 15 00 00 00 01 00 02 f3 00 15 00 00 00 01 00 02 f4 e6 15 00 00 00 01 00 02 f5 00 15 00 00 00 01 00 02 f6 f8 15 00 00 00 01 00 02 f7 01 15 00 00 00 01 00 02 f8 09 15 00 00 00 01 00 02 f9 01 15 00 00 00 01 00 02 fa 18 15 00 00 00 01 00 02 ff 21 15 00 00 00 01 00 02 fb 01 15 00 00 00 01 00 02 00 01 15 00 00 00 01 00 02 01 26 15 00 00 00 01 00 02 02 01 15 00 00 00 01 00 02 03 33 15 00 00 00 01 00 02 04 01 15 00 00 00 01 00 02 05 3f 15 00 00 00 01 00 02 06 01 15 00 00 00 01 00 02 07 6b 15 00 00 00 01 00 02 08 01 15 00 00 00 01 00 02 09 8e 15 00 00 00 01 00 02 0a 01 15 00 00 00 01 00 02 0b c7 15 00 00 00 01 00 02 0c 01 15 00 00 00 01 00 02 0d f2 15 00 00 00 01 00 02 0e 02 15 00 00 00 01 00 02 0f 37 15 00 00 00 01 00 02 10 02 15 00 00 00 01 00 02 11 70 15 00 00 00 01 00 02 12 02 15 00 00 00 01 00 02 13 72 15 00 00 00 01 00 02 14 02 15 00 00 00 01 00 02 15 a8 15 00 00 00 01 00 02 16 02 15 00 00 00 01 00 02 17 e3 15 00 00 00 01 00 02 18 03 15 00 00 00 01 00 02 19 05 15 00 00 00 01 00 02 1a 03 15 00 00 00 01 00 02 1b 34 15 00 00 00 01 00 02 1c 03 15 00 00 00 01 00 02 1d 50 15 00 00 00 01 00 02 1e 03 15 00 00 00 01 00 02 1f 73 15 00 00 00 01 00 02 20 03 15 00 00 00 01 00 02 21 7d 15 00 00 00 01 00 02 22 03 15 00 00 00 01 00 02 23 89 15 00 00 00 01 00 02 24 03 15 00 00 00 01 00 02 25 96 15 00 00 00 01 00 02 26 03 15 00 00 00 01 00 02 27 a5 15 00 00 00 01 00 02 28 03 15 00 00 00 01 00 02 29 b5 15 00 00 00 01 00 02 2a 03 15 00 00 00 01 00 02 2b c3 15 00 00 00 01 00 02 2d 03 15 00 00 00 01 00 02 2f cc 15 00 00 00 01 00 02 30 03 15 00 00 00 01 00 02 31 ff 15 00 00 00 01 00 02 32 00 15 00 00 00 01 00 02 33 c8 15 00 00 00 01 00 02 34 00 15 00 00 00 01 00 02 35 d3 15 00 00 00 01 00 02 36 00 15 00 00 00 01 00 02 37 e6 15 00 00 00 01 00 02 38 00 15 00 00 00 01 00 02 39 f8 15 00 00 00 01 00 02 3a 01 15 00 00 00 01 00 02 3b 09 15 00 00 00 01 00 02 3d 01 15 00 00 00 01 00 02 3f 18 15 00 00 00 01 00 02 40 01 15 00 00 00 01 00 02 41 26 15 00 00 00 01 00 02 42 01 15 00 00 00 01 00 02 43 33 15 00 00 00 01 00 02 44 01 15 00 00 00 01 00 02 45 3f 15 00 00 00 01 00 02 46 01 15 00 00 00 01 00 02 47 6b 15 00 00 00 01 00 02 48 01 15 00 00 00 01 00 02 49 8e 15 00 00 00 01 00 02 4a 01 15 00 00 00 01 00 02 4b c7 15 00 00 00 01 00 02 4c 01 15 00 00 00 01 00 02 4d f2 15 00 00 00 01 00 02 4e 02 15 00 00 00 01 00 02 4f 37 15 00 00 00 01 00 02 50 02 15 00 00 00 01 00 02 51 70 15 00 00 00 01 00 02 52 02 15 00 00 00 01 00 02 53 72 15 00 00 00 01 00 02 54 02 15 00 00 00 01 00 02 55 a8 15 00 00 00 01 00 02 56 02 15 00 00 00 01 00 02 58 e3 15 00 00 00 01 00 02 59 03 15 00 00 00 01 00 02 5a 05 15 00 00 00 01 00 02 5b 03 15 00 00 00 01 00 02 5c 34 15 00 00 00 01 00 02 5d 03 15 00 00 00 01 00 02 5e 50 15 00 00 00 01 00 02 5f 03 15 00 00 00 01 00 02 60 73 15 00 00 00 01 00 02 61 03 15 00 00 00 01 00 02 62 7d 15 00 00 00 01 00 02 63 03 15 00 00 00 01 00 02 64 89 15 00 00 00 01 00 02 65 03 15 00 00 00 01 00 02 66 96 15 00 00 00 01 00 02 67 03 15 00 00 00 01 00 02 68 a5 15 00 00 00 01 00 02 69 03 15 00 00 00 01 00 02 6a b5 15 00 00 00 01 00 02 6b 03 15 00 00 00 01 00 02 6c c3 15 00 00 00 01 00 02 6d 03 15 00 00 00 01 00 02 6e cc 15 00 00 00 01 00 02 6f 03 15 00 00 00 01 00 02 70 ff 15 00 00 00 01 00 02 71 02 15 00 00 00 01 00 02 72 26 15 00 00 00 01 00 02 73 02 15 00 00 00 01 00 02 74 27 15 00 00 00 01 00 02 75 02 15 00 00 00 01 00 02 76 2a 15 00 00 00 01 00 02 77 02 15 00 00 00 01 00 02 78 2c 15 00 00 00 01 00 02 79 02 15 00 00 00 01 00 02 7a 2f 15 00 00 00 01 00 02 7b 02 15 00 00 00 01 00 02 7c 32 15 00 00 00 01 00 02 7d 02 15 00 00 00 01 00 02 7e 34 15 00 00 00 01 00 02 7f 02 15 00 00 00 01 00 02 80 37 15 00 00 00 01 00 02 81 02 15 00 00 00 01 00 02 82 39 15 00 00 00 01 00 02 83 02 15 00 00 00 01 00 02 84 43 15 00 00 00 01 00 02 85 02 15 00 00 00 01 00 02 86 4c 15 00 00 00 01 00 02 87 02 15 00 00 00 01 00 02 88 5f 15 00 00 00 01 00 02 89 02 15 00 00 00 01 00 02 8a 71 15 00 00 00 01 00 02 8b 02 15 00 00 00 01 00 02 8c 95 15 00 00 00 01 00 02 8d 02 15 00 00 00 01 00 02 8e ba 15 00 00 00 01 00 02 8f 02 15 00 00 00 01 00 02 90 bb 15 00 00 00 01 00 02 91 02 15 00 00 00 01 00 02 92 e3 15 00 00 00 01 00 02 93 03 15 00 00 00 01 00 02 94 12 15 00 00 00 01 00 02 95 03 15 00 00 00 01 00 02 96 34 15 00 00 00 01 00 02 97 03 15 00 00 00 01 00 02 98 5a 15 00 00 00 01 00 02 99 03 15 00 00 00 01 00 02 9a 72 15 00 00 00 01 00 02 9b 03 15 00 00 00 01 00 02 9c 90 15 00 00 00 01 00 02 9d 03 15 00 00 00 01 00 02 9e 99 15 00 00 00 01 00 02 9f 03 15 00 00 00 01 00 02 a0 a2 15 00 00 00 01 00 02 a2 03 15 00 00 00 01 00 02 a3 ad 15 00 00 00 01 00 02 a4 03 15 00 00 00 01 00 02 a5 b7 15 00 00 00 01 00 02 a6 03 15 00 00 00 01 00 02 a7 c1 15 00 00 00 01 00 02 a9 03 15 00 00 00 01 00 02 aa c9 15 00 00 00 01 00 02 ab 03 15 00 00 00 01 00 02 ac f0 15 00 00 00 01 00 02 ad 03 15 00 00 00 01 00 02 ae ff 15 00 00 00 01 00 02 af 02 15 00 00 00 01 00 02 b0 26 15 00 00 00 01 00 02 b1 02 15 00 00 00 01 00 02 b2 27 15 00 00 00 01 00 02 b3 02 15 00 00 00 01 00 02 b4 2a 15 00 00 00 01 00 02 b5 02 15 00 00 00 01 00 02 b6 2c 15 00 00 00 01 00 02 b7 02 15 00 00 00 01 00 02 b8 2f 15 00 00 00 01 00 02 b9 02 15 00 00 00 01 00 02 ba 32 15 00 00 00 01 00 02 bb 02 15 00 00 00 01 00 02 bc 34 15 00 00 00 01 00 02 bd 02 15 00 00 00 01 00 02 be 37 15 00 00 00 01 00 02 bf 02 15 00 00 00 01 00 02 c0 39 15 00 00 00 01 00 02 c1 02 15 00 00 00 01 00 02 c2 43 15 00 00 00 01 00 02 c3 02 15 00 00 00 01 00 02 c4 4c 15 00 00 00 01 00 02 c5 02 15 00 00 00 01 00 02 c6 5f 15 00 00 00 01 00 02 c7 02 15 00 00 00 01 00 02 c8 71 15 00 00 00 01 00 02 c9 02 15 00 00 00 01 00 02 ca 95 15 00 00 00 01 00 02 cb 02 15 00 00 00 01 00 02 cc ba 15 00 00 00 01 00 02 cd 02 15 00 00 00 01 00 02 ce bb 15 00 00 00 01 00 02 cf 02 15 00 00 00 01 00 02 d0 e3 15 00 00 00 01 00 02 d1 03 15 00 00 00 01 00 02 d2 12 15 00 00 00 01 00 02 d3 03 15 00 00 00 01 00 02 d4 34 15 00 00 00 01 00 02 d5 03 15 00 00 00 01 00 02 d6 5a 15 00 00 00 01 00 02 d7 03 15 00 00 00 01 00 02 d8 72 15 00 00 00 01 00 02 d9 03 15 00 00 00 01 00 02 da 90 15 00 00 00 01 00 02 db 03 15 00 00 00 01 00 02 dc 99 15 00 00 00 01 00 02 dd 03 15 00 00 00 01 00 02 de a2 15 00 00 00 01 00 02 df 03 15 00 00 00 01 00 02 e0 ad 15 00 00 00 01 00 02 e1 03 15 00 00 00 01 00 02 e2 b7 15 00 00 00 01 00 02 e3 03 15 00 00 00 01 00 02 e4 c1 15 00 00 00 01 00 02 e5 03 15 00 00 00 01 00 02 e6 c9 15 00 00 00 01 00 02 e7 03 15 00 00 00 01 00 02 e8 f0 15 00 00 00 01 00 02 e9 03 15 00 00 00 01 00 02 ea ff 15 00 00 00 01 00 02 fb 01 15 01 00 00 01 00 02 ff 10];
        qcom,mdss-dsi-dispparam-papermode6-state = "dsi_hs_mode";
        qcom,mdss-dsi-dispparam-papermode7-command = [15 01 00 00 78 00 02 ff 20 15 00 00 00 01 00 02 fb 01 15 00 00 00 01 00 02 75 00 15 00 00 00 01 00 02 76 c8 15 00 00 00 01 00 02 77 00 15 00 00 00 01 00 02 78 d2 15 00 00 00 01 00 02 79 00 15 00 00 00 01 00 02 7a e5 15 00 00 00 01 00 02 7b 00 15 00 00 00 01 00 02 7c f6 15 00 00 00 01 00 02 7d 01 15 00 00 00 01 00 02 7e 06 15 00 00 00 01 00 02 7f 01 15 00 00 00 01 00 02 80 15 15 00 00 00 01 00 02 81 01 15 00 00 00 01 00 02 82 22 15 00 00 00 01 00 02 83 01 15 00 00 00 01 00 02 84 2f 15 00 00 00 01 00 02 85 01 15 00 00 00 01 00 02 86 3c 15 00 00 00 01 00 02 87 01 15 00 00 00 01 00 02 88 66 15 00 00 00 01 00 02 89 01 15 00 00 00 01 00 02 8a 89 15 00 00 00 01 00 02 8b 01 15 00 00 00 01 00 02 8c c2 15 00 00 00 01 00 02 8d 01 15 00 00 00 01 00 02 8e ee 15 00 00 00 01 00 02 8f 02 15 00 00 00 01 00 02 90 34 15 00 00 00 01 00 02 91 02 15 00 00 00 01 00 02 92 6d 15 00 00 00 01 00 02 93 02 15 00 00 00 01 00 02 94 6f 15 00 00 00 01 00 02 95 02 15 00 00 00 01 00 02 96 a6 15 00 00 00 01 00 02 97 02 15 00 00 00 01 00 02 98 e1 15 00 00 00 01 00 02 99 03 15 00 00 00 01 00 02 9a 04 15 00 00 00 01 00 02 9b 03 15 00 00 00 01 00 02 9c 33 15 00 00 00 01 00 02 9d 03 15 00 00 00 01 00 02 9e 4f 15 00 00 00 01 00 02 9f 03 15 00 00 00 01 00 02 a0 72 15 00 00 00 01 00 02 a2 03 15 00 00 00 01 00 02 a3 7c 15 00 00 00 01 00 02 a4 03 15 00 00 00 01 00 02 a5 88 15 00 00 00 01 00 02 a6 03 15 00 00 00 01 00 02 a7 95 15 00 00 00 01 00 02 a9 03 15 00 00 00 01 00 02 aa a3 15 00 00 00 01 00 02 ab 03 15 00 00 00 01 00 02 ac b4 15 00 00 00 01 00 02 ad 03 15 00 00 00 01 00 02 ae c3 15 00 00 00 01 00 02 af 03 15 00 00 00 01 00 02 b0 cd 15 00 00 00 01 00 02 b1 03 15 00 00 00 01 00 02 b2 ff 15 00 00 00 01 00 02 b3 00 15 00 00 00 01 00 02 b4 c8 15 00 00 00 01 00 02 b5 00 15 00 00 00 01 00 02 b6 d2 15 00 00 00 01 00 02 b7 00 15 00 00 00 01 00 02 b8 e5 15 00 00 00 01 00 02 b9 00 15 00 00 00 01 00 02 ba f6 15 00 00 00 01 00 02 bb 01 15 00 00 00 01 00 02 bc 06 15 00 00 00 01 00 02 bd 01 15 00 00 00 01 00 02 be 15 15 00 00 00 01 00 02 bf 01 15 00 00 00 01 00 02 c0 22 15 00 00 00 01 00 02 c1 01 15 00 00 00 01 00 02 c2 2f 15 00 00 00 01 00 02 c3 01 15 00 00 00 01 00 02 c4 3c 15 00 00 00 01 00 02 c5 01 15 00 00 00 01 00 02 c6 66 15 00 00 00 01 00 02 c7 01 15 00 00 00 01 00 02 c8 89 15 00 00 00 01 00 02 c9 01 15 00 00 00 01 00 02 ca c2 15 00 00 00 01 00 02 cb 01 15 00 00 00 01 00 02 cc ee 15 00 00 00 01 00 02 cd 02 15 00 00 00 01 00 02 ce 34 15 00 00 00 01 00 02 cf 02 15 00 00 00 01 00 02 d0 6d 15 00 00 00 01 00 02 d1 02 15 00 00 00 01 00 02 d2 6f 15 00 00 00 01 00 02 d3 02 15 00 00 00 01 00 02 d4 a6 15 00 00 00 01 00 02 d5 02 15 00 00 00 01 00 02 d6 e1 15 00 00 00 01 00 02 d7 03 15 00 00 00 01 00 02 d8 04 15 00 00 00 01 00 02 d9 03 15 00 00 00 01 00 02 da 33 15 00 00 00 01 00 02 db 03 15 00 00 00 01 00 02 dc 4f 15 00 00 00 01 00 02 dd 03 15 00 00 00 01 00 02 de 72 15 00 00 00 01 00 02 df 03 15 00 00 00 01 00 02 e0 7c 15 00 00 00 01 00 02 e1 03 15 00 00 00 01 00 02 e2 88 15 00 00 00 01 00 02 e3 03 15 00 00 00 01 00 02 e4 95 15 00 00 00 01 00 02 e5 03 15 00 00 00 01 00 02 e6 a3 15 00 00 00 01 00 02 e7 03 15 00 00 00 01 00 02 e8 b4 15 00 00 00 01 00 02 e9 03 15 00 00 00 01 00 02 ea c3 15 00 00 00 01 00 02 eb 03 15 00 00 00 01 00 02 ec cd 15 00 00 00 01 00 02 ed 03 15 00 00 00 01 00 02 ee ff 15 00 00 00 01 00 02 ef 00 15 00 00 00 01 00 02 f0 c8 15 00 00 00 01 00 02 f1 00 15 00 00 00 01 00 02 f2 d3 15 00 00 00 01 00 02 f3 00 15 00 00 00 01 00 02 f4 e6 15 00 00 00 01 00 02 f5 00 15 00 00 00 01 00 02 f6 f8 15 00 00 00 01 00 02 f7 01 15 00 00 00 01 00 02 f8 09 15 00 00 00 01 00 02 f9 01 15 00 00 00 01 00 02 fa 18 15 00 00 00 01 00 02 ff 21 15 00 00 00 01 00 02 fb 01 15 00 00 00 01 00 02 00 01 15 00 00 00 01 00 02 01 26 15 00 00 00 01 00 02 02 01 15 00 00 00 01 00 02 03 33 15 00 00 00 01 00 02 04 01 15 00 00 00 01 00 02 05 3f 15 00 00 00 01 00 02 06 01 15 00 00 00 01 00 02 07 6b 15 00 00 00 01 00 02 08 01 15 00 00 00 01 00 02 09 8e 15 00 00 00 01 00 02 0a 01 15 00 00 00 01 00 02 0b c7 15 00 00 00 01 00 02 0c 01 15 00 00 00 01 00 02 0d f2 15 00 00 00 01 00 02 0e 02 15 00 00 00 01 00 02 0f 37 15 00 00 00 01 00 02 10 02 15 00 00 00 01 00 02 11 70 15 00 00 00 01 00 02 12 02 15 00 00 00 01 00 02 13 72 15 00 00 00 01 00 02 14 02 15 00 00 00 01 00 02 15 a8 15 00 00 00 01 00 02 16 02 15 00 00 00 01 00 02 17 e3 15 00 00 00 01 00 02 18 03 15 00 00 00 01 00 02 19 05 15 00 00 00 01 00 02 1a 03 15 00 00 00 01 00 02 1b 34 15 00 00 00 01 00 02 1c 03 15 00 00 00 01 00 02 1d 50 15 00 00 00 01 00 02 1e 03 15 00 00 00 01 00 02 1f 73 15 00 00 00 01 00 02 20 03 15 00 00 00 01 00 02 21 7d 15 00 00 00 01 00 02 22 03 15 00 00 00 01 00 02 23 89 15 00 00 00 01 00 02 24 03 15 00 00 00 01 00 02 25 96 15 00 00 00 01 00 02 26 03 15 00 00 00 01 00 02 27 a5 15 00 00 00 01 00 02 28 03 15 00 00 00 01 00 02 29 b5 15 00 00 00 01 00 02 2a 03 15 00 00 00 01 00 02 2b c3 15 00 00 00 01 00 02 2d 03 15 00 00 00 01 00 02 2f cc 15 00 00 00 01 00 02 30 03 15 00 00 00 01 00 02 31 ff 15 00 00 00 01 00 02 32 00 15 00 00 00 01 00 02 33 c8 15 00 00 00 01 00 02 34 00 15 00 00 00 01 00 02 35 d3 15 00 00 00 01 00 02 36 00 15 00 00 00 01 00 02 37 e6 15 00 00 00 01 00 02 38 00 15 00 00 00 01 00 02 39 f8 15 00 00 00 01 00 02 3a 01 15 00 00 00 01 00 02 3b 09 15 00 00 00 01 00 02 3d 01 15 00 00 00 01 00 02 3f 18 15 00 00 00 01 00 02 40 01 15 00 00 00 01 00 02 41 26 15 00 00 00 01 00 02 42 01 15 00 00 00 01 00 02 43 33 15 00 00 00 01 00 02 44 01 15 00 00 00 01 00 02 45 3f 15 00 00 00 01 00 02 46 01 15 00 00 00 01 00 02 47 6b 15 00 00 00 01 00 02 48 01 15 00 00 00 01 00 02 49 8e 15 00 00 00 01 00 02 4a 01 15 00 00 00 01 00 02 4b c7 15 00 00 00 01 00 02 4c 01 15 00 00 00 01 00 02 4d f2 15 00 00 00 01 00 02 4e 02 15 00 00 00 01 00 02 4f 37 15 00 00 00 01 00 02 50 02 15 00 00 00 01 00 02 51 70 15 00 00 00 01 00 02 52 02 15 00 00 00 01 00 02 53 72 15 00 00 00 01 00 02 54 02 15 00 00 00 01 00 02 55 a8 15 00 00 00 01 00 02 56 02 15 00 00 00 01 00 02 58 e3 15 00 00 00 01 00 02 59 03 15 00 00 00 01 00 02 5a 05 15 00 00 00 01 00 02 5b 03 15 00 00 00 01 00 02 5c 34 15 00 00 00 01 00 02 5d 03 15 00 00 00 01 00 02 5e 50 15 00 00 00 01 00 02 5f 03 15 00 00 00 01 00 02 60 73 15 00 00 00 01 00 02 61 03 15 00 00 00 01 00 02 62 7d 15 00 00 00 01 00 02 63 03 15 00 00 00 01 00 02 64 89 15 00 00 00 01 00 02 65 03 15 00 00 00 01 00 02 66 96 15 00 00 00 01 00 02 67 03 15 00 00 00 01 00 02 68 a5 15 00 00 00 01 00 02 69 03 15 00 00 00 01 00 02 6a b5 15 00 00 00 01 00 02 6b 03 15 00 00 00 01 00 02 6c c3 15 00 00 00 01 00 02 6d 03 15 00 00 00 01 00 02 6e cc 15 00 00 00 01 00 02 6f 03 15 00 00 00 01 00 02 70 ff 15 00 00 00 01 00 02 71 02 15 00 00 00 01 00 02 72 3f 15 00 00 00 01 00 02 73 02 15 00 00 00 01 00 02 74 40 15 00 00 00 01 00 02 75 02 15 00 00 00 01 00 02 76 42 15 00 00 00 01 00 02 77 02 15 00 00 00 01 00 02 78 45 15 00 00 00 01 00 02 79 02 15 00 00 00 01 00 02 7a 47 15 00 00 00 01 00 02 7b 02 15 00 00 00 01 00 02 7c 49 15 00 00 00 01 00 02 7d 02 15 00 00 00 01 00 02 7e 4b 15 00 00 00 01 00 02 7f 02 15 00 00 00 01 00 02 80 4d 15 00 00 00 01 00 02 81 02 15 00 00 00 01 00 02 82 4f 15 00 00 00 01 00 02 83 02 15 00 00 00 01 00 02 84 58 15 00 00 00 01 00 02 85 02 15 00 00 00 01 00 02 86 61 15 00 00 00 01 00 02 87 02 15 00 00 00 01 00 02 88 71 15 00 00 00 01 00 02 89 02 15 00 00 00 01 00 02 8a 82 15 00 00 00 01 00 02 8b 02 15 00 00 00 01 00 02 8c a4 15 00 00 00 01 00 02 8d 02 15 00 00 00 01 00 02 8e c6 15 00 00 00 01 00 02 8f 02 15 00 00 00 01 00 02 90 c7 15 00 00 00 01 00 02 91 02 15 00 00 00 01 00 02 92 ed 15 00 00 00 01 00 02 93 03 15 00 00 00 01 00 02 94 1b 15 00 00 00 01 00 02 95 03 15 00 00 00 01 00 02 96 3c 15 00 00 00 01 00 02 97 03 15 00 00 00 01 00 02 98 61 15 00 00 00 01 00 02 99 03 15 00 00 00 01 00 02 9a 78 15 00 00 00 01 00 02 9b 03 15 00 00 00 01 00 02 9c 95 15 00 00 00 01 00 02 9d 03 15 00 00 00 01 00 02 9e 9d 15 00 00 00 01 00 02 9f 03 15 00 00 00 01 00 02 a0 a7 15 00 00 00 01 00 02 a2 03 15 00 00 00 01 00 02 a3 b1 15 00 00 00 01 00 02 a4 03 15 00 00 00 01 00 02 a5 ba 15 00 00 00 01 00 02 a6 03 15 00 00 00 01 00 02 a7 c3 15 00 00 00 01 00 02 a9 03 15 00 00 00 01 00 02 aa c9 15 00 00 00 01 00 02 ab 03 15 00 00 00 01 00 02 ac ef 15 00 00 00 01 00 02 ad 03 15 00 00 00 01 00 02 ae ff 15 00 00 00 01 00 02 af 02 15 00 00 00 01 00 02 b0 3f 15 00 00 00 01 00 02 b1 02 15 00 00 00 01 00 02 b2 40 15 00 00 00 01 00 02 b3 02 15 00 00 00 01 00 02 b4 42 15 00 00 00 01 00 02 b5 02 15 00 00 00 01 00 02 b6 45 15 00 00 00 01 00 02 b7 02 15 00 00 00 01 00 02 b8 47 15 00 00 00 01 00 02 b9 02 15 00 00 00 01 00 02 ba 49 15 00 00 00 01 00 02 bb 02 15 00 00 00 01 00 02 bc 4b 15 00 00 00 01 00 02 bd 02 15 00 00 00 01 00 02 be 4d 15 00 00 00 01 00 02 bf 02 15 00 00 00 01 00 02 c0 4f 15 00 00 00 01 00 02 c1 02 15 00 00 00 01 00 02 c2 58 15 00 00 00 01 00 02 c3 02 15 00 00 00 01 00 02 c4 61 15 00 00 00 01 00 02 c5 02 15 00 00 00 01 00 02 c6 71 15 00 00 00 01 00 02 c7 02 15 00 00 00 01 00 02 c8 82 15 00 00 00 01 00 02 c9 02 15 00 00 00 01 00 02 ca a4 15 00 00 00 01 00 02 cb 02 15 00 00 00 01 00 02 cc c6 15 00 00 00 01 00 02 cd 02 15 00 00 00 01 00 02 ce c7 15 00 00 00 01 00 02 cf 02 15 00 00 00 01 00 02 d0 ed 15 00 00 00 01 00 02 d1 03 15 00 00 00 01 00 02 d2 1b 15 00 00 00 01 00 02 d3 03 15 00 00 00 01 00 02 d4 3c 15 00 00 00 01 00 02 d5 03 15 00 00 00 01 00 02 d6 61 15 00 00 00 01 00 02 d7 03 15 00 00 00 01 00 02 d8 78 15 00 00 00 01 00 02 d9 03 15 00 00 00 01 00 02 da 95 15 00 00 00 01 00 02 db 03 15 00 00 00 01 00 02 dc 9d 15 00 00 00 01 00 02 dd 03 15 00 00 00 01 00 02 de a7 15 00 00 00 01 00 02 df 03 15 00 00 00 01 00 02 e0 b1 15 00 00 00 01 00 02 e1 03 15 00 00 00 01 00 02 e2 ba 15 00 00 00 01 00 02 e3 03 15 00 00 00 01 00 02 e4 c3 15 00 00 00 01 00 02 e5 03 15 00 00 00 01 00 02 e6 c9 15 00 00 00 01 00 02 e7 03 15 00 00 00 01 00 02 e8 ef 15 00 00 00 01 00 02 e9 03 15 00 00 00 01 00 02 ea ff 15 00 00 00 01 00 02 fb 01 15 01 00 00 01 00 02 ff 10];
        qcom,mdss-dsi-dispparam-papermode7-state = "dsi_hs_mode";
        qcom,mdss-dsi-dispparam-teon-command = [15 01 00 00 10 00 02 35 00];
        qcom,mdss-dsi-dispparam-teoff-command = [15 01 00 00 10 00 02 34 00];
	};
};
