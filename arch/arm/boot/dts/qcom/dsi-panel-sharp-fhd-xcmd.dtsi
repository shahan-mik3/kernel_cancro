/* Copyright (c) 2012-2013, The Linux Foundation. All rights reserved.
 * Copyright (C) 2015 XiaoMi, Inc.
 *
 * This program is free software; you can redistribute it and/or modify
 * it under the terms of the GNU General Public License version 2 and
 * only version 2 as published by the Free Software Foundation.
 *
 * This program is distributed in the hope that it will be useful,
 * but WITHOUT ANY WARRANTY; without even the implied warranty of
 * MERCHANTABILITY or FITNESS FOR A PARTICULAR PURPOSE.  See the
 * GNU General Public License for more details.
 */

/*---------------------------------------------------------------------------
 * This file is autogenerated file using gcdb parser. Please do not edit it.
 * Update input XML file to add a new entry or update variable in this file
 * VERSION = "1.0"
 *---------------------------------------------------------------------------*/
&soc {
	dsi_sharp_fhd_xcmd: qcom,mdss_dsi_sharp_fhd_xcmd {
		compatible = "qcom,mdss-dsi-panel";
		status = "okay";
		qcom,mdss-dsi-panel-name = "sharp fhd cmd oncell dsi panel";
		qcom,mdss-dsi-panel-id = <3>;
		qcom,mdss-dsi-panel-sleepwrmod = <0>;
		qcom,mdss-dsi-panel-controller = <&mdss_dsi0>;
		qcom,mdss-dsi-panel-type = "dsi_cmd_mode";
		qcom,mdss-dsi-panel-destination = "display_1";
		qcom,mdss-dsi-panel-framerate = <60>;
		qcom,mdss-dsi-virtual-channel-id = <0>;
		qcom,mdss-dsi-stream = <0>;
		qcom,mdss-dsi-panel-width = <1080>;
		qcom,mdss-dsi-panel-height = <1920>;
		qcom,mdss-dsi-h-front-porch = <80>;
		qcom,mdss-dsi-h-back-porch = <40>;
		qcom,mdss-dsi-h-pulse-width = <10>;
		qcom,mdss-dsi-h-sync-skew = <0>;
		qcom,mdss-dsi-v-back-porch = <4>;
		qcom,mdss-dsi-v-front-porch = <4>;
		qcom,mdss-dsi-v-pulse-width = <2>;
		qcom,mdss-dsi-h-left-border = <0>;
		qcom,mdss-dsi-h-right-border = <0>;
		qcom,mdss-dsi-v-top-border = <0>;
		qcom,mdss-dsi-v-bottom-border = <0>;
		qcom,mdss-dsi-bpp = <24>;
		qcom,mdss-dsi-color-order = <0>;
		qcom,mdss-dsi-underflow-color = <0xff>;
		qcom,mdss-dsi-border-color = <0>;
		qcom,mdss-dsi-on-command = [
				15 00 00 00 00 00 02 FF 10
				15 00 00 00 00 00 02 35 00
				39 00 00 00 00 00 03 44 03 e8
				39 00 00 00 00 00 05 2A 00 00 04 37
				39 01 00 00 00 00 05 2B 00 00 07 7F

				15 01 00 00 00 00 02 FF E0
				15 00 00 00 00 00 02 B5 86
				15 00 00 00 00 00 02 B6 77
				15 00 00 00 00 00 02 B8 AD
				15 00 00 00 00 00 02 FB 01
				15 01 00 00 00 00 02 FF 20
				15 01 00 00 00 00 02 10 06
				15 01 00 00 00 00 02 FB 01
				15 01 00 00 00 00 02 FF 24
				15 01 00 00 00 00 02 37 2D
				15 01 00 00 00 00 02 FB 01
				15 01 00 00 00 00 02 FF 10

				15 00 00 00 00 00 02 51 de
				15 00 00 00 00 00 02 53 2c
				15 00 00 00 00 00 02 55 00
				05 01 00 00 78 00 02 11 00
				05 01 00 00 14 00 02 29 00];
		qcom,mdss-dsi-off-command = [
				15 01 00 00 00 00 02 FF 10
				05 01 00 00 02 00 02 28 00
				05 01 00 00 78 00 02 10 00];
		qcom,mdss-dsi-on-command-state = "dsi_lp_mode";
		qcom,mdss-dsi-off-command-state = "dsi_hs_mode";
		qcom,mdss-dsi-h-sync-pulse = <0>;
		qcom,mdss-dsi-traffic-mode = <1>;
		qcom,mdss-dsi-lane-map = <0>;
		qcom,mdss-dsi-bllp-eof-power-mode;
		qcom,mdss-dsi-bllp-power-mode;
		qcom,mdss-dsi-lane-0-state;
		qcom,mdss-dsi-lane-1-state;
		qcom,mdss-dsi-lane-2-state;
		qcom,mdss-dsi-lane-3-state;
		qcom,mdss-dsi-te-pin-select = <1>;
		qcom,mdss-dsi-te-v-sync-rd-ptr-irq-line = <0x2c>;
		qcom,mdss-dsi-te-v-sync-continues-lines = <0x3c>;
		qcom,mdss-dsi-te-dcs-command = <1>;
		qcom,mdss-dsi-te-check-enable;
		qcom,mdss-dsi-te-using-te-pin;
		qcom,mdss-dsi-panel-timings = [e3 50 36 00 a9 a3 3a 50 3d 03 04 00];
		qcom,mdss-dsi-t-clk-post = <0x20>;
		qcom,mdss-dsi-t-clk-pre = <0x36>;
		qcom,mdss-dsi-bl-min-level = <8>;
		qcom,mdss-dsi-bl-max-level = <4095>;
		qcom,mdss-dsi-dma-trigger = <0x04>;
		qcom,mdss-dsi-mdp-trigger = <0x0>;
		qcom,mdss-dsi-bl-pmic-control-type = "bl_ctrl_wled";
		qcom,mdss-dsi-reset-sequence = <1 10>, <0 1>, <1 10>;
		qcom,mdss-pan-physical-width-dimension = <71>;
		qcom,mdss-pan-physical-height-dimension = <126>;
        qcom,dispparam-enabled;
        qcom,mdss-dsi-dispparam-ceon-command = [15 00 00 00 01 00 02 ff 10 15 01 00 00 10 00 02 55 80];
        qcom,mdss-dsi-dispparam-ceon-command-state = "dsi_hs_mode";
        qcom,mdss-dsi-dispparam-ceoff-command = [15 00 00 00 01 00 02 ff 10 15 01 00 00 10 00 02 55 00];
        qcom,mdss-dsi-dispparam-ceoff-command-state = "dsi_hs_mode";
        qcom,mdss-dsi-dispparam-cabcon-command = <0x15000000 0x10002ff 0x10150000 0x10002 0x51de1500 0x100 0x2532c15 0x1000001 0x25501>;
        qcom,mdss-dsi-dispparam-cabcguion-command = [15 00 00 00 01 00 02 ff 10 15 01 00 00 01 00 02 55 01];
        qcom,mdss-dsi-dispparam-cabcstillon-command = [15 00 00 00 01 00 02 ff 10 15 01 00 00 01 00 02 55 02];
        qcom,mdss-dsi-dispparam-cabcmovieon-command = [15 00 00 00 01 00 02 ff 10 15 01 00 00 01 00 02 55 03];
        qcom,mdss-dsi-dispparam-cabcon-command-state = "dsi_hs_mode";
        qcom,mdss-dsi-dispparam-cabcoff-command = [15 00 00 00 01 00 02 ff 10 15 01 00 00 01 00 02 55 00];
        qcom,mdss-dsi-dispparam-cabcoff-command-state = "dsi_hs_mode";
        qcom,mdss-dsi-dispparam-warm-command = [15 00 00 00 01 00 02 ff 20 15 00 00 00 01 00 02 75 00 15 00 00 00 01 00 02 76 00 15 00 00 00 01 00 02 77 00 15 00 00 00 01 00 02 78 14 15 00 00 00 01 00 02 79 00 15 00 00 00 01 00 02 7a 3d 15 00 00 00 01 00 02 7b 00 15 00 00 00 01 00 02 7c 5c 15 00 00 00 01 00 02 7d 00 15 00 00 00 01 00 02 7e 7a 15 00 00 00 01 00 02 7f 00 15 00 00 00 01 00 02 80 94 15 00 00 00 01 00 02 81 00 15 00 00 00 01 00 02 82 ad 15 00 00 00 01 00 02 83 00 15 00 00 00 01 00 02 84 c1 15 00 00 00 01 00 02 85 00 15 00 00 00 01 00 02 86 d4 15 00 00 00 01 00 02 87 01 15 00 00 00 01 00 02 88 14 15 00 00 00 01 00 02 89 01 15 00 00 00 01 00 02 8a 46 15 00 00 00 01 00 02 8b 01 15 00 00 00 01 00 02 8c 90 15 00 00 00 01 00 02 8d 01 15 00 00 00 01 00 02 8e c6 15 00 00 00 01 00 02 8f 02 15 00 00 00 01 00 02 90 17 15 00 00 00 01 00 02 91 02 15 00 00 00 01 00 02 92 56 15 00 00 00 01 00 02 93 02 15 00 00 00 01 00 02 94 58 15 00 00 00 01 00 02 95 02 15 00 00 00 01 00 02 96 92 15 00 00 00 01 00 02 97 02 15 00 00 00 01 00 02 98 d0 15 00 00 00 01 00 02 99 02 15 00 00 00 01 00 02 9a f6 15 00 00 00 01 00 02 9b 03 15 00 00 00 01 00 02 9c 26 15 00 00 00 01 00 02 9d 03 15 00 00 00 01 00 02 9e 46 15 00 00 00 01 00 02 9f 03 15 00 00 00 01 00 02 a0 72 15 00 00 00 01 00 02 a2 03 15 00 00 00 01 00 02 a3 81 15 00 00 00 01 00 02 a4 03 15 00 00 00 01 00 02 a5 90 15 00 00 00 01 00 02 a6 03 15 00 00 00 01 00 02 a7 a1 15 00 00 00 01 00 02 a9 03 15 00 00 00 01 00 02 aa b3 15 00 00 00 01 00 02 ab 03 15 00 00 00 01 00 02 ac c6 15 00 00 00 01 00 02 ad 03 15 00 00 00 01 00 02 ae dc 15 00 00 00 01 00 02 af 03 15 00 00 00 01 00 02 b0 f4 15 00 00 00 01 00 02 b1 03 15 00 00 00 01 00 02 b2 ff 15 00 00 00 01 00 02 b3 00 15 00 00 00 01 00 02 b4 00 15 00 00 00 01 00 02 b5 00 15 00 00 00 01 00 02 b6 14 15 00 00 00 01 00 02 b7 00 15 00 00 00 01 00 02 b8 3d 15 00 00 00 01 00 02 b9 00 15 00 00 00 01 00 02 ba 5c 15 00 00 00 01 00 02 bb 00 15 00 00 00 01 00 02 bc 7a 15 00 00 00 01 00 02 bd 00 15 00 00 00 01 00 02 be 94 15 00 00 00 01 00 02 bf 00 15 00 00 00 01 00 02 c0 ad 15 00 00 00 01 00 02 c1 00 15 00 00 00 01 00 02 c2 c1 15 00 00 00 01 00 02 c3 00 15 00 00 00 01 00 02 c4 d4 15 00 00 00 01 00 02 c5 01 15 00 00 00 01 00 02 c6 14 15 00 00 00 01 00 02 c7 01 15 00 00 00 01 00 02 c8 46 15 00 00 00 01 00 02 c9 01 15 00 00 00 01 00 02 ca 90 15 00 00 00 01 00 02 cb 01 15 00 00 00 01 00 02 cc c6 15 00 00 00 01 00 02 cd 02 15 00 00 00 01 00 02 ce 17 15 00 00 00 01 00 02 cf 02 15 00 00 00 01 00 02 d0 56 15 00 00 00 01 00 02 d1 02 15 00 00 00 01 00 02 d2 58 15 00 00 00 01 00 02 d3 02 15 00 00 00 01 00 02 d4 92 15 00 00 00 01 00 02 d5 02 15 00 00 00 01 00 02 d6 d0 15 00 00 00 01 00 02 d7 02 15 00 00 00 01 00 02 d8 f6 15 00 00 00 01 00 02 d9 03 15 00 00 00 01 00 02 da 26 15 00 00 00 01 00 02 db 03 15 00 00 00 01 00 02 dc 46 15 00 00 00 01 00 02 dd 03 15 00 00 00 01 00 02 de 72 15 00 00 00 01 00 02 df 03 15 00 00 00 01 00 02 e0 81 15 00 00 00 01 00 02 e1 03 15 00 00 00 01 00 02 e2 90 15 00 00 00 01 00 02 e3 03 15 00 00 00 01 00 02 e4 a1 15 00 00 00 01 00 02 e5 03 15 00 00 00 01 00 02 e6 b3 15 00 00 00 01 00 02 e7 03 15 00 00 00 01 00 02 e8 c6 15 00 00 00 01 00 02 e9 03 15 00 00 00 01 00 02 ea dc 15 00 00 00 01 00 02 eb 03 15 00 00 00 01 00 02 ec f4 15 00 00 00 01 00 02 ed 03 15 00 00 00 01 00 02 ee ff 15 00 00 00 01 00 02 ef 00 15 00 00 00 01 00 02 f0 c7 15 00 00 00 01 00 02 f1 00 15 00 00 00 01 00 02 f2 d0 15 00 00 00 01 00 02 f3 00 15 00 00 00 01 00 02 f4 e2 15 00 00 00 01 00 02 f5 00 15 00 00 00 01 00 02 f6 f2 15 00 00 00 01 00 02 f7 01 15 00 00 00 01 00 02 f8 02 15 00 00 00 01 00 02 f9 01 15 00 00 00 01 00 02 fa 10 15 00 00 00 01 00 02 fb 01 15 00 00 00 01 00 02 ff 21 15 00 00 00 01 00 02 00 01 15 00 00 00 01 00 02 01 1f 15 00 00 00 01 00 02 02 01 15 00 00 00 01 00 02 03 2b 15 00 00 00 01 00 02 04 01 15 00 00 00 01 00 02 05 37 15 00 00 00 01 00 02 06 01 15 00 00 00 01 00 02 07 60 15 00 00 00 01 00 02 08 01 15 00 00 00 01 00 02 09 84 15 00 00 00 01 00 02 0a 01 15 00 00 00 01 00 02 0b bb 15 00 00 00 01 00 02 0c 01 15 00 00 00 01 00 02 0d e7 15 00 00 00 01 00 02 0e 02 15 00 00 00 01 00 02 0f 2c 15 00 00 00 01 00 02 10 02 15 00 00 00 01 00 02 11 66 15 00 00 00 01 00 02 12 02 15 00 00 00 01 00 02 13 68 15 00 00 00 01 00 02 14 02 15 00 00 00 01 00 02 15 9e 15 00 00 00 01 00 02 16 02 15 00 00 00 01 00 02 17 da 15 00 00 00 01 00 02 18 02 15 00 00 00 01 00 02 19 ff 15 00 00 00 01 00 02 1a 03 15 00 00 00 01 00 02 1b 2d 15 00 00 00 01 00 02 1c 03 15 00 00 00 01 00 02 1d 4d 15 00 00 00 01 00 02 1e 03 15 00 00 00 01 00 02 1f 78 15 00 00 00 01 00 02 20 03 15 00 00 00 01 00 02 21 86 15 00 00 00 01 00 02 22 03 15 00 00 00 01 00 02 23 94 15 00 00 00 01 00 02 24 03 15 00 00 00 01 00 02 25 a4 15 00 00 00 01 00 02 26 03 15 00 00 00 01 00 02 27 b5 15 00 00 00 01 00 02 28 03 15 00 00 00 01 00 02 29 c8 15 00 00 00 01 00 02 2a 03 15 00 00 00 01 00 02 2b dd 15 00 00 00 01 00 02 2d 03 15 00 00 00 01 00 02 2f f4 15 00 00 00 01 00 02 30 03 15 00 00 00 01 00 02 31 ff 15 00 00 00 01 00 02 32 00 15 00 00 00 01 00 02 33 c7 15 00 00 00 01 00 02 34 00 15 00 00 00 01 00 02 35 d0 15 00 00 00 01 00 02 36 00 15 00 00 00 01 00 02 37 e2 15 00 00 00 01 00 02 38 00 15 00 00 00 01 00 02 39 f2 15 00 00 00 01 00 02 3a 01 15 00 00 00 01 00 02 3b 02 15 00 00 00 01 00 02 3d 01 15 00 00 00 01 00 02 3f 10 15 00 00 00 01 00 02 40 01 15 00 00 00 01 00 02 41 1f 15 00 00 00 01 00 02 42 01 15 00 00 00 01 00 02 43 2b 15 00 00 00 01 00 02 44 01 15 00 00 00 01 00 02 45 37 15 00 00 00 01 00 02 46 01 15 00 00 00 01 00 02 47 60 15 00 00 00 01 00 02 48 01 15 00 00 00 01 00 02 49 84 15 00 00 00 01 00 02 4a 01 15 00 00 00 01 00 02 4b bb 15 00 00 00 01 00 02 4c 01 15 00 00 00 01 00 02 4d e7 15 00 00 00 01 00 02 4e 02 15 00 00 00 01 00 02 4f 2c 15 00 00 00 01 00 02 50 02 15 00 00 00 01 00 02 51 66 15 00 00 00 01 00 02 52 02 15 00 00 00 01 00 02 53 68 15 00 00 00 01 00 02 54 02 15 00 00 00 01 00 02 55 9e 15 00 00 00 01 00 02 56 02 15 00 00 00 01 00 02 58 da 15 00 00 00 01 00 02 59 02 15 00 00 00 01 00 02 5a ff 15 00 00 00 01 00 02 5b 03 15 00 00 00 01 00 02 5c 2d 15 00 00 00 01 00 02 5d 03 15 00 00 00 01 00 02 5e 4d 15 00 00 00 01 00 02 5f 03 15 00 00 00 01 00 02 60 78 15 00 00 00 01 00 02 61 03 15 00 00 00 01 00 02 62 86 15 00 00 00 01 00 02 63 03 15 00 00 00 01 00 02 64 94 15 00 00 00 01 00 02 65 03 15 00 00 00 01 00 02 66 a4 15 00 00 00 01 00 02 67 03 15 00 00 00 01 00 02 68 b5 15 00 00 00 01 00 02 69 03 15 00 00 00 01 00 02 6a c8 15 00 00 00 01 00 02 6b 03 15 00 00 00 01 00 02 6c dd 15 00 00 00 01 00 02 6d 03 15 00 00 00 01 00 02 6e f4 15 00 00 00 01 00 02 6f 03 15 00 00 00 01 00 02 70 ff 15 00 00 00 01 00 02 71 01 15 00 00 00 01 00 02 72 79 15 00 00 00 01 00 02 73 01 15 00 00 00 01 00 02 74 7d 15 00 00 00 01 00 02 75 01 15 00 00 00 01 00 02 76 84 15 00 00 00 01 00 02 77 01 15 00 00 00 01 00 02 78 8b 15 00 00 00 01 00 02 79 01 15 00 00 00 01 00 02 7a 92 15 00 00 00 01 00 02 7b 01 15 00 00 00 01 00 02 7c 99 15 00 00 00 01 00 02 7d 01 15 00 00 00 01 00 02 7e 9f 15 00 00 00 01 00 02 7f 01 15 00 00 00 01 00 02 80 a5 15 00 00 00 01 00 02 81 01 15 00 00 00 01 00 02 82 ab 15 00 00 00 01 00 02 83 01 15 00 00 00 01 00 02 84 c1 15 00 00 00 01 00 02 85 01 15 00 00 00 01 00 02 86 d6 15 00 00 00 01 00 02 87 01 15 00 00 00 01 00 02 88 f9 15 00 00 00 01 00 02 89 02 15 00 00 00 01 00 02 8a 19 15 00 00 00 01 00 02 8b 02 15 00 00 00 01 00 02 8c 4e 15 00 00 00 01 00 02 8d 02 15 00 00 00 01 00 02 8e 7f 15 00 00 00 01 00 02 8f 02 15 00 00 00 01 00 02 90 80 15 00 00 00 01 00 02 91 02 15 00 00 00 01 00 02 92 b1 15 00 00 00 01 00 02 93 02 15 00 00 00 01 00 02 94 e9 15 00 00 00 01 00 02 95 03 15 00 00 00 01 00 02 96 0e 15 00 00 00 01 00 02 97 03 15 00 00 00 01 00 02 98 3a 15 00 00 00 01 00 02 99 03 15 00 00 00 01 00 02 9a 59 15 00 00 00 01 00 02 9b 03 15 00 00 00 01 00 02 9c 82 15 00 00 00 01 00 02 9d 03 15 00 00 00 01 00 02 9e 8f 15 00 00 00 01 00 02 9f 03 15 00 00 00 01 00 02 a0 9d 15 00 00 00 01 00 02 a2 03 15 00 00 00 01 00 02 a3 ac 15 00 00 00 01 00 02 a4 03 15 00 00 00 01 00 02 a5 bb 15 00 00 00 01 00 02 a6 03 15 00 00 00 01 00 02 a7 cd 15 00 00 00 01 00 02 a9 03 15 00 00 00 01 00 02 aa e0 15 00 00 00 01 00 02 ab 03 15 00 00 00 01 00 02 ac f5 15 00 00 00 01 00 02 ad 03 15 00 00 00 01 00 02 ae ff 15 00 00 00 01 00 02 af 01 15 00 00 00 01 00 02 b0 79 15 00 00 00 01 00 02 b1 01 15 00 00 00 01 00 02 b2 7d 15 00 00 00 01 00 02 b3 01 15 00 00 00 01 00 02 b4 84 15 00 00 00 01 00 02 b5 01 15 00 00 00 01 00 02 b6 8b 15 00 00 00 01 00 02 b7 01 15 00 00 00 01 00 02 b8 92 15 00 00 00 01 00 02 b9 01 15 00 00 00 01 00 02 ba 99 15 00 00 00 01 00 02 bb 01 15 00 00 00 01 00 02 bc 9f 15 00 00 00 01 00 02 bd 01 15 00 00 00 01 00 02 be a5 15 00 00 00 01 00 02 bf 01 15 00 00 00 01 00 02 c0 ab 15 00 00 00 01 00 02 c1 01 15 00 00 00 01 00 02 c2 c1 15 00 00 00 01 00 02 c3 01 15 00 00 00 01 00 02 c4 d6 15 00 00 00 01 00 02 c5 01 15 00 00 00 01 00 02 c6 f9 15 00 00 00 01 00 02 c7 02 15 00 00 00 01 00 02 c8 19 15 00 00 00 01 00 02 c9 02 15 00 00 00 01 00 02 ca 4e 15 00 00 00 01 00 02 cb 02 15 00 00 00 01 00 02 cc 7f 15 00 00 00 01 00 02 cd 02 15 00 00 00 01 00 02 ce 80 15 00 00 00 01 00 02 cf 02 15 00 00 00 01 00 02 d0 b1 15 00 00 00 01 00 02 d1 02 15 00 00 00 01 00 02 d2 e9 15 00 00 00 01 00 02 d3 03 15 00 00 00 01 00 02 d4 0e 15 00 00 00 01 00 02 d5 03 15 00 00 00 01 00 02 d6 3a 15 00 00 00 01 00 02 d7 03 15 00 00 00 01 00 02 d8 59 15 00 00 00 01 00 02 d9 03 15 00 00 00 01 00 02 da 82 15 00 00 00 01 00 02 db 03 15 00 00 00 01 00 02 dc 8f 15 00 00 00 01 00 02 dd 03 15 00 00 00 01 00 02 de 9d 15 00 00 00 01 00 02 df 03 15 00 00 00 01 00 02 e0 ac 15 00 00 00 01 00 02 e1 03 15 00 00 00 01 00 02 e2 bb 15 00 00 00 01 00 02 e3 03 15 00 00 00 01 00 02 e4 cd 15 00 00 00 01 00 02 e5 03 15 00 00 00 01 00 02 e6 e0 15 00 00 00 01 00 02 e7 03 15 00 00 00 01 00 02 e8 f5 15 00 00 00 01 00 02 e9 03 15 00 00 00 01 00 02 ea ff 15 00 00 00 01 00 02 fb 01 15 01 00 00 01 00 02 ff 10];
        qcom,mdss-dsi-dispparam-warm-command-state = "dsi_hs_mode";
        qcom,mdss-dsi-dispparam-default-command = [15 00 00 00 01 00 02 ff 20 15 00 00 00 01 00 02 fb 00 15 00 00 00 01 00 02 ff 21 15 00 00 00 01 00 02 fb 00 15 00 00 00 01 00 02 ff 10 05 01 00 00 10 00 02 11 00];
        qcom,mdss-dsi-dispparam-default-command-state = "dsi_hs_mode";
        qcom,mdss-dsi-dispparam-cold-command = [15 00 00 00 01 00 02 ff 20 15 00 00 00 01 00 02 75 00 15 00 00 00 01 00 02 76 73 15 00 00 00 01 00 02 77 00 15 00 00 00 01 00 02 78 82 15 00 00 00 01 00 02 79 00 15 00 00 00 01 00 02 7a 9f 15 00 00 00 01 00 02 7b 00 15 00 00 00 01 00 02 7c b5 15 00 00 00 01 00 02 7d 00 15 00 00 00 01 00 02 7e cb 15 00 00 00 01 00 02 7f 00 15 00 00 00 01 00 02 80 dd 15 00 00 00 01 00 02 81 00 15 00 00 00 01 00 02 82 f0 15 00 00 00 01 00 02 83 01 15 00 00 00 01 00 02 84 00 15 00 00 00 01 00 02 85 01 15 00 00 00 01 00 02 86 10 15 00 00 00 01 00 02 87 01 15 00 00 00 01 00 02 88 46 15 00 00 00 01 00 02 89 01 15 00 00 00 01 00 02 8a 70 15 00 00 00 01 00 02 8b 01 15 00 00 00 01 00 02 8c af 15 00 00 00 01 00 02 8d 01 15 00 00 00 01 00 02 8e e3 15 00 00 00 01 00 02 8f 02 15 00 00 00 01 00 02 90 2e 15 00 00 00 01 00 02 91 02 15 00 00 00 01 00 02 92 6b 15 00 00 00 01 00 02 93 02 15 00 00 00 01 00 02 94 6c 15 00 00 00 01 00 02 95 02 15 00 00 00 01 00 02 96 a6 15 00 00 00 01 00 02 97 02 15 00 00 00 01 00 02 98 e6 15 00 00 00 01 00 02 99 03 15 00 00 00 01 00 02 9a 0c 15 00 00 00 01 00 02 9b 03 15 00 00 00 01 00 02 9c 3f 15 00 00 00 01 00 02 9d 03 15 00 00 00 01 00 02 9e 64 15 00 00 00 01 00 02 9f 03 15 00 00 00 01 00 02 a0 91 15 00 00 00 01 00 02 a2 03 15 00 00 00 01 00 02 a3 9e 15 00 00 00 01 00 02 a4 03 15 00 00 00 01 00 02 a5 ab 15 00 00 00 01 00 02 a6 03 15 00 00 00 01 00 02 a7 b9 15 00 00 00 01 00 02 a9 03 15 00 00 00 01 00 02 aa c7 15 00 00 00 01 00 02 ab 03 15 00 00 00 01 00 02 ac d6 15 00 00 00 01 00 02 ad 03 15 00 00 00 01 00 02 ae e6 15 00 00 00 01 00 02 af 03 15 00 00 00 01 00 02 b0 f7 15 00 00 00 01 00 02 b1 03 15 00 00 00 01 00 02 b2 ff 15 00 00 00 01 00 02 b3 00 15 00 00 00 01 00 02 b4 73 15 00 00 00 01 00 02 b5 00 15 00 00 00 01 00 02 b6 82 15 00 00 00 01 00 02 b7 00 15 00 00 00 01 00 02 b8 9f 15 00 00 00 01 00 02 b9 00 15 00 00 00 01 00 02 ba b5 15 00 00 00 01 00 02 bb 00 15 00 00 00 01 00 02 bc cb 15 00 00 00 01 00 02 bd 00 15 00 00 00 01 00 02 be dd 15 00 00 00 01 00 02 bf 00 15 00 00 00 01 00 02 c0 f0 15 00 00 00 01 00 02 c1 01 15 00 00 00 01 00 02 c2 00 15 00 00 00 01 00 02 c3 01 15 00 00 00 01 00 02 c4 10 15 00 00 00 01 00 02 c5 01 15 00 00 00 01 00 02 c6 46 15 00 00 00 01 00 02 c7 01 15 00 00 00 01 00 02 c8 70 15 00 00 00 01 00 02 c9 01 15 00 00 00 01 00 02 ca af 15 00 00 00 01 00 02 cb 01 15 00 00 00 01 00 02 cc e3 15 00 00 00 01 00 02 cd 02 15 00 00 00 01 00 02 ce 2e 15 00 00 00 01 00 02 cf 02 15 00 00 00 01 00 02 d0 6b 15 00 00 00 01 00 02 d1 02 15 00 00 00 01 00 02 d2 6c 15 00 00 00 01 00 02 d3 02 15 00 00 00 01 00 02 d4 a6 15 00 00 00 01 00 02 d5 02 15 00 00 00 01 00 02 d6 e6 15 00 00 00 01 00 02 d7 03 15 00 00 00 01 00 02 d8 0c 15 00 00 00 01 00 02 d9 03 15 00 00 00 01 00 02 da 3f 15 00 00 00 01 00 02 db 03 15 00 00 00 01 00 02 dc 64 15 00 00 00 01 00 02 dd 03 15 00 00 00 01 00 02 de 91 15 00 00 00 01 00 02 df 03 15 00 00 00 01 00 02 e0 9e 15 00 00 00 01 00 02 e1 03 15 00 00 00 01 00 02 e2 ab 15 00 00 00 01 00 02 e3 03 15 00 00 00 01 00 02 e4 b9 15 00 00 00 01 00 02 e5 03 15 00 00 00 01 00 02 e6 c7 15 00 00 00 01 00 02 e7 03 15 00 00 00 01 00 02 e8 d6 15 00 00 00 01 00 02 e9 03 15 00 00 00 01 00 02 ea e6 15 00 00 00 01 00 02 eb 03 15 00 00 00 01 00 02 ec f7 15 00 00 00 01 00 02 ed 03 15 00 00 00 01 00 02 ee ff 15 00 00 00 01 00 02 ef 00 15 00 00 00 01 00 02 f0 00 15 00 00 00 01 00 02 f1 00 15 00 00 00 01 00 02 f2 18 15 00 00 00 01 00 02 f3 00 15 00 00 00 01 00 02 f4 49 15 00 00 00 01 00 02 f5 00 15 00 00 00 01 00 02 f6 6c 15 00 00 00 01 00 02 f7 00 15 00 00 00 01 00 02 f8 8f 15 00 00 00 01 00 02 f9 00 15 00 00 00 01 00 02 fa a9 15 00 00 00 01 00 02 fb 01 15 00 00 00 01 00 02 ff 21 15 00 00 00 01 00 02 00 00 15 00 00 00 01 00 02 01 c2 15 00 00 00 01 00 02 02 00 15 00 00 00 01 00 02 03 d7 15 00 00 00 01 00 02 04 00 15 00 00 00 01 00 02 05 ed 15 00 00 00 01 00 02 06 01 15 00 00 00 01 00 02 07 2d 15 00 00 00 01 00 02 08 01 15 00 00 00 01 00 02 09 60 15 00 00 00 01 00 02 0a 01 15 00 00 00 01 00 02 0b a8 15 00 00 00 01 00 02 0c 01 15 00 00 00 01 00 02 0d dc 15 00 00 00 01 00 02 0e 02 15 00 00 00 01 00 02 0f 2a 15 00 00 00 01 00 02 10 02 15 00 00 00 01 00 02 11 69 15 00 00 00 01 00 02 12 02 15 00 00 00 01 00 02 13 6a 15 00 00 00 01 00 02 14 02 15 00 00 00 01 00 02 15 a5 15 00 00 00 01 00 02 16 02 15 00 00 00 01 00 02 17 e6 15 00 00 00 01 00 02 18 03 15 00 00 00 01 00 02 19 0c 15 00 00 00 01 00 02 1a 03 15 00 00 00 01 00 02 1b 3c 15 00 00 00 01 00 02 1c 03 15 00 00 00 01 00 02 1d 5d 15 00 00 00 01 00 02 1e 03 15 00 00 00 01 00 02 1f 88 15 00 00 00 01 00 02 20 03 15 00 00 00 01 00 02 21 95 15 00 00 00 01 00 02 22 03 15 00 00 00 01 00 02 23 a2 15 00 00 00 01 00 02 24 03 15 00 00 00 01 00 02 25 b1 15 00 00 00 01 00 02 26 03 15 00 00 00 01 00 02 27 c0 15 00 00 00 01 00 02 28 03 15 00 00 00 01 00 02 29 d1 15 00 00 00 01 00 02 2a 03 15 00 00 00 01 00 02 2b e3 15 00 00 00 01 00 02 2d 03 15 00 00 00 01 00 02 2f f6 15 00 00 00 01 00 02 30 03 15 00 00 00 01 00 02 31 ff 15 00 00 00 01 00 02 32 00 15 00 00 00 01 00 02 33 00 15 00 00 00 01 00 02 34 00 15 00 00 00 01 00 02 35 18 15 00 00 00 01 00 02 36 00 15 00 00 00 01 00 02 37 49 15 00 00 00 01 00 02 38 00 15 00 00 00 01 00 02 39 6c 15 00 00 00 01 00 02 3a 00 15 00 00 00 01 00 02 3b 8f 15 00 00 00 01 00 02 3d 00 15 00 00 00 01 00 02 3f a9 15 00 00 00 01 00 02 40 00 15 00 00 00 01 00 02 41 c2 15 00 00 00 01 00 02 42 00 15 00 00 00 01 00 02 43 d7 15 00 00 00 01 00 02 44 00 15 00 00 00 01 00 02 45 ed 15 00 00 00 01 00 02 46 01 15 00 00 00 01 00 02 47 2d 15 00 00 00 01 00 02 48 01 15 00 00 00 01 00 02 49 60 15 00 00 00 01 00 02 4a 01 15 00 00 00 01 00 02 4b a8 15 00 00 00 01 00 02 4c 01 15 00 00 00 01 00 02 4d dc 15 00 00 00 01 00 02 4e 02 15 00 00 00 01 00 02 4f 2a 15 00 00 00 01 00 02 50 02 15 00 00 00 01 00 02 51 69 15 00 00 00 01 00 02 52 02 15 00 00 00 01 00 02 53 6a 15 00 00 00 01 00 02 54 02 15 00 00 00 01 00 02 55 a5 15 00 00 00 01 00 02 56 02 15 00 00 00 01 00 02 58 e6 15 00 00 00 01 00 02 59 03 15 00 00 00 01 00 02 5a 0c 15 00 00 00 01 00 02 5b 03 15 00 00 00 01 00 02 5c 3c 15 00 00 00 01 00 02 5d 03 15 00 00 00 01 00 02 5e 5d 15 00 00 00 01 00 02 5f 03 15 00 00 00 01 00 02 60 88 15 00 00 00 01 00 02 61 03 15 00 00 00 01 00 02 62 95 15 00 00 00 01 00 02 63 03 15 00 00 00 01 00 02 64 a2 15 00 00 00 01 00 02 65 03 15 00 00 00 01 00 02 66 b1 15 00 00 00 01 00 02 67 03 15 00 00 00 01 00 02 68 c0 15 00 00 00 01 00 02 69 03 15 00 00 00 01 00 02 6a d1 15 00 00 00 01 00 02 6b 03 15 00 00 00 01 00 02 6c e3 15 00 00 00 01 00 02 6d 03 15 00 00 00 01 00 02 6e f6 15 00 00 00 01 00 02 6f 03 15 00 00 00 01 00 02 70 ff 15 00 00 00 01 00 02 71 00 15 00 00 00 01 00 02 72 cf 15 00 00 00 01 00 02 73 00 15 00 00 00 01 00 02 74 d9 15 00 00 00 01 00 02 75 00 15 00 00 00 01 00 02 76 ee 15 00 00 00 01 00 02 77 00 15 00 00 00 01 00 02 78 ff 15 00 00 00 01 00 02 79 01 15 00 00 00 01 00 02 7a 10 15 00 00 00 01 00 02 7b 01 15 00 00 00 01 00 02 7c 1f 15 00 00 00 01 00 02 7d 01 15 00 00 00 01 00 02 7e 2e 15 00 00 00 01 00 02 7f 01 15 00 00 00 01 00 02 80 3a 15 00 00 00 01 00 02 81 01 15 00 00 00 01 00 02 82 48 15 00 00 00 01 00 02 83 01 15 00 00 00 01 00 02 84 72 15 00 00 00 01 00 02 85 01 15 00 00 00 01 00 02 86 95 15 00 00 00 01 00 02 87 01 15 00 00 00 01 00 02 88 cd 15 00 00 00 01 00 02 89 01 15 00 00 00 01 00 02 8a f9 15 00 00 00 01 00 02 8b 02 15 00 00 00 01 00 02 8c 3d 15 00 00 00 01 00 02 8d 02 15 00 00 00 01 00 02 8e 75 15 00 00 00 01 00 02 8f 02 15 00 00 00 01 00 02 90 77 15 00 00 00 01 00 02 91 02 15 00 00 00 01 00 02 92 ae 15 00 00 00 01 00 02 93 02 15 00 00 00 01 00 02 94 ec 15 00 00 00 01 00 02 95 03 15 00 00 00 01 00 02 96 13 15 00 00 00 01 00 02 97 03 15 00 00 00 01 00 02 98 43 15 00 00 00 01 00 02 99 03 15 00 00 00 01 00 02 9a 63 15 00 00 00 01 00 02 9b 03 15 00 00 00 01 00 02 9c 8c 15 00 00 00 01 00 02 9d 03 15 00 00 00 01 00 02 9e 98 15 00 00 00 01 00 02 9f 03 15 00 00 00 01 00 02 a0 a5 15 00 00 00 01 00 02 a2 03 15 00 00 00 01 00 02 a3 b3 15 00 00 00 01 00 02 a4 03 15 00 00 00 01 00 02 a5 c2 15 00 00 00 01 00 02 a6 03 15 00 00 00 01 00 02 a7 d2 15 00 00 00 01 00 02 a9 03 15 00 00 00 01 00 02 aa e3 15 00 00 00 01 00 02 ab 03 15 00 00 00 01 00 02 ac f6 15 00 00 00 01 00 02 ad 03 15 00 00 00 01 00 02 ae ff 15 00 00 00 01 00 02 af 00 15 00 00 00 01 00 02 b0 cf 15 00 00 00 01 00 02 b1 00 15 00 00 00 01 00 02 b2 d9 15 00 00 00 01 00 02 b3 00 15 00 00 00 01 00 02 b4 ee 15 00 00 00 01 00 02 b5 00 15 00 00 00 01 00 02 b6 ff 15 00 00 00 01 00 02 b7 01 15 00 00 00 01 00 02 b8 10 15 00 00 00 01 00 02 b9 01 15 00 00 00 01 00 02 ba 1f 15 00 00 00 01 00 02 bb 01 15 00 00 00 01 00 02 bc 2e 15 00 00 00 01 00 02 bd 01 15 00 00 00 01 00 02 be 3a 15 00 00 00 01 00 02 bf 01 15 00 00 00 01 00 02 c0 48 15 00 00 00 01 00 02 c1 01 15 00 00 00 01 00 02 c2 72 15 00 00 00 01 00 02 c3 01 15 00 00 00 01 00 02 c4 95 15 00 00 00 01 00 02 c5 01 15 00 00 00 01 00 02 c6 cd 15 00 00 00 01 00 02 c7 01 15 00 00 00 01 00 02 c8 f9 15 00 00 00 01 00 02 c9 02 15 00 00 00 01 00 02 ca 3d 15 00 00 00 01 00 02 cb 02 15 00 00 00 01 00 02 cc 75 15 00 00 00 01 00 02 cd 02 15 00 00 00 01 00 02 ce 77 15 00 00 00 01 00 02 cf 02 15 00 00 00 01 00 02 d0 ae 15 00 00 00 01 00 02 d1 02 15 00 00 00 01 00 02 d2 ec 15 00 00 00 01 00 02 d3 03 15 00 00 00 01 00 02 d4 13 15 00 00 00 01 00 02 d5 03 15 00 00 00 01 00 02 d6 43 15 00 00 00 01 00 02 d7 03 15 00 00 00 01 00 02 d8 63 15 00 00 00 01 00 02 d9 03 15 00 00 00 01 00 02 da 8c 15 00 00 00 01 00 02 db 03 15 00 00 00 01 00 02 dc 98 15 00 00 00 01 00 02 dd 03 15 00 00 00 01 00 02 de a5 15 00 00 00 01 00 02 df 03 15 00 00 00 01 00 02 e0 b3 15 00 00 00 01 00 02 e1 03 15 00 00 00 01 00 02 e2 c2 15 00 00 00 01 00 02 e3 03 15 00 00 00 01 00 02 e4 d2 15 00 00 00 01 00 02 e5 03 15 00 00 00 01 00 02 e6 e3 15 00 00 00 01 00 02 e7 03 15 00 00 00 01 00 02 e8 f6 15 00 00 00 01 00 02 e9 03 15 00 00 00 01 00 02 ea ff 15 00 00 00 01 00 02 fb 01 15 01 00 00 01 00 02 ff 10];
        qcom,mdss-dsi-dispparam-cold-command-state = "dsi_hs_mode";
        qcom,mdss-dsi-dispparam-papermode-command = [15 01 00 00 01 00 02 ff 20 15 00 00 00 01 00 02 fb 01 15 00 00 00 01 00 02 75 00 15 00 00 00 01 00 02 76 14 15 00 00 00 01 00 02 77 00 15 00 00 00 01 00 02 78 2f 15 00 00 00 01 00 02 79 00 15 00 00 00 01 00 02 7a 59 15 00 00 00 01 00 02 7b 00 15 00 00 00 01 00 02 7c 7b 15 00 00 00 01 00 02 7d 00 15 00 00 00 01 00 02 7e 9a 15 00 00 00 01 00 02 7f 00 15 00 00 00 01 00 02 80 b2 15 00 00 00 01 00 02 81 00 15 00 00 00 01 00 02 82 c9 15 00 00 00 01 00 02 83 00 15 00 00 00 01 00 02 84 dd 15 00 00 00 01 00 02 85 00 15 00 00 00 01 00 02 86 ef 15 00 00 00 01 00 02 87 01 15 00 00 00 01 00 02 88 29 15 00 00 00 01 00 02 89 01 15 00 00 00 01 00 02 8a 57 15 00 00 00 01 00 02 8b 01 15 00 00 00 01 00 02 8c 9a 15 00 00 00 01 00 02 8d 01 15 00 00 00 01 00 02 8e cc 15 00 00 00 01 00 02 8f 02 15 00 00 00 01 00 02 90 17 15 00 00 00 01 00 02 91 02 15 00 00 00 01 00 02 92 4e 15 00 00 00 01 00 02 93 02 15 00 00 00 01 00 02 94 50 15 00 00 00 01 00 02 95 02 15 00 00 00 01 00 02 96 84 15 00 00 00 01 00 02 97 02 15 00 00 00 01 00 02 98 c4 15 00 00 00 01 00 02 99 02 15 00 00 00 01 00 02 9a ed 15 00 00 00 01 00 02 9b 03 15 00 00 00 01 00 02 9c 21 15 00 00 00 01 00 02 9d 03 15 00 00 00 01 00 02 9e 3d 15 00 00 00 01 00 02 9f 03 15 00 00 00 01 00 02 a0 62 15 00 00 00 01 00 02 a2 03 15 00 00 00 01 00 02 a3 6d 15 00 00 00 01 00 02 a4 03 15 00 00 00 01 00 02 a5 78 15 00 00 00 01 00 02 a6 03 15 00 00 00 01 00 02 a7 86 15 00 00 00 01 00 02 a9 03 15 00 00 00 01 00 02 aa 96 15 00 00 00 01 00 02 ab 03 15 00 00 00 01 00 02 ac a7 15 00 00 00 01 00 02 ad 03 15 00 00 00 01 00 02 ae bc 15 00 00 00 01 00 02 af 03 15 00 00 00 01 00 02 b0 d0 15 00 00 00 01 00 02 b1 03 15 00 00 00 01 00 02 b2 d5 15 00 00 00 01 00 02 b3 00 15 00 00 00 01 00 02 b4 3b 15 00 00 00 01 00 02 b5 00 15 00 00 00 01 00 02 b6 55 15 00 00 00 01 00 02 b7 00 15 00 00 00 01 00 02 b8 7e 15 00 00 00 01 00 02 b9 00 15 00 00 00 01 00 02 ba a0 15 00 00 00 01 00 02 bb 00 15 00 00 00 01 00 02 bc bd 15 00 00 00 01 00 02 bd 00 15 00 00 00 01 00 02 be d5 15 00 00 00 01 00 02 bf 00 15 00 00 00 01 00 02 c0 ec 15 00 00 00 01 00 02 c1 00 15 00 00 00 01 00 02 c2 fe 15 00 00 00 01 00 02 c3 01 15 00 00 00 01 00 02 c4 10 15 00 00 00 01 00 02 c5 01 15 00 00 00 01 00 02 c6 48 15 00 00 00 01 00 02 c7 01 15 00 00 00 01 00 02 c8 72 15 00 00 00 01 00 02 c9 01 15 00 00 00 01 00 02 ca af 15 00 00 00 01 00 02 cb 01 15 00 00 00 01 00 02 cc dd 15 00 00 00 01 00 02 cd 02 15 00 00 00 01 00 02 ce 20 15 00 00 00 01 00 02 cf 02 15 00 00 00 01 00 02 d0 57 15 00 00 00 01 00 02 d1 02 15 00 00 00 01 00 02 d2 59 15 00 00 00 01 00 02 d3 02 15 00 00 00 01 00 02 d4 8d 15 00 00 00 01 00 02 d5 02 15 00 00 00 01 00 02 d6 c1 15 00 00 00 01 00 02 d7 02 15 00 00 00 01 00 02 d8 e1 15 00 00 00 01 00 02 d9 03 15 00 00 00 01 00 02 da 0c 15 00 00 00 01 00 02 db 03 15 00 00 00 01 00 02 dc 2e 15 00 00 00 01 00 02 dd 03 15 00 00 00 01 00 02 de 57 15 00 00 00 01 00 02 df 03 15 00 00 00 01 00 02 e0 64 15 00 00 00 01 00 02 e1 03 15 00 00 00 01 00 02 e2 71 15 00 00 00 01 00 02 e3 03 15 00 00 00 01 00 02 e4 7f 15 00 00 00 01 00 02 e5 03 15 00 00 00 01 00 02 e6 91 15 00 00 00 01 00 02 e7 03 15 00 00 00 01 00 02 e8 a4 15 00 00 00 01 00 02 e9 03 15 00 00 00 01 00 02 ea b9 15 00 00 00 01 00 02 eb 03 15 00 00 00 01 00 02 ec cf 15 00 00 00 01 00 02 ed 03 15 00 00 00 01 00 02 ee d5 15 00 00 00 01 00 02 ef 00 15 00 00 00 01 00 02 f0 14 15 00 00 00 01 00 02 f1 00 15 00 00 00 01 00 02 f2 2f 15 00 00 00 01 00 02 f3 00 15 00 00 00 01 00 02 f4 59 15 00 00 00 01 00 02 f5 00 15 00 00 00 01 00 02 f6 7b 15 00 00 00 01 00 02 f7 00 15 00 00 00 01 00 02 f8 9a 15 00 00 00 01 00 02 f9 00 15 00 00 00 01 00 02 fa b2 15 01 00 00 01 00 02 ff 21 15 00 00 00 01 00 02 fb 01 15 00 00 00 01 00 02 00 00 15 00 00 00 01 00 02 01 c9 15 00 00 00 01 00 02 02 00 15 00 00 00 01 00 02 03 dd 15 00 00 00 01 00 02 04 00 15 00 00 00 01 00 02 05 ef 15 00 00 00 01 00 02 06 01 15 00 00 00 01 00 02 07 29 15 00 00 00 01 00 02 08 01 15 00 00 00 01 00 02 09 57 15 00 00 00 01 00 02 0a 01 15 00 00 00 01 00 02 0b 9a 15 00 00 00 01 00 02 0c 01 15 00 00 00 01 00 02 0d cc 15 00 00 00 01 00 02 0e 02 15 00 00 00 01 00 02 0f 17 15 00 00 00 01 00 02 10 02 15 00 00 00 01 00 02 11 4e 15 00 00 00 01 00 02 12 02 15 00 00 00 01 00 02 13 50 15 00 00 00 01 00 02 14 02 15 00 00 00 01 00 02 15 84 15 00 00 00 01 00 02 16 02 15 00 00 00 01 00 02 17 c4 15 00 00 00 01 00 02 18 02 15 00 00 00 01 00 02 19 ed 15 00 00 00 01 00 02 1a 03 15 00 00 00 01 00 02 1b 21 15 00 00 00 01 00 02 1c 03 15 00 00 00 01 00 02 1d 3d 15 00 00 00 01 00 02 1e 03 15 00 00 00 01 00 02 1f 62 15 00 00 00 01 00 02 20 03 15 00 00 00 01 00 02 21 6d 15 00 00 00 01 00 02 22 03 15 00 00 00 01 00 02 23 78 15 00 00 00 01 00 02 24 03 15 00 00 00 01 00 02 25 86 15 00 00 00 01 00 02 26 03 15 00 00 00 01 00 02 27 96 15 00 00 00 01 00 02 28 03 15 00 00 00 01 00 02 29 a7 15 00 00 00 01 00 02 2a 03 15 00 00 00 01 00 02 2b bc 15 00 00 00 01 00 02 2d 03 15 00 00 00 01 00 02 2f d0 15 00 00 00 01 00 02 30 03 15 00 00 00 01 00 02 31 d5 15 00 00 00 01 00 02 32 00 15 00 00 00 01 00 02 33 3b 15 00 00 00 01 00 02 34 00 15 00 00 00 01 00 02 35 55 15 00 00 00 01 00 02 36 00 15 00 00 00 01 00 02 37 7e 15 00 00 00 01 00 02 38 00 15 00 00 00 01 00 02 39 a0 15 00 00 00 01 00 02 3a 00 15 00 00 00 01 00 02 3b bd 15 00 00 00 01 00 02 3d 00 15 00 00 00 01 00 02 3f d5 15 00 00 00 01 00 02 40 00 15 00 00 00 01 00 02 41 ec 15 00 00 00 01 00 02 42 00 15 00 00 00 01 00 02 43 fe 15 00 00 00 01 00 02 44 01 15 00 00 00 01 00 02 45 10 15 00 00 00 01 00 02 46 01 15 00 00 00 01 00 02 47 48 15 00 00 00 01 00 02 48 01 15 00 00 00 01 00 02 49 72 15 00 00 00 01 00 02 4a 01 15 00 00 00 01 00 02 4b af 15 00 00 00 01 00 02 4c 01 15 00 00 00 01 00 02 4d dd 15 00 00 00 01 00 02 4e 02 15 00 00 00 01 00 02 4f 20 15 00 00 00 01 00 02 50 02 15 00 00 00 01 00 02 51 57 15 00 00 00 01 00 02 52 02 15 00 00 00 01 00 02 53 59 15 00 00 00 01 00 02 54 02 15 00 00 00 01 00 02 55 8d 15 00 00 00 01 00 02 56 02 15 00 00 00 01 00 02 58 c1 15 00 00 00 01 00 02 59 02 15 00 00 00 01 00 02 5a e1 15 00 00 00 01 00 02 5b 03 15 00 00 00 01 00 02 5c 0c 15 00 00 00 01 00 02 5d 03 15 00 00 00 01 00 02 5e 2e 15 00 00 00 01 00 02 5f 03 15 00 00 00 01 00 02 60 57 15 00 00 00 01 00 02 61 03 15 00 00 00 01 00 02 62 64 15 00 00 00 01 00 02 63 03 15 00 00 00 01 00 02 64 71 15 00 00 00 01 00 02 65 03 15 00 00 00 01 00 02 66 7f 15 00 00 00 01 00 02 67 03 15 00 00 00 01 00 02 68 91 15 00 00 00 01 00 02 69 03 15 00 00 00 01 00 02 6a a4 15 00 00 00 01 00 02 6b 03 15 00 00 00 01 00 02 6c b9 15 00 00 00 01 00 02 6d 03 15 00 00 00 01 00 02 6e cf 15 00 00 00 01 00 02 6f 03 15 00 00 00 01 00 02 70 d5 15 00 00 00 01 00 02 71 02 15 00 00 00 01 00 02 72 3d 15 00 00 00 01 00 02 73 02 15 00 00 00 01 00 02 74 3e 15 00 00 00 01 00 02 75 02 15 00 00 00 01 00 02 76 40 15 00 00 00 01 00 02 77 02 15 00 00 00 01 00 02 78 42 15 00 00 00 01 00 02 79 02 15 00 00 00 01 00 02 7a 44 15 00 00 00 01 00 02 7b 02 15 00 00 00 01 00 02 7c 45 15 00 00 00 01 00 02 7d 02 15 00 00 00 01 00 02 7e 47 15 00 00 00 01 00 02 7f 02 15 00 00 00 01 00 02 80 48 15 00 00 00 01 00 02 81 02 15 00 00 00 01 00 02 82 4a 15 00 00 00 01 00 02 83 02 15 00 00 00 01 00 02 84 51 15 00 00 00 01 00 02 85 02 15 00 00 00 01 00 02 86 57 15 00 00 00 01 00 02 87 02 15 00 00 00 01 00 02 88 62 15 00 00 00 01 00 02 89 02 15 00 00 00 01 00 02 8a 6f 15 00 00 00 01 00 02 8b 02 15 00 00 00 01 00 02 8c 8b 15 00 00 00 01 00 02 8d 02 15 00 00 00 01 00 02 8e ab 15 00 00 00 01 00 02 8f 02 15 00 00 00 01 00 02 90 ac 15 00 00 00 01 00 02 91 02 15 00 00 00 01 00 02 92 d2 15 00 00 00 01 00 02 93 03 15 00 00 00 01 00 02 94 08 15 00 00 00 01 00 02 95 03 15 00 00 00 01 00 02 96 2c 15 00 00 00 01 00 02 97 03 15 00 00 00 01 00 02 98 5a 15 00 00 00 01 00 02 99 03 15 00 00 00 01 00 02 9a 70 15 00 00 00 01 00 02 9b 03 15 00 00 00 01 00 02 9c 8b 15 00 00 00 01 00 02 9d 03 15 00 00 00 01 00 02 9e 93 15 00 00 00 01 00 02 9f 03 15 00 00 00 01 00 02 a0 9b 15 00 00 00 01 00 02 a2 03 15 00 00 00 01 00 02 a3 a4 15 00 00 00 01 00 02 a4 03 15 00 00 00 01 00 02 a5 af 15 00 00 00 01 00 02 a6 03 15 00 00 00 01 00 02 a7 b7 15 00 00 00 01 00 02 a9 03 15 00 00 00 01 00 02 aa c1 15 00 00 00 01 00 02 ab 03 15 00 00 00 01 00 02 ac c5 15 00 00 00 01 00 02 ad 03 15 00 00 00 01 00 02 ae d5 15 00 00 00 01 00 02 af 02 15 00 00 00 01 00 02 b0 30 15 00 00 00 01 00 02 b1 02 15 00 00 00 01 00 02 b2 31 15 00 00 00 01 00 02 b3 02 15 00 00 00 01 00 02 b4 33 15 00 00 00 01 00 02 b5 02 15 00 00 00 01 00 02 b6 35 15 00 00 00 01 00 02 b7 02 15 00 00 00 01 00 02 b8 38 15 00 00 00 01 00 02 b9 02 15 00 00 00 01 00 02 ba 3a 15 00 00 00 01 00 02 bb 02 15 00 00 00 01 00 02 bc 3c 15 00 00 00 01 00 02 bd 02 15 00 00 00 01 00 02 be 3e 15 00 00 00 01 00 02 bf 02 15 00 00 00 01 00 02 c0 40 15 00 00 00 01 00 02 c1 02 15 00 00 00 01 00 02 c2 49 15 00 00 00 01 00 02 c3 02 15 00 00 00 01 00 02 c4 51 15 00 00 00 01 00 02 c5 02 15 00 00 00 01 00 02 c6 61 15 00 00 00 01 00 02 c7 02 15 00 00 00 01 00 02 c8 72 15 00 00 00 01 00 02 c9 02 15 00 00 00 01 00 02 ca 93 15 00 00 00 01 00 02 cb 02 15 00 00 00 01 00 02 cc b4 15 00 00 00 01 00 02 cd 02 15 00 00 00 01 00 02 ce b5 15 00 00 00 01 00 02 cf 02 15 00 00 00 01 00 02 d0 db 15 00 00 00 01 00 02 d1 03 15 00 00 00 01 00 02 d2 05 15 00 00 00 01 00 02 d3 03 15 00 00 00 01 00 02 d4 21 15 00 00 00 01 00 02 d5 03 15 00 00 00 01 00 02 d6 44 15 00 00 00 01 00 02 d7 03 15 00 00 00 01 00 02 d8 60 15 00 00 00 01 00 02 d9 03 15 00 00 00 01 00 02 da 81 15 00 00 00 01 00 02 db 03 15 00 00 00 01 00 02 dc 8a 15 00 00 00 01 00 02 dd 03 15 00 00 00 01 00 02 de 94 15 00 00 00 01 00 02 df 03 15 00 00 00 01 00 02 e0 9e 15 00 00 00 01 00 02 e1 03 15 00 00 00 01 00 02 e2 ab 15 00 00 00 01 00 02 e3 03 15 00 00 00 01 00 02 e4 b4 15 00 00 00 01 00 02 e5 03 15 00 00 00 01 00 02 e6 bf 15 00 00 00 01 00 02 e7 03 15 00 00 00 01 00 02 e8 c4 15 00 00 00 01 00 02 e9 03 15 00 00 00 01 00 02 ea d5 15 01 00 00 01 00 02 ff 10];
        qcom,mdss-dsi-dispparam-papermode-command-state = "dsi_hs_mode";
        qcom,mdss-dsi-dispparam-papermode1-command = [15 01 00 00 01 00 02 ff 20 15 00 00 00 01 00 02 fb 01 15 00 00 00 01 00 02 75 00 15 00 00 00 01 00 02 76 14 15 00 00 00 01 00 02 77 00 15 00 00 00 01 00 02 78 2f 15 00 00 00 01 00 02 79 00 15 00 00 00 01 00 02 7a 59 15 00 00 00 01 00 02 7b 00 15 00 00 00 01 00 02 7c 7b 15 00 00 00 01 00 02 7d 00 15 00 00 00 01 00 02 7e 9a 15 00 00 00 01 00 02 7f 00 15 00 00 00 01 00 02 80 b2 15 00 00 00 01 00 02 81 00 15 00 00 00 01 00 02 82 c9 15 00 00 00 01 00 02 83 00 15 00 00 00 01 00 02 84 dd 15 00 00 00 01 00 02 85 00 15 00 00 00 01 00 02 86 ef 15 00 00 00 01 00 02 87 01 15 00 00 00 01 00 02 88 29 15 00 00 00 01 00 02 89 01 15 00 00 00 01 00 02 8a 57 15 00 00 00 01 00 02 8b 01 15 00 00 00 01 00 02 8c 9a 15 00 00 00 01 00 02 8d 01 15 00 00 00 01 00 02 8e cc 15 00 00 00 01 00 02 8f 02 15 00 00 00 01 00 02 90 17 15 00 00 00 01 00 02 91 02 15 00 00 00 01 00 02 92 4e 15 00 00 00 01 00 02 93 02 15 00 00 00 01 00 02 94 50 15 00 00 00 01 00 02 95 02 15 00 00 00 01 00 02 96 84 15 00 00 00 01 00 02 97 02 15 00 00 00 01 00 02 98 c4 15 00 00 00 01 00 02 99 02 15 00 00 00 01 00 02 9a ed 15 00 00 00 01 00 02 9b 03 15 00 00 00 01 00 02 9c 21 15 00 00 00 01 00 02 9d 03 15 00 00 00 01 00 02 9e 3d 15 00 00 00 01 00 02 9f 03 15 00 00 00 01 00 02 a0 62 15 00 00 00 01 00 02 a2 03 15 00 00 00 01 00 02 a3 6d 15 00 00 00 01 00 02 a4 03 15 00 00 00 01 00 02 a5 78 15 00 00 00 01 00 02 a6 03 15 00 00 00 01 00 02 a7 86 15 00 00 00 01 00 02 a9 03 15 00 00 00 01 00 02 aa 96 15 00 00 00 01 00 02 ab 03 15 00 00 00 01 00 02 ac a7 15 00 00 00 01 00 02 ad 03 15 00 00 00 01 00 02 ae bc 15 00 00 00 01 00 02 af 03 15 00 00 00 01 00 02 b0 d0 15 00 00 00 01 00 02 b1 03 15 00 00 00 01 00 02 b2 d5 15 00 00 00 01 00 02 b3 00 15 00 00 00 01 00 02 b4 3b 15 00 00 00 01 00 02 b5 00 15 00 00 00 01 00 02 b6 55 15 00 00 00 01 00 02 b7 00 15 00 00 00 01 00 02 b8 7e 15 00 00 00 01 00 02 b9 00 15 00 00 00 01 00 02 ba a0 15 00 00 00 01 00 02 bb 00 15 00 00 00 01 00 02 bc bd 15 00 00 00 01 00 02 bd 00 15 00 00 00 01 00 02 be d5 15 00 00 00 01 00 02 bf 00 15 00 00 00 01 00 02 c0 ec 15 00 00 00 01 00 02 c1 00 15 00 00 00 01 00 02 c2 fe 15 00 00 00 01 00 02 c3 01 15 00 00 00 01 00 02 c4 10 15 00 00 00 01 00 02 c5 01 15 00 00 00 01 00 02 c6 48 15 00 00 00 01 00 02 c7 01 15 00 00 00 01 00 02 c8 72 15 00 00 00 01 00 02 c9 01 15 00 00 00 01 00 02 ca af 15 00 00 00 01 00 02 cb 01 15 00 00 00 01 00 02 cc dd 15 00 00 00 01 00 02 cd 02 15 00 00 00 01 00 02 ce 20 15 00 00 00 01 00 02 cf 02 15 00 00 00 01 00 02 d0 57 15 00 00 00 01 00 02 d1 02 15 00 00 00 01 00 02 d2 59 15 00 00 00 01 00 02 d3 02 15 00 00 00 01 00 02 d4 8d 15 00 00 00 01 00 02 d5 02 15 00 00 00 01 00 02 d6 c1 15 00 00 00 01 00 02 d7 02 15 00 00 00 01 00 02 d8 e1 15 00 00 00 01 00 02 d9 03 15 00 00 00 01 00 02 da 0c 15 00 00 00 01 00 02 db 03 15 00 00 00 01 00 02 dc 2e 15 00 00 00 01 00 02 dd 03 15 00 00 00 01 00 02 de 57 15 00 00 00 01 00 02 df 03 15 00 00 00 01 00 02 e0 64 15 00 00 00 01 00 02 e1 03 15 00 00 00 01 00 02 e2 71 15 00 00 00 01 00 02 e3 03 15 00 00 00 01 00 02 e4 7f 15 00 00 00 01 00 02 e5 03 15 00 00 00 01 00 02 e6 91 15 00 00 00 01 00 02 e7 03 15 00 00 00 01 00 02 e8 a4 15 00 00 00 01 00 02 e9 03 15 00 00 00 01 00 02 ea b9 15 00 00 00 01 00 02 eb 03 15 00 00 00 01 00 02 ec cf 15 00 00 00 01 00 02 ed 03 15 00 00 00 01 00 02 ee d5 15 00 00 00 01 00 02 ef 00 15 00 00 00 01 00 02 f0 14 15 00 00 00 01 00 02 f1 00 15 00 00 00 01 00 02 f2 2f 15 00 00 00 01 00 02 f3 00 15 00 00 00 01 00 02 f4 59 15 00 00 00 01 00 02 f5 00 15 00 00 00 01 00 02 f6 7b 15 00 00 00 01 00 02 f7 00 15 00 00 00 01 00 02 f8 9a 15 00 00 00 01 00 02 f9 00 15 00 00 00 01 00 02 fa b2 15 01 00 00 01 00 02 ff 21 15 00 00 00 01 00 02 fb 01 15 00 00 00 01 00 02 00 00 15 00 00 00 01 00 02 01 c9 15 00 00 00 01 00 02 02 00 15 00 00 00 01 00 02 03 dd 15 00 00 00 01 00 02 04 00 15 00 00 00 01 00 02 05 ef 15 00 00 00 01 00 02 06 01 15 00 00 00 01 00 02 07 29 15 00 00 00 01 00 02 08 01 15 00 00 00 01 00 02 09 57 15 00 00 00 01 00 02 0a 01 15 00 00 00 01 00 02 0b 9a 15 00 00 00 01 00 02 0c 01 15 00 00 00 01 00 02 0d cc 15 00 00 00 01 00 02 0e 02 15 00 00 00 01 00 02 0f 17 15 00 00 00 01 00 02 10 02 15 00 00 00 01 00 02 11 4e 15 00 00 00 01 00 02 12 02 15 00 00 00 01 00 02 13 50 15 00 00 00 01 00 02 14 02 15 00 00 00 01 00 02 15 84 15 00 00 00 01 00 02 16 02 15 00 00 00 01 00 02 17 c4 15 00 00 00 01 00 02 18 02 15 00 00 00 01 00 02 19 ed 15 00 00 00 01 00 02 1a 03 15 00 00 00 01 00 02 1b 21 15 00 00 00 01 00 02 1c 03 15 00 00 00 01 00 02 1d 3d 15 00 00 00 01 00 02 1e 03 15 00 00 00 01 00 02 1f 62 15 00 00 00 01 00 02 20 03 15 00 00 00 01 00 02 21 6d 15 00 00 00 01 00 02 22 03 15 00 00 00 01 00 02 23 78 15 00 00 00 01 00 02 24 03 15 00 00 00 01 00 02 25 86 15 00 00 00 01 00 02 26 03 15 00 00 00 01 00 02 27 96 15 00 00 00 01 00 02 28 03 15 00 00 00 01 00 02 29 a7 15 00 00 00 01 00 02 2a 03 15 00 00 00 01 00 02 2b bc 15 00 00 00 01 00 02 2d 03 15 00 00 00 01 00 02 2f d0 15 00 00 00 01 00 02 30 03 15 00 00 00 01 00 02 31 d5 15 00 00 00 01 00 02 32 00 15 00 00 00 01 00 02 33 3b 15 00 00 00 01 00 02 34 00 15 00 00 00 01 00 02 35 55 15 00 00 00 01 00 02 36 00 15 00 00 00 01 00 02 37 7e 15 00 00 00 01 00 02 38 00 15 00 00 00 01 00 02 39 a0 15 00 00 00 01 00 02 3a 00 15 00 00 00 01 00 02 3b bd 15 00 00 00 01 00 02 3d 00 15 00 00 00 01 00 02 3f d5 15 00 00 00 01 00 02 40 00 15 00 00 00 01 00 02 41 ec 15 00 00 00 01 00 02 42 00 15 00 00 00 01 00 02 43 fe 15 00 00 00 01 00 02 44 01 15 00 00 00 01 00 02 45 10 15 00 00 00 01 00 02 46 01 15 00 00 00 01 00 02 47 48 15 00 00 00 01 00 02 48 01 15 00 00 00 01 00 02 49 72 15 00 00 00 01 00 02 4a 01 15 00 00 00 01 00 02 4b af 15 00 00 00 01 00 02 4c 01 15 00 00 00 01 00 02 4d dd 15 00 00 00 01 00 02 4e 02 15 00 00 00 01 00 02 4f 20 15 00 00 00 01 00 02 50 02 15 00 00 00 01 00 02 51 57 15 00 00 00 01 00 02 52 02 15 00 00 00 01 00 02 53 59 15 00 00 00 01 00 02 54 02 15 00 00 00 01 00 02 55 8d 15 00 00 00 01 00 02 56 02 15 00 00 00 01 00 02 58 c1 15 00 00 00 01 00 02 59 02 15 00 00 00 01 00 02 5a e1 15 00 00 00 01 00 02 5b 03 15 00 00 00 01 00 02 5c 0c 15 00 00 00 01 00 02 5d 03 15 00 00 00 01 00 02 5e 2e 15 00 00 00 01 00 02 5f 03 15 00 00 00 01 00 02 60 57 15 00 00 00 01 00 02 61 03 15 00 00 00 01 00 02 62 64 15 00 00 00 01 00 02 63 03 15 00 00 00 01 00 02 64 71 15 00 00 00 01 00 02 65 03 15 00 00 00 01 00 02 66 7f 15 00 00 00 01 00 02 67 03 15 00 00 00 01 00 02 68 91 15 00 00 00 01 00 02 69 03 15 00 00 00 01 00 02 6a a4 15 00 00 00 01 00 02 6b 03 15 00 00 00 01 00 02 6c b9 15 00 00 00 01 00 02 6d 03 15 00 00 00 01 00 02 6e cf 15 00 00 00 01 00 02 6f 03 15 00 00 00 01 00 02 70 d5 15 00 00 00 01 00 02 71 01 15 00 00 00 01 00 02 72 2a 15 00 00 00 01 00 02 73 01 15 00 00 00 01 00 02 74 30 15 00 00 00 01 00 02 75 01 15 00 00 00 01 00 02 76 3b 15 00 00 00 01 00 02 77 01 15 00 00 00 01 00 02 78 46 15 00 00 00 01 00 02 79 01 15 00 00 00 01 00 02 7a 50 15 00 00 00 01 00 02 7b 01 15 00 00 00 01 00 02 7c 5a 15 00 00 00 01 00 02 7d 01 15 00 00 00 01 00 02 7e 63 15 00 00 00 01 00 02 7f 01 15 00 00 00 01 00 02 80 6b 15 00 00 00 01 00 02 81 01 15 00 00 00 01 00 02 82 73 15 00 00 00 01 00 02 83 01 15 00 00 00 01 00 02 84 90 15 00 00 00 01 00 02 85 01 15 00 00 00 01 00 02 86 aa 15 00 00 00 01 00 02 87 01 15 00 00 00 01 00 02 88 d1 15 00 00 00 01 00 02 89 01 15 00 00 00 01 00 02 8a f4 15 00 00 00 01 00 02 8b 02 15 00 00 00 01 00 02 8c 2c 15 00 00 00 01 00 02 8d 02 15 00 00 00 01 00 02 8e 5d 15 00 00 00 01 00 02 8f 02 15 00 00 00 01 00 02 90 5e 15 00 00 00 01 00 02 91 02 15 00 00 00 01 00 02 92 8f 15 00 00 00 01 00 02 93 02 15 00 00 00 01 00 02 94 cf 15 00 00 00 01 00 02 95 02 15 00 00 00 01 00 02 96 f7 15 00 00 00 01 00 02 97 03 15 00 00 00 01 00 02 98 2a 15 00 00 00 01 00 02 99 03 15 00 00 00 01 00 02 9a 45 15 00 00 00 01 00 02 9b 03 15 00 00 00 01 00 02 9c 67 15 00 00 00 01 00 02 9d 03 15 00 00 00 01 00 02 9e 72 15 00 00 00 01 00 02 9f 03 15 00 00 00 01 00 02 a0 7e 15 00 00 00 01 00 02 a2 03 15 00 00 00 01 00 02 a3 8a 15 00 00 00 01 00 02 a4 03 15 00 00 00 01 00 02 a5 98 15 00 00 00 01 00 02 a6 03 15 00 00 00 01 00 02 a7 a8 15 00 00 00 01 00 02 a9 03 15 00 00 00 01 00 02 aa b9 15 00 00 00 01 00 02 ab 03 15 00 00 00 01 00 02 ac c8 15 00 00 00 01 00 02 ad 03 15 00 00 00 01 00 02 ae d5 15 00 00 00 01 00 02 af 01 15 00 00 00 01 00 02 b0 29 15 00 00 00 01 00 02 b1 01 15 00 00 00 01 00 02 b2 2f 15 00 00 00 01 00 02 b3 01 15 00 00 00 01 00 02 b4 3a 15 00 00 00 01 00 02 b5 01 15 00 00 00 01 00 02 b6 45 15 00 00 00 01 00 02 b7 01 15 00 00 00 01 00 02 b8 50 15 00 00 00 01 00 02 b9 01 15 00 00 00 01 00 02 ba 59 15 00 00 00 01 00 02 bb 01 15 00 00 00 01 00 02 bc 63 15 00 00 00 01 00 02 bd 01 15 00 00 00 01 00 02 be 6c 15 00 00 00 01 00 02 bf 01 15 00 00 00 01 00 02 c0 73 15 00 00 00 01 00 02 c1 01 15 00 00 00 01 00 02 c2 92 15 00 00 00 01 00 02 c3 01 15 00 00 00 01 00 02 c4 ad 15 00 00 00 01 00 02 c5 01 15 00 00 00 01 00 02 c6 d5 15 00 00 00 01 00 02 c7 01 15 00 00 00 01 00 02 c8 fa 15 00 00 00 01 00 02 c9 02 15 00 00 00 01 00 02 ca 35 15 00 00 00 01 00 02 cb 02 15 00 00 00 01 00 02 cc 65 15 00 00 00 01 00 02 cd 02 15 00 00 00 01 00 02 ce 67 15 00 00 00 01 00 02 cf 02 15 00 00 00 01 00 02 d0 98 15 00 00 00 01 00 02 d1 02 15 00 00 00 01 00 02 d2 cc 15 00 00 00 01 00 02 d3 02 15 00 00 00 01 00 02 d4 eb 15 00 00 00 01 00 02 d5 03 15 00 00 00 01 00 02 d6 14 15 00 00 00 01 00 02 d7 03 15 00 00 00 01 00 02 d8 35 15 00 00 00 01 00 02 d9 03 15 00 00 00 01 00 02 da 5d 15 00 00 00 01 00 02 db 03 15 00 00 00 01 00 02 dc 69 15 00 00 00 01 00 02 dd 03 15 00 00 00 01 00 02 de 76 15 00 00 00 01 00 02 df 03 15 00 00 00 01 00 02 e0 84 15 00 00 00 01 00 02 e1 03 15 00 00 00 01 00 02 e2 93 15 00 00 00 01 00 02 e3 03 15 00 00 00 01 00 02 e4 a4 15 00 00 00 01 00 02 e5 03 15 00 00 00 01 00 02 e6 b7 15 00 00 00 01 00 02 e7 03 15 00 00 00 01 00 02 e8 c7 15 00 00 00 01 00 02 e9 03 15 00 00 00 01 00 02 ea d5 15 01 00 00 01 00 02 ff 10];
        qcom,mdss-dsi-dispparam-papermode1-command-state = "dsi_hs_mode";
        qcom,mdss-dsi-dispparam-papermode2-command = [15 01 00 00 01 00 02 ff 20 15 00 00 00 01 00 02 fb 01 15 00 00 00 01 00 02 75 00 15 00 00 00 01 00 02 76 14 15 00 00 00 01 00 02 77 00 15 00 00 00 01 00 02 78 2f 15 00 00 00 01 00 02 79 00 15 00 00 00 01 00 02 7a 59 15 00 00 00 01 00 02 7b 00 15 00 00 00 01 00 02 7c 7b 15 00 00 00 01 00 02 7d 00 15 00 00 00 01 00 02 7e 9a 15 00 00 00 01 00 02 7f 00 15 00 00 00 01 00 02 80 b2 15 00 00 00 01 00 02 81 00 15 00 00 00 01 00 02 82 c9 15 00 00 00 01 00 02 83 00 15 00 00 00 01 00 02 84 dd 15 00 00 00 01 00 02 85 00 15 00 00 00 01 00 02 86 ef 15 00 00 00 01 00 02 87 01 15 00 00 00 01 00 02 88 29 15 00 00 00 01 00 02 89 01 15 00 00 00 01 00 02 8a 57 15 00 00 00 01 00 02 8b 01 15 00 00 00 01 00 02 8c 9a 15 00 00 00 01 00 02 8d 01 15 00 00 00 01 00 02 8e cc 15 00 00 00 01 00 02 8f 02 15 00 00 00 01 00 02 90 17 15 00 00 00 01 00 02 91 02 15 00 00 00 01 00 02 92 4e 15 00 00 00 01 00 02 93 02 15 00 00 00 01 00 02 94 50 15 00 00 00 01 00 02 95 02 15 00 00 00 01 00 02 96 84 15 00 00 00 01 00 02 97 02 15 00 00 00 01 00 02 98 c4 15 00 00 00 01 00 02 99 02 15 00 00 00 01 00 02 9a ed 15 00 00 00 01 00 02 9b 03 15 00 00 00 01 00 02 9c 21 15 00 00 00 01 00 02 9d 03 15 00 00 00 01 00 02 9e 3d 15 00 00 00 01 00 02 9f 03 15 00 00 00 01 00 02 a0 62 15 00 00 00 01 00 02 a2 03 15 00 00 00 01 00 02 a3 6d 15 00 00 00 01 00 02 a4 03 15 00 00 00 01 00 02 a5 78 15 00 00 00 01 00 02 a6 03 15 00 00 00 01 00 02 a7 86 15 00 00 00 01 00 02 a9 03 15 00 00 00 01 00 02 aa 96 15 00 00 00 01 00 02 ab 03 15 00 00 00 01 00 02 ac a7 15 00 00 00 01 00 02 ad 03 15 00 00 00 01 00 02 ae bc 15 00 00 00 01 00 02 af 03 15 00 00 00 01 00 02 b0 d0 15 00 00 00 01 00 02 b1 03 15 00 00 00 01 00 02 b2 d5 15 00 00 00 01 00 02 b3 00 15 00 00 00 01 00 02 b4 3b 15 00 00 00 01 00 02 b5 00 15 00 00 00 01 00 02 b6 55 15 00 00 00 01 00 02 b7 00 15 00 00 00 01 00 02 b8 7e 15 00 00 00 01 00 02 b9 00 15 00 00 00 01 00 02 ba a0 15 00 00 00 01 00 02 bb 00 15 00 00 00 01 00 02 bc bd 15 00 00 00 01 00 02 bd 00 15 00 00 00 01 00 02 be d5 15 00 00 00 01 00 02 bf 00 15 00 00 00 01 00 02 c0 ec 15 00 00 00 01 00 02 c1 00 15 00 00 00 01 00 02 c2 fe 15 00 00 00 01 00 02 c3 01 15 00 00 00 01 00 02 c4 10 15 00 00 00 01 00 02 c5 01 15 00 00 00 01 00 02 c6 48 15 00 00 00 01 00 02 c7 01 15 00 00 00 01 00 02 c8 72 15 00 00 00 01 00 02 c9 01 15 00 00 00 01 00 02 ca af 15 00 00 00 01 00 02 cb 01 15 00 00 00 01 00 02 cc dd 15 00 00 00 01 00 02 cd 02 15 00 00 00 01 00 02 ce 20 15 00 00 00 01 00 02 cf 02 15 00 00 00 01 00 02 d0 57 15 00 00 00 01 00 02 d1 02 15 00 00 00 01 00 02 d2 59 15 00 00 00 01 00 02 d3 02 15 00 00 00 01 00 02 d4 8d 15 00 00 00 01 00 02 d5 02 15 00 00 00 01 00 02 d6 c1 15 00 00 00 01 00 02 d7 02 15 00 00 00 01 00 02 d8 e1 15 00 00 00 01 00 02 d9 03 15 00 00 00 01 00 02 da 0c 15 00 00 00 01 00 02 db 03 15 00 00 00 01 00 02 dc 2e 15 00 00 00 01 00 02 dd 03 15 00 00 00 01 00 02 de 57 15 00 00 00 01 00 02 df 03 15 00 00 00 01 00 02 e0 64 15 00 00 00 01 00 02 e1 03 15 00 00 00 01 00 02 e2 71 15 00 00 00 01 00 02 e3 03 15 00 00 00 01 00 02 e4 7f 15 00 00 00 01 00 02 e5 03 15 00 00 00 01 00 02 e6 91 15 00 00 00 01 00 02 e7 03 15 00 00 00 01 00 02 e8 a4 15 00 00 00 01 00 02 e9 03 15 00 00 00 01 00 02 ea b9 15 00 00 00 01 00 02 eb 03 15 00 00 00 01 00 02 ec cf 15 00 00 00 01 00 02 ed 03 15 00 00 00 01 00 02 ee d5 15 00 00 00 01 00 02 ef 00 15 00 00 00 01 00 02 f0 14 15 00 00 00 01 00 02 f1 00 15 00 00 00 01 00 02 f2 2f 15 00 00 00 01 00 02 f3 00 15 00 00 00 01 00 02 f4 59 15 00 00 00 01 00 02 f5 00 15 00 00 00 01 00 02 f6 7b 15 00 00 00 01 00 02 f7 00 15 00 00 00 01 00 02 f8 9a 15 00 00 00 01 00 02 f9 00 15 00 00 00 01 00 02 fa b2 15 01 00 00 01 00 02 ff 21 15 00 00 00 01 00 02 fb 01 15 00 00 00 01 00 02 00 00 15 00 00 00 01 00 02 01 c9 15 00 00 00 01 00 02 02 00 15 00 00 00 01 00 02 03 dd 15 00 00 00 01 00 02 04 00 15 00 00 00 01 00 02 05 ef 15 00 00 00 01 00 02 06 01 15 00 00 00 01 00 02 07 29 15 00 00 00 01 00 02 08 01 15 00 00 00 01 00 02 09 57 15 00 00 00 01 00 02 0a 01 15 00 00 00 01 00 02 0b 9a 15 00 00 00 01 00 02 0c 01 15 00 00 00 01 00 02 0d cc 15 00 00 00 01 00 02 0e 02 15 00 00 00 01 00 02 0f 17 15 00 00 00 01 00 02 10 02 15 00 00 00 01 00 02 11 4e 15 00 00 00 01 00 02 12 02 15 00 00 00 01 00 02 13 50 15 00 00 00 01 00 02 14 02 15 00 00 00 01 00 02 15 84 15 00 00 00 01 00 02 16 02 15 00 00 00 01 00 02 17 c4 15 00 00 00 01 00 02 18 02 15 00 00 00 01 00 02 19 ed 15 00 00 00 01 00 02 1a 03 15 00 00 00 01 00 02 1b 21 15 00 00 00 01 00 02 1c 03 15 00 00 00 01 00 02 1d 3d 15 00 00 00 01 00 02 1e 03 15 00 00 00 01 00 02 1f 62 15 00 00 00 01 00 02 20 03 15 00 00 00 01 00 02 21 6d 15 00 00 00 01 00 02 22 03 15 00 00 00 01 00 02 23 78 15 00 00 00 01 00 02 24 03 15 00 00 00 01 00 02 25 86 15 00 00 00 01 00 02 26 03 15 00 00 00 01 00 02 27 96 15 00 00 00 01 00 02 28 03 15 00 00 00 01 00 02 29 a7 15 00 00 00 01 00 02 2a 03 15 00 00 00 01 00 02 2b bc 15 00 00 00 01 00 02 2d 03 15 00 00 00 01 00 02 2f d0 15 00 00 00 01 00 02 30 03 15 00 00 00 01 00 02 31 d5 15 00 00 00 01 00 02 32 00 15 00 00 00 01 00 02 33 3b 15 00 00 00 01 00 02 34 00 15 00 00 00 01 00 02 35 55 15 00 00 00 01 00 02 36 00 15 00 00 00 01 00 02 37 7e 15 00 00 00 01 00 02 38 00 15 00 00 00 01 00 02 39 a0 15 00 00 00 01 00 02 3a 00 15 00 00 00 01 00 02 3b bd 15 00 00 00 01 00 02 3d 00 15 00 00 00 01 00 02 3f d5 15 00 00 00 01 00 02 40 00 15 00 00 00 01 00 02 41 ec 15 00 00 00 01 00 02 42 00 15 00 00 00 01 00 02 43 fe 15 00 00 00 01 00 02 44 01 15 00 00 00 01 00 02 45 10 15 00 00 00 01 00 02 46 01 15 00 00 00 01 00 02 47 48 15 00 00 00 01 00 02 48 01 15 00 00 00 01 00 02 49 72 15 00 00 00 01 00 02 4a 01 15 00 00 00 01 00 02 4b af 15 00 00 00 01 00 02 4c 01 15 00 00 00 01 00 02 4d dd 15 00 00 00 01 00 02 4e 02 15 00 00 00 01 00 02 4f 20 15 00 00 00 01 00 02 50 02 15 00 00 00 01 00 02 51 57 15 00 00 00 01 00 02 52 02 15 00 00 00 01 00 02 53 59 15 00 00 00 01 00 02 54 02 15 00 00 00 01 00 02 55 8d 15 00 00 00 01 00 02 56 02 15 00 00 00 01 00 02 58 c1 15 00 00 00 01 00 02 59 02 15 00 00 00 01 00 02 5a e1 15 00 00 00 01 00 02 5b 03 15 00 00 00 01 00 02 5c 0c 15 00 00 00 01 00 02 5d 03 15 00 00 00 01 00 02 5e 2e 15 00 00 00 01 00 02 5f 03 15 00 00 00 01 00 02 60 57 15 00 00 00 01 00 02 61 03 15 00 00 00 01 00 02 62 64 15 00 00 00 01 00 02 63 03 15 00 00 00 01 00 02 64 71 15 00 00 00 01 00 02 65 03 15 00 00 00 01 00 02 66 7f 15 00 00 00 01 00 02 67 03 15 00 00 00 01 00 02 68 91 15 00 00 00 01 00 02 69 03 15 00 00 00 01 00 02 6a a4 15 00 00 00 01 00 02 6b 03 15 00 00 00 01 00 02 6c b9 15 00 00 00 01 00 02 6d 03 15 00 00 00 01 00 02 6e cf 15 00 00 00 01 00 02 6f 03 15 00 00 00 01 00 02 70 d5 15 00 00 00 01 00 02 71 01 15 00 00 00 01 00 02 72 78 15 00 00 00 01 00 02 73 01 15 00 00 00 01 00 02 74 7c 15 00 00 00 01 00 02 75 01 15 00 00 00 01 00 02 76 83 15 00 00 00 01 00 02 77 01 15 00 00 00 01 00 02 78 8a 15 00 00 00 01 00 02 79 01 15 00 00 00 01 00 02 7a 90 15 00 00 00 01 00 02 7b 01 15 00 00 00 01 00 02 7c 97 15 00 00 00 01 00 02 7d 01 15 00 00 00 01 00 02 7e 9d 15 00 00 00 01 00 02 7f 01 15 00 00 00 01 00 02 80 a3 15 00 00 00 01 00 02 81 01 15 00 00 00 01 00 02 82 a9 15 00 00 00 01 00 02 83 01 15 00 00 00 01 00 02 84 be 15 00 00 00 01 00 02 85 01 15 00 00 00 01 00 02 86 cf 15 00 00 00 01 00 02 87 01 15 00 00 00 01 00 02 88 ef 15 00 00 00 01 00 02 89 02 15 00 00 00 01 00 02 8a 0b 15 00 00 00 01 00 02 8b 02 15 00 00 00 01 00 02 8c 3b 15 00 00 00 01 00 02 8d 02 15 00 00 00 01 00 02 8e 69 15 00 00 00 01 00 02 8f 02 15 00 00 00 01 00 02 90 6a 15 00 00 00 01 00 02 91 02 15 00 00 00 01 00 02 92 99 15 00 00 00 01 00 02 93 02 15 00 00 00 01 00 02 94 d5 15 00 00 00 01 00 02 95 02 15 00 00 00 01 00 02 96 fd 15 00 00 00 01 00 02 97 03 15 00 00 00 01 00 02 98 30 15 00 00 00 01 00 02 99 03 15 00 00 00 01 00 02 9a 4a 15 00 00 00 01 00 02 9b 03 15 00 00 00 01 00 02 9c 6c 15 00 00 00 01 00 02 9d 03 15 00 00 00 01 00 02 9e 76 15 00 00 00 01 00 02 9f 03 15 00 00 00 01 00 02 a0 81 15 00 00 00 01 00 02 a2 03 15 00 00 00 01 00 02 a3 8e 15 00 00 00 01 00 02 a4 03 15 00 00 00 01 00 02 a5 9b 15 00 00 00 01 00 02 a6 03 15 00 00 00 01 00 02 a7 aa 15 00 00 00 01 00 02 a9 03 15 00 00 00 01 00 02 aa b9 15 00 00 00 01 00 02 ab 03 15 00 00 00 01 00 02 ac c4 15 00 00 00 01 00 02 ad 03 15 00 00 00 01 00 02 ae d5 15 00 00 00 01 00 02 af 01 15 00 00 00 01 00 02 b0 71 15 00 00 00 01 00 02 b1 01 15 00 00 00 01 00 02 b2 75 15 00 00 00 01 00 02 b3 01 15 00 00 00 01 00 02 b4 7c 15 00 00 00 01 00 02 b5 01 15 00 00 00 01 00 02 b6 83 15 00 00 00 01 00 02 b7 01 15 00 00 00 01 00 02 b8 8a 15 00 00 00 01 00 02 b9 01 15 00 00 00 01 00 02 ba 91 15 00 00 00 01 00 02 bb 01 15 00 00 00 01 00 02 bc 98 15 00 00 00 01 00 02 bd 01 15 00 00 00 01 00 02 be 9e 15 00 00 00 01 00 02 bf 01 15 00 00 00 01 00 02 c0 a4 15 00 00 00 01 00 02 c1 01 15 00 00 00 01 00 02 c2 bb 15 00 00 00 01 00 02 c3 01 15 00 00 00 01 00 02 c4 cd 15 00 00 00 01 00 02 c5 01 15 00 00 00 01 00 02 c6 f1 15 00 00 00 01 00 02 c7 02 15 00 00 00 01 00 02 c8 0f 15 00 00 00 01 00 02 c9 02 15 00 00 00 01 00 02 ca 44 15 00 00 00 01 00 02 cb 02 15 00 00 00 01 00 02 cc 72 15 00 00 00 01 00 02 cd 02 15 00 00 00 01 00 02 ce 73 15 00 00 00 01 00 02 cf 02 15 00 00 00 01 00 02 d0 a1 15 00 00 00 01 00 02 d1 02 15 00 00 00 01 00 02 d2 d3 15 00 00 00 01 00 02 d3 02 15 00 00 00 01 00 02 d4 f1 15 00 00 00 01 00 02 d5 03 15 00 00 00 01 00 02 d6 1b 15 00 00 00 01 00 02 d7 03 15 00 00 00 01 00 02 d8 3a 15 00 00 00 01 00 02 d9 03 15 00 00 00 01 00 02 da 62 15 00 00 00 01 00 02 db 03 15 00 00 00 01 00 02 dc 6d 15 00 00 00 01 00 02 dd 03 15 00 00 00 01 00 02 de 7a 15 00 00 00 01 00 02 df 03 15 00 00 00 01 00 02 e0 88 15 00 00 00 01 00 02 e1 03 15 00 00 00 01 00 02 e2 96 15 00 00 00 01 00 02 e3 03 15 00 00 00 01 00 02 e4 a7 15 00 00 00 01 00 02 e5 03 15 00 00 00 01 00 02 e6 b6 15 00 00 00 01 00 02 e7 03 15 00 00 00 01 00 02 e8 c4 15 00 00 00 01 00 02 e9 03 15 00 00 00 01 00 02 ea d5 15 01 00 00 01 00 02 ff 10];
        qcom,mdss-dsi-dispparam-papermode2-command-state = "dsi_hs_mode";
        qcom,mdss-dsi-dispparam-papermode3-command = [15 01 00 00 01 00 02 ff 20 15 00 00 00 01 00 02 fb 01 15 00 00 00 01 00 02 75 00 15 00 00 00 01 00 02 76 14 15 00 00 00 01 00 02 77 00 15 00 00 00 01 00 02 78 2f 15 00 00 00 01 00 02 79 00 15 00 00 00 01 00 02 7a 59 15 00 00 00 01 00 02 7b 00 15 00 00 00 01 00 02 7c 7b 15 00 00 00 01 00 02 7d 00 15 00 00 00 01 00 02 7e 9a 15 00 00 00 01 00 02 7f 00 15 00 00 00 01 00 02 80 b2 15 00 00 00 01 00 02 81 00 15 00 00 00 01 00 02 82 c9 15 00 00 00 01 00 02 83 00 15 00 00 00 01 00 02 84 dd 15 00 00 00 01 00 02 85 00 15 00 00 00 01 00 02 86 ef 15 00 00 00 01 00 02 87 01 15 00 00 00 01 00 02 88 29 15 00 00 00 01 00 02 89 01 15 00 00 00 01 00 02 8a 57 15 00 00 00 01 00 02 8b 01 15 00 00 00 01 00 02 8c 9a 15 00 00 00 01 00 02 8d 01 15 00 00 00 01 00 02 8e cc 15 00 00 00 01 00 02 8f 02 15 00 00 00 01 00 02 90 17 15 00 00 00 01 00 02 91 02 15 00 00 00 01 00 02 92 4e 15 00 00 00 01 00 02 93 02 15 00 00 00 01 00 02 94 50 15 00 00 00 01 00 02 95 02 15 00 00 00 01 00 02 96 84 15 00 00 00 01 00 02 97 02 15 00 00 00 01 00 02 98 c4 15 00 00 00 01 00 02 99 02 15 00 00 00 01 00 02 9a ed 15 00 00 00 01 00 02 9b 03 15 00 00 00 01 00 02 9c 21 15 00 00 00 01 00 02 9d 03 15 00 00 00 01 00 02 9e 3d 15 00 00 00 01 00 02 9f 03 15 00 00 00 01 00 02 a0 62 15 00 00 00 01 00 02 a2 03 15 00 00 00 01 00 02 a3 6d 15 00 00 00 01 00 02 a4 03 15 00 00 00 01 00 02 a5 78 15 00 00 00 01 00 02 a6 03 15 00 00 00 01 00 02 a7 86 15 00 00 00 01 00 02 a9 03 15 00 00 00 01 00 02 aa 96 15 00 00 00 01 00 02 ab 03 15 00 00 00 01 00 02 ac a7 15 00 00 00 01 00 02 ad 03 15 00 00 00 01 00 02 ae bc 15 00 00 00 01 00 02 af 03 15 00 00 00 01 00 02 b0 d0 15 00 00 00 01 00 02 b1 03 15 00 00 00 01 00 02 b2 d5 15 00 00 00 01 00 02 b3 00 15 00 00 00 01 00 02 b4 3b 15 00 00 00 01 00 02 b5 00 15 00 00 00 01 00 02 b6 55 15 00 00 00 01 00 02 b7 00 15 00 00 00 01 00 02 b8 7e 15 00 00 00 01 00 02 b9 00 15 00 00 00 01 00 02 ba a0 15 00 00 00 01 00 02 bb 00 15 00 00 00 01 00 02 bc bd 15 00 00 00 01 00 02 bd 00 15 00 00 00 01 00 02 be d5 15 00 00 00 01 00 02 bf 00 15 00 00 00 01 00 02 c0 ec 15 00 00 00 01 00 02 c1 00 15 00 00 00 01 00 02 c2 fe 15 00 00 00 01 00 02 c3 01 15 00 00 00 01 00 02 c4 10 15 00 00 00 01 00 02 c5 01 15 00 00 00 01 00 02 c6 48 15 00 00 00 01 00 02 c7 01 15 00 00 00 01 00 02 c8 72 15 00 00 00 01 00 02 c9 01 15 00 00 00 01 00 02 ca af 15 00 00 00 01 00 02 cb 01 15 00 00 00 01 00 02 cc dd 15 00 00 00 01 00 02 cd 02 15 00 00 00 01 00 02 ce 20 15 00 00 00 01 00 02 cf 02 15 00 00 00 01 00 02 d0 57 15 00 00 00 01 00 02 d1 02 15 00 00 00 01 00 02 d2 59 15 00 00 00 01 00 02 d3 02 15 00 00 00 01 00 02 d4 8d 15 00 00 00 01 00 02 d5 02 15 00 00 00 01 00 02 d6 c1 15 00 00 00 01 00 02 d7 02 15 00 00 00 01 00 02 d8 e1 15 00 00 00 01 00 02 d9 03 15 00 00 00 01 00 02 da 0c 15 00 00 00 01 00 02 db 03 15 00 00 00 01 00 02 dc 2e 15 00 00 00 01 00 02 dd 03 15 00 00 00 01 00 02 de 57 15 00 00 00 01 00 02 df 03 15 00 00 00 01 00 02 e0 64 15 00 00 00 01 00 02 e1 03 15 00 00 00 01 00 02 e2 71 15 00 00 00 01 00 02 e3 03 15 00 00 00 01 00 02 e4 7f 15 00 00 00 01 00 02 e5 03 15 00 00 00 01 00 02 e6 91 15 00 00 00 01 00 02 e7 03 15 00 00 00 01 00 02 e8 a4 15 00 00 00 01 00 02 e9 03 15 00 00 00 01 00 02 ea b9 15 00 00 00 01 00 02 eb 03 15 00 00 00 01 00 02 ec cf 15 00 00 00 01 00 02 ed 03 15 00 00 00 01 00 02 ee d5 15 00 00 00 01 00 02 ef 00 15 00 00 00 01 00 02 f0 14 15 00 00 00 01 00 02 f1 00 15 00 00 00 01 00 02 f2 2f 15 00 00 00 01 00 02 f3 00 15 00 00 00 01 00 02 f4 59 15 00 00 00 01 00 02 f5 00 15 00 00 00 01 00 02 f6 7b 15 00 00 00 01 00 02 f7 00 15 00 00 00 01 00 02 f8 9a 15 00 00 00 01 00 02 f9 00 15 00 00 00 01 00 02 fa b2 15 01 00 00 01 00 02 ff 21 15 00 00 00 01 00 02 fb 01 15 00 00 00 01 00 02 00 00 15 00 00 00 01 00 02 01 c9 15 00 00 00 01 00 02 02 00 15 00 00 00 01 00 02 03 dd 15 00 00 00 01 00 02 04 00 15 00 00 00 01 00 02 05 ef 15 00 00 00 01 00 02 06 01 15 00 00 00 01 00 02 07 29 15 00 00 00 01 00 02 08 01 15 00 00 00 01 00 02 09 57 15 00 00 00 01 00 02 0a 01 15 00 00 00 01 00 02 0b 9a 15 00 00 00 01 00 02 0c 01 15 00 00 00 01 00 02 0d cc 15 00 00 00 01 00 02 0e 02 15 00 00 00 01 00 02 0f 17 15 00 00 00 01 00 02 10 02 15 00 00 00 01 00 02 11 4e 15 00 00 00 01 00 02 12 02 15 00 00 00 01 00 02 13 50 15 00 00 00 01 00 02 14 02 15 00 00 00 01 00 02 15 84 15 00 00 00 01 00 02 16 02 15 00 00 00 01 00 02 17 c4 15 00 00 00 01 00 02 18 02 15 00 00 00 01 00 02 19 ed 15 00 00 00 01 00 02 1a 03 15 00 00 00 01 00 02 1b 21 15 00 00 00 01 00 02 1c 03 15 00 00 00 01 00 02 1d 3d 15 00 00 00 01 00 02 1e 03 15 00 00 00 01 00 02 1f 62 15 00 00 00 01 00 02 20 03 15 00 00 00 01 00 02 21 6d 15 00 00 00 01 00 02 22 03 15 00 00 00 01 00 02 23 78 15 00 00 00 01 00 02 24 03 15 00 00 00 01 00 02 25 86 15 00 00 00 01 00 02 26 03 15 00 00 00 01 00 02 27 96 15 00 00 00 01 00 02 28 03 15 00 00 00 01 00 02 29 a7 15 00 00 00 01 00 02 2a 03 15 00 00 00 01 00 02 2b bc 15 00 00 00 01 00 02 2d 03 15 00 00 00 01 00 02 2f d0 15 00 00 00 01 00 02 30 03 15 00 00 00 01 00 02 31 d5 15 00 00 00 01 00 02 32 00 15 00 00 00 01 00 02 33 3b 15 00 00 00 01 00 02 34 00 15 00 00 00 01 00 02 35 55 15 00 00 00 01 00 02 36 00 15 00 00 00 01 00 02 37 7e 15 00 00 00 01 00 02 38 00 15 00 00 00 01 00 02 39 a0 15 00 00 00 01 00 02 3a 00 15 00 00 00 01 00 02 3b bd 15 00 00 00 01 00 02 3d 00 15 00 00 00 01 00 02 3f d5 15 00 00 00 01 00 02 40 00 15 00 00 00 01 00 02 41 ec 15 00 00 00 01 00 02 42 00 15 00 00 00 01 00 02 43 fe 15 00 00 00 01 00 02 44 01 15 00 00 00 01 00 02 45 10 15 00 00 00 01 00 02 46 01 15 00 00 00 01 00 02 47 48 15 00 00 00 01 00 02 48 01 15 00 00 00 01 00 02 49 72 15 00 00 00 01 00 02 4a 01 15 00 00 00 01 00 02 4b af 15 00 00 00 01 00 02 4c 01 15 00 00 00 01 00 02 4d dd 15 00 00 00 01 00 02 4e 02 15 00 00 00 01 00 02 4f 20 15 00 00 00 01 00 02 50 02 15 00 00 00 01 00 02 51 57 15 00 00 00 01 00 02 52 02 15 00 00 00 01 00 02 53 59 15 00 00 00 01 00 02 54 02 15 00 00 00 01 00 02 55 8d 15 00 00 00 01 00 02 56 02 15 00 00 00 01 00 02 58 c1 15 00 00 00 01 00 02 59 02 15 00 00 00 01 00 02 5a e1 15 00 00 00 01 00 02 5b 03 15 00 00 00 01 00 02 5c 0c 15 00 00 00 01 00 02 5d 03 15 00 00 00 01 00 02 5e 2e 15 00 00 00 01 00 02 5f 03 15 00 00 00 01 00 02 60 57 15 00 00 00 01 00 02 61 03 15 00 00 00 01 00 02 62 64 15 00 00 00 01 00 02 63 03 15 00 00 00 01 00 02 64 71 15 00 00 00 01 00 02 65 03 15 00 00 00 01 00 02 66 7f 15 00 00 00 01 00 02 67 03 15 00 00 00 01 00 02 68 91 15 00 00 00 01 00 02 69 03 15 00 00 00 01 00 02 6a a4 15 00 00 00 01 00 02 6b 03 15 00 00 00 01 00 02 6c b9 15 00 00 00 01 00 02 6d 03 15 00 00 00 01 00 02 6e cf 15 00 00 00 01 00 02 6f 03 15 00 00 00 01 00 02 70 d5 15 00 00 00 01 00 02 71 01 15 00 00 00 01 00 02 72 aa 15 00 00 00 01 00 02 73 01 15 00 00 00 01 00 02 74 ad 15 00 00 00 01 00 02 75 01 15 00 00 00 01 00 02 76 b1 15 00 00 00 01 00 02 77 01 15 00 00 00 01 00 02 78 b4 15 00 00 00 01 00 02 79 01 15 00 00 00 01 00 02 7a b9 15 00 00 00 01 00 02 7b 01 15 00 00 00 01 00 02 7c c0 15 00 00 00 01 00 02 7d 01 15 00 00 00 01 00 02 7e c4 15 00 00 00 01 00 02 7f 01 15 00 00 00 01 00 02 80 c8 15 00 00 00 01 00 02 81 01 15 00 00 00 01 00 02 82 cc 15 00 00 00 01 00 02 83 01 15 00 00 00 01 00 02 84 dc 15 00 00 00 01 00 02 85 01 15 00 00 00 01 00 02 86 eb 15 00 00 00 01 00 02 87 02 15 00 00 00 01 00 02 88 05 15 00 00 00 01 00 02 89 02 15 00 00 00 01 00 02 8a 1d 15 00 00 00 01 00 02 8b 02 15 00 00 00 01 00 02 8c 49 15 00 00 00 01 00 02 8d 02 15 00 00 00 01 00 02 8e 73 15 00 00 00 01 00 02 8f 02 15 00 00 00 01 00 02 90 75 15 00 00 00 01 00 02 91 02 15 00 00 00 01 00 02 92 a1 15 00 00 00 01 00 02 93 02 15 00 00 00 01 00 02 94 dd 15 00 00 00 01 00 02 95 03 15 00 00 00 01 00 02 96 05 15 00 00 00 01 00 02 97 03 15 00 00 00 01 00 02 98 35 15 00 00 00 01 00 02 99 03 15 00 00 00 01 00 02 9a 51 15 00 00 00 01 00 02 9b 03 15 00 00 00 01 00 02 9c 71 15 00 00 00 01 00 02 9d 03 15 00 00 00 01 00 02 9e 7b 15 00 00 00 01 00 02 9f 03 15 00 00 00 01 00 02 a0 85 15 00 00 00 01 00 02 a2 03 15 00 00 00 01 00 02 a3 91 15 00 00 00 01 00 02 a4 03 15 00 00 00 01 00 02 a5 9f 15 00 00 00 01 00 02 a6 03 15 00 00 00 01 00 02 a7 ad 15 00 00 00 01 00 02 a9 03 15 00 00 00 01 00 02 aa bb 15 00 00 00 01 00 02 ab 03 15 00 00 00 01 00 02 ac c5 15 00 00 00 01 00 02 ad 03 15 00 00 00 01 00 02 ae d5 15 00 00 00 01 00 02 af 01 15 00 00 00 01 00 02 b0 9f 15 00 00 00 01 00 02 b1 01 15 00 00 00 01 00 02 b2 a2 15 00 00 00 01 00 02 b3 01 15 00 00 00 01 00 02 b4 a7 15 00 00 00 01 00 02 b5 01 15 00 00 00 01 00 02 b6 ab 15 00 00 00 01 00 02 b7 01 15 00 00 00 01 00 02 b8 b0 15 00 00 00 01 00 02 b9 01 15 00 00 00 01 00 02 ba b7 15 00 00 00 01 00 02 bb 01 15 00 00 00 01 00 02 bc bc 15 00 00 00 01 00 02 bd 01 15 00 00 00 01 00 02 be c0 15 00 00 00 01 00 02 bf 01 15 00 00 00 01 00 02 c0 c5 15 00 00 00 01 00 02 c1 01 15 00 00 00 01 00 02 c2 d6 15 00 00 00 01 00 02 c3 01 15 00 00 00 01 00 02 c4 e8 15 00 00 00 01 00 02 c5 02 15 00 00 00 01 00 02 c6 06 15 00 00 00 01 00 02 c7 02 15 00 00 00 01 00 02 c8 21 15 00 00 00 01 00 02 c9 02 15 00 00 00 01 00 02 ca 52 15 00 00 00 01 00 02 cb 02 15 00 00 00 01 00 02 cc 7c 15 00 00 00 01 00 02 cd 02 15 00 00 00 01 00 02 ce 7d 15 00 00 00 01 00 02 cf 02 15 00 00 00 01 00 02 d0 aa 15 00 00 00 01 00 02 d1 02 15 00 00 00 01 00 02 d2 db 15 00 00 00 01 00 02 d3 02 15 00 00 00 01 00 02 d4 f9 15 00 00 00 01 00 02 d5 03 15 00 00 00 01 00 02 d6 20 15 00 00 00 01 00 02 d7 03 15 00 00 00 01 00 02 d8 41 15 00 00 00 01 00 02 d9 03 15 00 00 00 01 00 02 da 66 15 00 00 00 01 00 02 db 03 15 00 00 00 01 00 02 dc 72 15 00 00 00 01 00 02 dd 03 15 00 00 00 01 00 02 de 7d 15 00 00 00 01 00 02 df 03 15 00 00 00 01 00 02 e0 8b 15 00 00 00 01 00 02 e1 03 15 00 00 00 01 00 02 e2 9a 15 00 00 00 01 00 02 e3 03 15 00 00 00 01 00 02 e4 a9 15 00 00 00 01 00 02 e5 03 15 00 00 00 01 00 02 e6 b9 15 00 00 00 01 00 02 e7 03 15 00 00 00 01 00 02 e8 c4 15 00 00 00 01 00 02 e9 03 15 00 00 00 01 00 02 ea d5 15 01 00 00 01 00 02 ff 10];
        qcom,mdss-dsi-dispparam-papermode3-command-state = "dsi_hs_mode";
        qcom,mdss-dsi-dispparam-papermode4-command = [15 01 00 00 01 00 02 ff 20 15 00 00 00 01 00 02 fb 01 15 00 00 00 01 00 02 75 00 15 00 00 00 01 00 02 76 14 15 00 00 00 01 00 02 77 00 15 00 00 00 01 00 02 78 2f 15 00 00 00 01 00 02 79 00 15 00 00 00 01 00 02 7a 59 15 00 00 00 01 00 02 7b 00 15 00 00 00 01 00 02 7c 7b 15 00 00 00 01 00 02 7d 00 15 00 00 00 01 00 02 7e 9a 15 00 00 00 01 00 02 7f 00 15 00 00 00 01 00 02 80 b2 15 00 00 00 01 00 02 81 00 15 00 00 00 01 00 02 82 c9 15 00 00 00 01 00 02 83 00 15 00 00 00 01 00 02 84 dd 15 00 00 00 01 00 02 85 00 15 00 00 00 01 00 02 86 ef 15 00 00 00 01 00 02 87 01 15 00 00 00 01 00 02 88 29 15 00 00 00 01 00 02 89 01 15 00 00 00 01 00 02 8a 57 15 00 00 00 01 00 02 8b 01 15 00 00 00 01 00 02 8c 9a 15 00 00 00 01 00 02 8d 01 15 00 00 00 01 00 02 8e cc 15 00 00 00 01 00 02 8f 02 15 00 00 00 01 00 02 90 17 15 00 00 00 01 00 02 91 02 15 00 00 00 01 00 02 92 4e 15 00 00 00 01 00 02 93 02 15 00 00 00 01 00 02 94 50 15 00 00 00 01 00 02 95 02 15 00 00 00 01 00 02 96 84 15 00 00 00 01 00 02 97 02 15 00 00 00 01 00 02 98 c4 15 00 00 00 01 00 02 99 02 15 00 00 00 01 00 02 9a ed 15 00 00 00 01 00 02 9b 03 15 00 00 00 01 00 02 9c 21 15 00 00 00 01 00 02 9d 03 15 00 00 00 01 00 02 9e 3d 15 00 00 00 01 00 02 9f 03 15 00 00 00 01 00 02 a0 62 15 00 00 00 01 00 02 a2 03 15 00 00 00 01 00 02 a3 6d 15 00 00 00 01 00 02 a4 03 15 00 00 00 01 00 02 a5 78 15 00 00 00 01 00 02 a6 03 15 00 00 00 01 00 02 a7 86 15 00 00 00 01 00 02 a9 03 15 00 00 00 01 00 02 aa 96 15 00 00 00 01 00 02 ab 03 15 00 00 00 01 00 02 ac a7 15 00 00 00 01 00 02 ad 03 15 00 00 00 01 00 02 ae bc 15 00 00 00 01 00 02 af 03 15 00 00 00 01 00 02 b0 d0 15 00 00 00 01 00 02 b1 03 15 00 00 00 01 00 02 b2 d5 15 00 00 00 01 00 02 b3 00 15 00 00 00 01 00 02 b4 3b 15 00 00 00 01 00 02 b5 00 15 00 00 00 01 00 02 b6 55 15 00 00 00 01 00 02 b7 00 15 00 00 00 01 00 02 b8 7e 15 00 00 00 01 00 02 b9 00 15 00 00 00 01 00 02 ba a0 15 00 00 00 01 00 02 bb 00 15 00 00 00 01 00 02 bc bd 15 00 00 00 01 00 02 bd 00 15 00 00 00 01 00 02 be d5 15 00 00 00 01 00 02 bf 00 15 00 00 00 01 00 02 c0 ec 15 00 00 00 01 00 02 c1 00 15 00 00 00 01 00 02 c2 fe 15 00 00 00 01 00 02 c3 01 15 00 00 00 01 00 02 c4 10 15 00 00 00 01 00 02 c5 01 15 00 00 00 01 00 02 c6 48 15 00 00 00 01 00 02 c7 01 15 00 00 00 01 00 02 c8 72 15 00 00 00 01 00 02 c9 01 15 00 00 00 01 00 02 ca af 15 00 00 00 01 00 02 cb 01 15 00 00 00 01 00 02 cc dd 15 00 00 00 01 00 02 cd 02 15 00 00 00 01 00 02 ce 20 15 00 00 00 01 00 02 cf 02 15 00 00 00 01 00 02 d0 57 15 00 00 00 01 00 02 d1 02 15 00 00 00 01 00 02 d2 59 15 00 00 00 01 00 02 d3 02 15 00 00 00 01 00 02 d4 8d 15 00 00 00 01 00 02 d5 02 15 00 00 00 01 00 02 d6 c1 15 00 00 00 01 00 02 d7 02 15 00 00 00 01 00 02 d8 e1 15 00 00 00 01 00 02 d9 03 15 00 00 00 01 00 02 da 0c 15 00 00 00 01 00 02 db 03 15 00 00 00 01 00 02 dc 2e 15 00 00 00 01 00 02 dd 03 15 00 00 00 01 00 02 de 57 15 00 00 00 01 00 02 df 03 15 00 00 00 01 00 02 e0 64 15 00 00 00 01 00 02 e1 03 15 00 00 00 01 00 02 e2 71 15 00 00 00 01 00 02 e3 03 15 00 00 00 01 00 02 e4 7f 15 00 00 00 01 00 02 e5 03 15 00 00 00 01 00 02 e6 91 15 00 00 00 01 00 02 e7 03 15 00 00 00 01 00 02 e8 a4 15 00 00 00 01 00 02 e9 03 15 00 00 00 01 00 02 ea b9 15 00 00 00 01 00 02 eb 03 15 00 00 00 01 00 02 ec cf 15 00 00 00 01 00 02 ed 03 15 00 00 00 01 00 02 ee d5 15 00 00 00 01 00 02 ef 00 15 00 00 00 01 00 02 f0 14 15 00 00 00 01 00 02 f1 00 15 00 00 00 01 00 02 f2 2f 15 00 00 00 01 00 02 f3 00 15 00 00 00 01 00 02 f4 59 15 00 00 00 01 00 02 f5 00 15 00 00 00 01 00 02 f6 7b 15 00 00 00 01 00 02 f7 00 15 00 00 00 01 00 02 f8 9a 15 00 00 00 01 00 02 f9 00 15 00 00 00 01 00 02 fa b2 15 01 00 00 01 00 02 ff 21 15 00 00 00 01 00 02 fb 01 15 00 00 00 01 00 02 00 00 15 00 00 00 01 00 02 01 c9 15 00 00 00 01 00 02 02 00 15 00 00 00 01 00 02 03 dd 15 00 00 00 01 00 02 04 00 15 00 00 00 01 00 02 05 ef 15 00 00 00 01 00 02 06 01 15 00 00 00 01 00 02 07 29 15 00 00 00 01 00 02 08 01 15 00 00 00 01 00 02 09 57 15 00 00 00 01 00 02 0a 01 15 00 00 00 01 00 02 0b 9a 15 00 00 00 01 00 02 0c 01 15 00 00 00 01 00 02 0d cc 15 00 00 00 01 00 02 0e 02 15 00 00 00 01 00 02 0f 17 15 00 00 00 01 00 02 10 02 15 00 00 00 01 00 02 11 4e 15 00 00 00 01 00 02 12 02 15 00 00 00 01 00 02 13 50 15 00 00 00 01 00 02 14 02 15 00 00 00 01 00 02 15 84 15 00 00 00 01 00 02 16 02 15 00 00 00 01 00 02 17 c4 15 00 00 00 01 00 02 18 02 15 00 00 00 01 00 02 19 ed 15 00 00 00 01 00 02 1a 03 15 00 00 00 01 00 02 1b 21 15 00 00 00 01 00 02 1c 03 15 00 00 00 01 00 02 1d 3d 15 00 00 00 01 00 02 1e 03 15 00 00 00 01 00 02 1f 62 15 00 00 00 01 00 02 20 03 15 00 00 00 01 00 02 21 6d 15 00 00 00 01 00 02 22 03 15 00 00 00 01 00 02 23 78 15 00 00 00 01 00 02 24 03 15 00 00 00 01 00 02 25 86 15 00 00 00 01 00 02 26 03 15 00 00 00 01 00 02 27 96 15 00 00 00 01 00 02 28 03 15 00 00 00 01 00 02 29 a7 15 00 00 00 01 00 02 2a 03 15 00 00 00 01 00 02 2b bc 15 00 00 00 01 00 02 2d 03 15 00 00 00 01 00 02 2f d0 15 00 00 00 01 00 02 30 03 15 00 00 00 01 00 02 31 d5 15 00 00 00 01 00 02 32 00 15 00 00 00 01 00 02 33 3b 15 00 00 00 01 00 02 34 00 15 00 00 00 01 00 02 35 55 15 00 00 00 01 00 02 36 00 15 00 00 00 01 00 02 37 7e 15 00 00 00 01 00 02 38 00 15 00 00 00 01 00 02 39 a0 15 00 00 00 01 00 02 3a 00 15 00 00 00 01 00 02 3b bd 15 00 00 00 01 00 02 3d 00 15 00 00 00 01 00 02 3f d5 15 00 00 00 01 00 02 40 00 15 00 00 00 01 00 02 41 ec 15 00 00 00 01 00 02 42 00 15 00 00 00 01 00 02 43 fe 15 00 00 00 01 00 02 44 01 15 00 00 00 01 00 02 45 10 15 00 00 00 01 00 02 46 01 15 00 00 00 01 00 02 47 48 15 00 00 00 01 00 02 48 01 15 00 00 00 01 00 02 49 72 15 00 00 00 01 00 02 4a 01 15 00 00 00 01 00 02 4b af 15 00 00 00 01 00 02 4c 01 15 00 00 00 01 00 02 4d dd 15 00 00 00 01 00 02 4e 02 15 00 00 00 01 00 02 4f 20 15 00 00 00 01 00 02 50 02 15 00 00 00 01 00 02 51 57 15 00 00 00 01 00 02 52 02 15 00 00 00 01 00 02 53 59 15 00 00 00 01 00 02 54 02 15 00 00 00 01 00 02 55 8d 15 00 00 00 01 00 02 56 02 15 00 00 00 01 00 02 58 c1 15 00 00 00 01 00 02 59 02 15 00 00 00 01 00 02 5a e1 15 00 00 00 01 00 02 5b 03 15 00 00 00 01 00 02 5c 0c 15 00 00 00 01 00 02 5d 03 15 00 00 00 01 00 02 5e 2e 15 00 00 00 01 00 02 5f 03 15 00 00 00 01 00 02 60 57 15 00 00 00 01 00 02 61 03 15 00 00 00 01 00 02 62 64 15 00 00 00 01 00 02 63 03 15 00 00 00 01 00 02 64 71 15 00 00 00 01 00 02 65 03 15 00 00 00 01 00 02 66 7f 15 00 00 00 01 00 02 67 03 15 00 00 00 01 00 02 68 91 15 00 00 00 01 00 02 69 03 15 00 00 00 01 00 02 6a a4 15 00 00 00 01 00 02 6b 03 15 00 00 00 01 00 02 6c b9 15 00 00 00 01 00 02 6d 03 15 00 00 00 01 00 02 6e cf 15 00 00 00 01 00 02 6f 03 15 00 00 00 01 00 02 70 d5 15 00 00 00 01 00 02 71 01 15 00 00 00 01 00 02 72 d5 15 00 00 00 01 00 02 73 01 15 00 00 00 01 00 02 74 d6 15 00 00 00 01 00 02 75 01 15 00 00 00 01 00 02 76 da 15 00 00 00 01 00 02 77 01 15 00 00 00 01 00 02 78 db 15 00 00 00 01 00 02 79 01 15 00 00 00 01 00 02 7a de 15 00 00 00 01 00 02 7b 01 15 00 00 00 01 00 02 7c e3 15 00 00 00 01 00 02 7d 01 15 00 00 00 01 00 02 7e e8 15 00 00 00 01 00 02 7f 01 15 00 00 00 01 00 02 80 ec 15 00 00 00 01 00 02 81 01 15 00 00 00 01 00 02 82 ef 15 00 00 00 01 00 02 83 01 15 00 00 00 01 00 02 84 fc 15 00 00 00 01 00 02 85 02 15 00 00 00 01 00 02 86 08 15 00 00 00 01 00 02 87 02 15 00 00 00 01 00 02 88 1e 15 00 00 00 01 00 02 89 02 15 00 00 00 01 00 02 8a 31 15 00 00 00 01 00 02 8b 02 15 00 00 00 01 00 02 8c 58 15 00 00 00 01 00 02 8d 02 15 00 00 00 01 00 02 8e 7f 15 00 00 00 01 00 02 8f 02 15 00 00 00 01 00 02 90 80 15 00 00 00 01 00 02 91 02 15 00 00 00 01 00 02 92 ac 15 00 00 00 01 00 02 93 02 15 00 00 00 01 00 02 94 e6 15 00 00 00 01 00 02 95 03 15 00 00 00 01 00 02 96 0c 15 00 00 00 01 00 02 97 03 15 00 00 00 01 00 02 98 3d 15 00 00 00 01 00 02 99 03 15 00 00 00 01 00 02 9a 57 15 00 00 00 01 00 02 9b 03 15 00 00 00 01 00 02 9c 76 15 00 00 00 01 00 02 9d 03 15 00 00 00 01 00 02 9e 80 15 00 00 00 01 00 02 9f 03 15 00 00 00 01 00 02 a0 8a 15 00 00 00 01 00 02 a2 03 15 00 00 00 01 00 02 a3 94 15 00 00 00 01 00 02 a4 03 15 00 00 00 01 00 02 a5 a1 15 00 00 00 01 00 02 a6 03 15 00 00 00 01 00 02 a7 af 15 00 00 00 01 00 02 a9 03 15 00 00 00 01 00 02 aa bb 15 00 00 00 01 00 02 ab 03 15 00 00 00 01 00 02 ac c3 15 00 00 00 01 00 02 ad 03 15 00 00 00 01 00 02 ae d5 15 00 00 00 01 00 02 af 01 15 00 00 00 01 00 02 b0 c8 15 00 00 00 01 00 02 b1 01 15 00 00 00 01 00 02 b2 cb 15 00 00 00 01 00 02 b3 01 15 00 00 00 01 00 02 b4 ce 15 00 00 00 01 00 02 b5 01 15 00 00 00 01 00 02 b6 d0 15 00 00 00 01 00 02 b7 01 15 00 00 00 01 00 02 b8 d4 15 00 00 00 01 00 02 b9 01 15 00 00 00 01 00 02 ba d9 15 00 00 00 01 00 02 bb 01 15 00 00 00 01 00 02 bc df 15 00 00 00 01 00 02 bd 01 15 00 00 00 01 00 02 be e3 15 00 00 00 01 00 02 bf 01 15 00 00 00 01 00 02 c0 e7 15 00 00 00 01 00 02 c1 01 15 00 00 00 01 00 02 c2 f6 15 00 00 00 01 00 02 c3 02 15 00 00 00 01 00 02 c4 04 15 00 00 00 01 00 02 c5 02 15 00 00 00 01 00 02 c6 1d 15 00 00 00 01 00 02 c7 02 15 00 00 00 01 00 02 c8 35 15 00 00 00 01 00 02 c9 02 15 00 00 00 01 00 02 ca 60 15 00 00 00 01 00 02 cb 02 15 00 00 00 01 00 02 cc 88 15 00 00 00 01 00 02 cd 02 15 00 00 00 01 00 02 ce 89 15 00 00 00 01 00 02 cf 02 15 00 00 00 01 00 02 d0 b5 15 00 00 00 01 00 02 d1 02 15 00 00 00 01 00 02 d2 e3 15 00 00 00 01 00 02 d3 03 15 00 00 00 01 00 02 d4 00 15 00 00 00 01 00 02 d5 03 15 00 00 00 01 00 02 d6 28 15 00 00 00 01 00 02 d7 03 15 00 00 00 01 00 02 d8 47 15 00 00 00 01 00 02 d9 03 15 00 00 00 01 00 02 da 6c 15 00 00 00 01 00 02 db 03 15 00 00 00 01 00 02 dc 77 15 00 00 00 01 00 02 dd 03 15 00 00 00 01 00 02 de 82 15 00 00 00 01 00 02 df 03 15 00 00 00 01 00 02 e0 8e 15 00 00 00 01 00 02 e1 03 15 00 00 00 01 00 02 e2 9c 15 00 00 00 01 00 02 e3 03 15 00 00 00 01 00 02 e4 ab 15 00 00 00 01 00 02 e5 03 15 00 00 00 01 00 02 e6 b9 15 00 00 00 01 00 02 e7 03 15 00 00 00 01 00 02 e8 c2 15 00 00 00 01 00 02 e9 03 15 00 00 00 01 00 02 ea d5 15 01 00 00 01 00 02 ff 10];
        qcom,mdss-dsi-dispparam-papermode4-command-state = "dsi_hs_mode";
        qcom,mdss-dsi-dispparam-papermode5-command = [15 01 00 00 01 00 02 ff 20 15 00 00 00 01 00 02 fb 01 15 00 00 00 01 00 02 75 00 15 00 00 00 01 00 02 76 14 15 00 00 00 01 00 02 77 00 15 00 00 00 01 00 02 78 2f 15 00 00 00 01 00 02 79 00 15 00 00 00 01 00 02 7a 59 15 00 00 00 01 00 02 7b 00 15 00 00 00 01 00 02 7c 7b 15 00 00 00 01 00 02 7d 00 15 00 00 00 01 00 02 7e 9a 15 00 00 00 01 00 02 7f 00 15 00 00 00 01 00 02 80 b2 15 00 00 00 01 00 02 81 00 15 00 00 00 01 00 02 82 c9 15 00 00 00 01 00 02 83 00 15 00 00 00 01 00 02 84 dd 15 00 00 00 01 00 02 85 00 15 00 00 00 01 00 02 86 ef 15 00 00 00 01 00 02 87 01 15 00 00 00 01 00 02 88 29 15 00 00 00 01 00 02 89 01 15 00 00 00 01 00 02 8a 57 15 00 00 00 01 00 02 8b 01 15 00 00 00 01 00 02 8c 9a 15 00 00 00 01 00 02 8d 01 15 00 00 00 01 00 02 8e cc 15 00 00 00 01 00 02 8f 02 15 00 00 00 01 00 02 90 17 15 00 00 00 01 00 02 91 02 15 00 00 00 01 00 02 92 4e 15 00 00 00 01 00 02 93 02 15 00 00 00 01 00 02 94 50 15 00 00 00 01 00 02 95 02 15 00 00 00 01 00 02 96 84 15 00 00 00 01 00 02 97 02 15 00 00 00 01 00 02 98 c4 15 00 00 00 01 00 02 99 02 15 00 00 00 01 00 02 9a ed 15 00 00 00 01 00 02 9b 03 15 00 00 00 01 00 02 9c 21 15 00 00 00 01 00 02 9d 03 15 00 00 00 01 00 02 9e 3d 15 00 00 00 01 00 02 9f 03 15 00 00 00 01 00 02 a0 62 15 00 00 00 01 00 02 a2 03 15 00 00 00 01 00 02 a3 6d 15 00 00 00 01 00 02 a4 03 15 00 00 00 01 00 02 a5 78 15 00 00 00 01 00 02 a6 03 15 00 00 00 01 00 02 a7 86 15 00 00 00 01 00 02 a9 03 15 00 00 00 01 00 02 aa 96 15 00 00 00 01 00 02 ab 03 15 00 00 00 01 00 02 ac a7 15 00 00 00 01 00 02 ad 03 15 00 00 00 01 00 02 ae bc 15 00 00 00 01 00 02 af 03 15 00 00 00 01 00 02 b0 d0 15 00 00 00 01 00 02 b1 03 15 00 00 00 01 00 02 b2 d5 15 00 00 00 01 00 02 b3 00 15 00 00 00 01 00 02 b4 3b 15 00 00 00 01 00 02 b5 00 15 00 00 00 01 00 02 b6 55 15 00 00 00 01 00 02 b7 00 15 00 00 00 01 00 02 b8 7e 15 00 00 00 01 00 02 b9 00 15 00 00 00 01 00 02 ba a0 15 00 00 00 01 00 02 bb 00 15 00 00 00 01 00 02 bc bd 15 00 00 00 01 00 02 bd 00 15 00 00 00 01 00 02 be d5 15 00 00 00 01 00 02 bf 00 15 00 00 00 01 00 02 c0 ec 15 00 00 00 01 00 02 c1 00 15 00 00 00 01 00 02 c2 fe 15 00 00 00 01 00 02 c3 01 15 00 00 00 01 00 02 c4 10 15 00 00 00 01 00 02 c5 01 15 00 00 00 01 00 02 c6 48 15 00 00 00 01 00 02 c7 01 15 00 00 00 01 00 02 c8 72 15 00 00 00 01 00 02 c9 01 15 00 00 00 01 00 02 ca af 15 00 00 00 01 00 02 cb 01 15 00 00 00 01 00 02 cc dd 15 00 00 00 01 00 02 cd 02 15 00 00 00 01 00 02 ce 20 15 00 00 00 01 00 02 cf 02 15 00 00 00 01 00 02 d0 57 15 00 00 00 01 00 02 d1 02 15 00 00 00 01 00 02 d2 59 15 00 00 00 01 00 02 d3 02 15 00 00 00 01 00 02 d4 8d 15 00 00 00 01 00 02 d5 02 15 00 00 00 01 00 02 d6 c1 15 00 00 00 01 00 02 d7 02 15 00 00 00 01 00 02 d8 e1 15 00 00 00 01 00 02 d9 03 15 00 00 00 01 00 02 da 0c 15 00 00 00 01 00 02 db 03 15 00 00 00 01 00 02 dc 2e 15 00 00 00 01 00 02 dd 03 15 00 00 00 01 00 02 de 57 15 00 00 00 01 00 02 df 03 15 00 00 00 01 00 02 e0 64 15 00 00 00 01 00 02 e1 03 15 00 00 00 01 00 02 e2 71 15 00 00 00 01 00 02 e3 03 15 00 00 00 01 00 02 e4 7f 15 00 00 00 01 00 02 e5 03 15 00 00 00 01 00 02 e6 91 15 00 00 00 01 00 02 e7 03 15 00 00 00 01 00 02 e8 a4 15 00 00 00 01 00 02 e9 03 15 00 00 00 01 00 02 ea b9 15 00 00 00 01 00 02 eb 03 15 00 00 00 01 00 02 ec cf 15 00 00 00 01 00 02 ed 03 15 00 00 00 01 00 02 ee d5 15 00 00 00 01 00 02 ef 00 15 00 00 00 01 00 02 f0 14 15 00 00 00 01 00 02 f1 00 15 00 00 00 01 00 02 f2 2f 15 00 00 00 01 00 02 f3 00 15 00 00 00 01 00 02 f4 59 15 00 00 00 01 00 02 f5 00 15 00 00 00 01 00 02 f6 7b 15 00 00 00 01 00 02 f7 00 15 00 00 00 01 00 02 f8 9a 15 00 00 00 01 00 02 f9 00 15 00 00 00 01 00 02 fa b2 15 01 00 00 01 00 02 ff 21 15 00 00 00 01 00 02 fb 01 15 00 00 00 01 00 02 00 00 15 00 00 00 01 00 02 01 c9 15 00 00 00 01 00 02 02 00 15 00 00 00 01 00 02 03 dd 15 00 00 00 01 00 02 04 00 15 00 00 00 01 00 02 05 ef 15 00 00 00 01 00 02 06 01 15 00 00 00 01 00 02 07 29 15 00 00 00 01 00 02 08 01 15 00 00 00 01 00 02 09 57 15 00 00 00 01 00 02 0a 01 15 00 00 00 01 00 02 0b 9a 15 00 00 00 01 00 02 0c 01 15 00 00 00 01 00 02 0d cc 15 00 00 00 01 00 02 0e 02 15 00 00 00 01 00 02 0f 17 15 00 00 00 01 00 02 10 02 15 00 00 00 01 00 02 11 4e 15 00 00 00 01 00 02 12 02 15 00 00 00 01 00 02 13 50 15 00 00 00 01 00 02 14 02 15 00 00 00 01 00 02 15 84 15 00 00 00 01 00 02 16 02 15 00 00 00 01 00 02 17 c4 15 00 00 00 01 00 02 18 02 15 00 00 00 01 00 02 19 ed 15 00 00 00 01 00 02 1a 03 15 00 00 00 01 00 02 1b 21 15 00 00 00 01 00 02 1c 03 15 00 00 00 01 00 02 1d 3d 15 00 00 00 01 00 02 1e 03 15 00 00 00 01 00 02 1f 62 15 00 00 00 01 00 02 20 03 15 00 00 00 01 00 02 21 6d 15 00 00 00 01 00 02 22 03 15 00 00 00 01 00 02 23 78 15 00 00 00 01 00 02 24 03 15 00 00 00 01 00 02 25 86 15 00 00 00 01 00 02 26 03 15 00 00 00 01 00 02 27 96 15 00 00 00 01 00 02 28 03 15 00 00 00 01 00 02 29 a7 15 00 00 00 01 00 02 2a 03 15 00 00 00 01 00 02 2b bc 15 00 00 00 01 00 02 2d 03 15 00 00 00 01 00 02 2f d0 15 00 00 00 01 00 02 30 03 15 00 00 00 01 00 02 31 d5 15 00 00 00 01 00 02 32 00 15 00 00 00 01 00 02 33 3b 15 00 00 00 01 00 02 34 00 15 00 00 00 01 00 02 35 55 15 00 00 00 01 00 02 36 00 15 00 00 00 01 00 02 37 7e 15 00 00 00 01 00 02 38 00 15 00 00 00 01 00 02 39 a0 15 00 00 00 01 00 02 3a 00 15 00 00 00 01 00 02 3b bd 15 00 00 00 01 00 02 3d 00 15 00 00 00 01 00 02 3f d5 15 00 00 00 01 00 02 40 00 15 00 00 00 01 00 02 41 ec 15 00 00 00 01 00 02 42 00 15 00 00 00 01 00 02 43 fe 15 00 00 00 01 00 02 44 01 15 00 00 00 01 00 02 45 10 15 00 00 00 01 00 02 46 01 15 00 00 00 01 00 02 47 48 15 00 00 00 01 00 02 48 01 15 00 00 00 01 00 02 49 72 15 00 00 00 01 00 02 4a 01 15 00 00 00 01 00 02 4b af 15 00 00 00 01 00 02 4c 01 15 00 00 00 01 00 02 4d dd 15 00 00 00 01 00 02 4e 02 15 00 00 00 01 00 02 4f 20 15 00 00 00 01 00 02 50 02 15 00 00 00 01 00 02 51 57 15 00 00 00 01 00 02 52 02 15 00 00 00 01 00 02 53 59 15 00 00 00 01 00 02 54 02 15 00 00 00 01 00 02 55 8d 15 00 00 00 01 00 02 56 02 15 00 00 00 01 00 02 58 c1 15 00 00 00 01 00 02 59 02 15 00 00 00 01 00 02 5a e1 15 00 00 00 01 00 02 5b 03 15 00 00 00 01 00 02 5c 0c 15 00 00 00 01 00 02 5d 03 15 00 00 00 01 00 02 5e 2e 15 00 00 00 01 00 02 5f 03 15 00 00 00 01 00 02 60 57 15 00 00 00 01 00 02 61 03 15 00 00 00 01 00 02 62 64 15 00 00 00 01 00 02 63 03 15 00 00 00 01 00 02 64 71 15 00 00 00 01 00 02 65 03 15 00 00 00 01 00 02 66 7f 15 00 00 00 01 00 02 67 03 15 00 00 00 01 00 02 68 91 15 00 00 00 01 00 02 69 03 15 00 00 00 01 00 02 6a a4 15 00 00 00 01 00 02 6b 03 15 00 00 00 01 00 02 6c b9 15 00 00 00 01 00 02 6d 03 15 00 00 00 01 00 02 6e cf 15 00 00 00 01 00 02 6f 03 15 00 00 00 01 00 02 70 d5 15 00 00 00 01 00 02 71 01 15 00 00 00 01 00 02 72 f4 15 00 00 00 01 00 02 73 01 15 00 00 00 01 00 02 74 f5 15 00 00 00 01 00 02 75 01 15 00 00 00 01 00 02 76 f7 15 00 00 00 01 00 02 77 01 15 00 00 00 01 00 02 78 f8 15 00 00 00 01 00 02 79 01 15 00 00 00 01 00 02 7a fa 15 00 00 00 01 00 02 7b 02 15 00 00 00 01 00 02 7c 00 15 00 00 00 01 00 02 7d 02 15 00 00 00 01 00 02 7e 05 15 00 00 00 01 00 02 7f 02 15 00 00 00 01 00 02 80 07 15 00 00 00 01 00 02 81 02 15 00 00 00 01 00 02 82 0a 15 00 00 00 01 00 02 83 02 15 00 00 00 01 00 02 84 14 15 00 00 00 01 00 02 85 02 15 00 00 00 01 00 02 86 1e 15 00 00 00 01 00 02 87 02 15 00 00 00 01 00 02 88 31 15 00 00 00 01 00 02 89 02 15 00 00 00 01 00 02 8a 42 15 00 00 00 01 00 02 8b 02 15 00 00 00 01 00 02 8c 65 15 00 00 00 01 00 02 8d 02 15 00 00 00 01 00 02 8e 8a 15 00 00 00 01 00 02 8f 02 15 00 00 00 01 00 02 90 8c 15 00 00 00 01 00 02 91 02 15 00 00 00 01 00 02 92 b4 15 00 00 00 01 00 02 93 02 15 00 00 00 01 00 02 94 ef 15 00 00 00 01 00 02 95 03 15 00 00 00 01 00 02 96 14 15 00 00 00 01 00 02 97 03 15 00 00 00 01 00 02 98 44 15 00 00 00 01 00 02 99 03 15 00 00 00 01 00 02 9a 5c 15 00 00 00 01 00 02 9b 03 15 00 00 00 01 00 02 9c 7b 15 00 00 00 01 00 02 9d 03 15 00 00 00 01 00 02 9e 84 15 00 00 00 01 00 02 9f 03 15 00 00 00 01 00 02 a0 8f 15 00 00 00 01 00 02 a2 03 15 00 00 00 01 00 02 a3 99 15 00 00 00 01 00 02 a4 03 15 00 00 00 01 00 02 a5 a4 15 00 00 00 01 00 02 a6 03 15 00 00 00 01 00 02 a7 b2 15 00 00 00 01 00 02 a9 03 15 00 00 00 01 00 02 aa bf 15 00 00 00 01 00 02 ab 03 15 00 00 00 01 00 02 ac c8 15 00 00 00 01 00 02 ad 03 15 00 00 00 01 00 02 ae d5 15 00 00 00 01 00 02 af 01 15 00 00 00 01 00 02 b0 e7 15 00 00 00 01 00 02 b1 01 15 00 00 00 01 00 02 b2 e8 15 00 00 00 01 00 02 b3 01 15 00 00 00 01 00 02 b4 eb 15 00 00 00 01 00 02 b5 01 15 00 00 00 01 00 02 b6 ec 15 00 00 00 01 00 02 b7 01 15 00 00 00 01 00 02 b8 ef 15 00 00 00 01 00 02 b9 01 15 00 00 00 01 00 02 ba f5 15 00 00 00 01 00 02 bb 01 15 00 00 00 01 00 02 bc fa 15 00 00 00 01 00 02 bd 01 15 00 00 00 01 00 02 be fe 15 00 00 00 01 00 02 bf 02 15 00 00 00 01 00 02 c0 01 15 00 00 00 01 00 02 c1 02 15 00 00 00 01 00 02 c2 0d 15 00 00 00 01 00 02 c3 02 15 00 00 00 01 00 02 c4 18 15 00 00 00 01 00 02 c5 02 15 00 00 00 01 00 02 c6 30 15 00 00 00 01 00 02 c7 02 15 00 00 00 01 00 02 c8 46 15 00 00 00 01 00 02 c9 02 15 00 00 00 01 00 02 ca 6d 15 00 00 00 01 00 02 cb 02 15 00 00 00 01 00 02 cc 93 15 00 00 00 01 00 02 cd 02 15 00 00 00 01 00 02 ce 94 15 00 00 00 01 00 02 cf 02 15 00 00 00 01 00 02 d0 bd 15 00 00 00 01 00 02 d1 02 15 00 00 00 01 00 02 d2 ec 15 00 00 00 01 00 02 d3 03 15 00 00 00 01 00 02 d4 08 15 00 00 00 01 00 02 d5 03 15 00 00 00 01 00 02 d6 2f 15 00 00 00 01 00 02 d7 03 15 00 00 00 01 00 02 d8 4c 15 00 00 00 01 00 02 d9 03 15 00 00 00 01 00 02 da 71 15 00 00 00 01 00 02 db 03 15 00 00 00 01 00 02 dc 7b 15 00 00 00 01 00 02 dd 03 15 00 00 00 01 00 02 de 87 15 00 00 00 01 00 02 df 03 15 00 00 00 01 00 02 e0 93 15 00 00 00 01 00 02 e1 03 15 00 00 00 01 00 02 e2 9f 15 00 00 00 01 00 02 e3 03 15 00 00 00 01 00 02 e4 ae 15 00 00 00 01 00 02 e5 03 15 00 00 00 01 00 02 e6 bd 15 00 00 00 01 00 02 e7 03 15 00 00 00 01 00 02 e8 c7 15 00 00 00 01 00 02 e9 03 15 00 00 00 01 00 02 ea d5 15 01 00 00 01 00 02 ff 10];
        qcom,mdss-dsi-dispparam-papermode5-command-state = "dsi_hs_mode";
        qcom,mdss-dsi-dispparam-papermode6-command = [15 01 00 00 01 00 02 ff 20 15 00 00 00 01 00 02 fb 01 15 00 00 00 01 00 02 75 00 15 00 00 00 01 00 02 76 14 15 00 00 00 01 00 02 77 00 15 00 00 00 01 00 02 78 2f 15 00 00 00 01 00 02 79 00 15 00 00 00 01 00 02 7a 59 15 00 00 00 01 00 02 7b 00 15 00 00 00 01 00 02 7c 7b 15 00 00 00 01 00 02 7d 00 15 00 00 00 01 00 02 7e 9a 15 00 00 00 01 00 02 7f 00 15 00 00 00 01 00 02 80 b2 15 00 00 00 01 00 02 81 00 15 00 00 00 01 00 02 82 c9 15 00 00 00 01 00 02 83 00 15 00 00 00 01 00 02 84 dd 15 00 00 00 01 00 02 85 00 15 00 00 00 01 00 02 86 ef 15 00 00 00 01 00 02 87 01 15 00 00 00 01 00 02 88 29 15 00 00 00 01 00 02 89 01 15 00 00 00 01 00 02 8a 57 15 00 00 00 01 00 02 8b 01 15 00 00 00 01 00 02 8c 9a 15 00 00 00 01 00 02 8d 01 15 00 00 00 01 00 02 8e cc 15 00 00 00 01 00 02 8f 02 15 00 00 00 01 00 02 90 17 15 00 00 00 01 00 02 91 02 15 00 00 00 01 00 02 92 4e 15 00 00 00 01 00 02 93 02 15 00 00 00 01 00 02 94 50 15 00 00 00 01 00 02 95 02 15 00 00 00 01 00 02 96 84 15 00 00 00 01 00 02 97 02 15 00 00 00 01 00 02 98 c4 15 00 00 00 01 00 02 99 02 15 00 00 00 01 00 02 9a ed 15 00 00 00 01 00 02 9b 03 15 00 00 00 01 00 02 9c 21 15 00 00 00 01 00 02 9d 03 15 00 00 00 01 00 02 9e 3d 15 00 00 00 01 00 02 9f 03 15 00 00 00 01 00 02 a0 62 15 00 00 00 01 00 02 a2 03 15 00 00 00 01 00 02 a3 6d 15 00 00 00 01 00 02 a4 03 15 00 00 00 01 00 02 a5 78 15 00 00 00 01 00 02 a6 03 15 00 00 00 01 00 02 a7 86 15 00 00 00 01 00 02 a9 03 15 00 00 00 01 00 02 aa 96 15 00 00 00 01 00 02 ab 03 15 00 00 00 01 00 02 ac a7 15 00 00 00 01 00 02 ad 03 15 00 00 00 01 00 02 ae bc 15 00 00 00 01 00 02 af 03 15 00 00 00 01 00 02 b0 d0 15 00 00 00 01 00 02 b1 03 15 00 00 00 01 00 02 b2 d5 15 00 00 00 01 00 02 b3 00 15 00 00 00 01 00 02 b4 3b 15 00 00 00 01 00 02 b5 00 15 00 00 00 01 00 02 b6 55 15 00 00 00 01 00 02 b7 00 15 00 00 00 01 00 02 b8 7e 15 00 00 00 01 00 02 b9 00 15 00 00 00 01 00 02 ba a0 15 00 00 00 01 00 02 bb 00 15 00 00 00 01 00 02 bc bd 15 00 00 00 01 00 02 bd 00 15 00 00 00 01 00 02 be d5 15 00 00 00 01 00 02 bf 00 15 00 00 00 01 00 02 c0 ec 15 00 00 00 01 00 02 c1 00 15 00 00 00 01 00 02 c2 fe 15 00 00 00 01 00 02 c3 01 15 00 00 00 01 00 02 c4 10 15 00 00 00 01 00 02 c5 01 15 00 00 00 01 00 02 c6 48 15 00 00 00 01 00 02 c7 01 15 00 00 00 01 00 02 c8 72 15 00 00 00 01 00 02 c9 01 15 00 00 00 01 00 02 ca af 15 00 00 00 01 00 02 cb 01 15 00 00 00 01 00 02 cc dd 15 00 00 00 01 00 02 cd 02 15 00 00 00 01 00 02 ce 20 15 00 00 00 01 00 02 cf 02 15 00 00 00 01 00 02 d0 57 15 00 00 00 01 00 02 d1 02 15 00 00 00 01 00 02 d2 59 15 00 00 00 01 00 02 d3 02 15 00 00 00 01 00 02 d4 8d 15 00 00 00 01 00 02 d5 02 15 00 00 00 01 00 02 d6 c1 15 00 00 00 01 00 02 d7 02 15 00 00 00 01 00 02 d8 e1 15 00 00 00 01 00 02 d9 03 15 00 00 00 01 00 02 da 0c 15 00 00 00 01 00 02 db 03 15 00 00 00 01 00 02 dc 2e 15 00 00 00 01 00 02 dd 03 15 00 00 00 01 00 02 de 57 15 00 00 00 01 00 02 df 03 15 00 00 00 01 00 02 e0 64 15 00 00 00 01 00 02 e1 03 15 00 00 00 01 00 02 e2 71 15 00 00 00 01 00 02 e3 03 15 00 00 00 01 00 02 e4 7f 15 00 00 00 01 00 02 e5 03 15 00 00 00 01 00 02 e6 91 15 00 00 00 01 00 02 e7 03 15 00 00 00 01 00 02 e8 a4 15 00 00 00 01 00 02 e9 03 15 00 00 00 01 00 02 ea b9 15 00 00 00 01 00 02 eb 03 15 00 00 00 01 00 02 ec cf 15 00 00 00 01 00 02 ed 03 15 00 00 00 01 00 02 ee d5 15 00 00 00 01 00 02 ef 00 15 00 00 00 01 00 02 f0 14 15 00 00 00 01 00 02 f1 00 15 00 00 00 01 00 02 f2 2f 15 00 00 00 01 00 02 f3 00 15 00 00 00 01 00 02 f4 59 15 00 00 00 01 00 02 f5 00 15 00 00 00 01 00 02 f6 7b 15 00 00 00 01 00 02 f7 00 15 00 00 00 01 00 02 f8 9a 15 00 00 00 01 00 02 f9 00 15 00 00 00 01 00 02 fa b2 15 01 00 00 01 00 02 ff 21 15 00 00 00 01 00 02 fb 01 15 00 00 00 01 00 02 00 00 15 00 00 00 01 00 02 01 c9 15 00 00 00 01 00 02 02 00 15 00 00 00 01 00 02 03 dd 15 00 00 00 01 00 02 04 00 15 00 00 00 01 00 02 05 ef 15 00 00 00 01 00 02 06 01 15 00 00 00 01 00 02 07 29 15 00 00 00 01 00 02 08 01 15 00 00 00 01 00 02 09 57 15 00 00 00 01 00 02 0a 01 15 00 00 00 01 00 02 0b 9a 15 00 00 00 01 00 02 0c 01 15 00 00 00 01 00 02 0d cc 15 00 00 00 01 00 02 0e 02 15 00 00 00 01 00 02 0f 17 15 00 00 00 01 00 02 10 02 15 00 00 00 01 00 02 11 4e 15 00 00 00 01 00 02 12 02 15 00 00 00 01 00 02 13 50 15 00 00 00 01 00 02 14 02 15 00 00 00 01 00 02 15 84 15 00 00 00 01 00 02 16 02 15 00 00 00 01 00 02 17 c4 15 00 00 00 01 00 02 18 02 15 00 00 00 01 00 02 19 ed 15 00 00 00 01 00 02 1a 03 15 00 00 00 01 00 02 1b 21 15 00 00 00 01 00 02 1c 03 15 00 00 00 01 00 02 1d 3d 15 00 00 00 01 00 02 1e 03 15 00 00 00 01 00 02 1f 62 15 00 00 00 01 00 02 20 03 15 00 00 00 01 00 02 21 6d 15 00 00 00 01 00 02 22 03 15 00 00 00 01 00 02 23 78 15 00 00 00 01 00 02 24 03 15 00 00 00 01 00 02 25 86 15 00 00 00 01 00 02 26 03 15 00 00 00 01 00 02 27 96 15 00 00 00 01 00 02 28 03 15 00 00 00 01 00 02 29 a7 15 00 00 00 01 00 02 2a 03 15 00 00 00 01 00 02 2b bc 15 00 00 00 01 00 02 2d 03 15 00 00 00 01 00 02 2f d0 15 00 00 00 01 00 02 30 03 15 00 00 00 01 00 02 31 d5 15 00 00 00 01 00 02 32 00 15 00 00 00 01 00 02 33 3b 15 00 00 00 01 00 02 34 00 15 00 00 00 01 00 02 35 55 15 00 00 00 01 00 02 36 00 15 00 00 00 01 00 02 37 7e 15 00 00 00 01 00 02 38 00 15 00 00 00 01 00 02 39 a0 15 00 00 00 01 00 02 3a 00 15 00 00 00 01 00 02 3b bd 15 00 00 00 01 00 02 3d 00 15 00 00 00 01 00 02 3f d5 15 00 00 00 01 00 02 40 00 15 00 00 00 01 00 02 41 ec 15 00 00 00 01 00 02 42 00 15 00 00 00 01 00 02 43 fe 15 00 00 00 01 00 02 44 01 15 00 00 00 01 00 02 45 10 15 00 00 00 01 00 02 46 01 15 00 00 00 01 00 02 47 48 15 00 00 00 01 00 02 48 01 15 00 00 00 01 00 02 49 72 15 00 00 00 01 00 02 4a 01 15 00 00 00 01 00 02 4b af 15 00 00 00 01 00 02 4c 01 15 00 00 00 01 00 02 4d dd 15 00 00 00 01 00 02 4e 02 15 00 00 00 01 00 02 4f 20 15 00 00 00 01 00 02 50 02 15 00 00 00 01 00 02 51 57 15 00 00 00 01 00 02 52 02 15 00 00 00 01 00 02 53 59 15 00 00 00 01 00 02 54 02 15 00 00 00 01 00 02 55 8d 15 00 00 00 01 00 02 56 02 15 00 00 00 01 00 02 58 c1 15 00 00 00 01 00 02 59 02 15 00 00 00 01 00 02 5a e1 15 00 00 00 01 00 02 5b 03 15 00 00 00 01 00 02 5c 0c 15 00 00 00 01 00 02 5d 03 15 00 00 00 01 00 02 5e 2e 15 00 00 00 01 00 02 5f 03 15 00 00 00 01 00 02 60 57 15 00 00 00 01 00 02 61 03 15 00 00 00 01 00 02 62 64 15 00 00 00 01 00 02 63 03 15 00 00 00 01 00 02 64 71 15 00 00 00 01 00 02 65 03 15 00 00 00 01 00 02 66 7f 15 00 00 00 01 00 02 67 03 15 00 00 00 01 00 02 68 91 15 00 00 00 01 00 02 69 03 15 00 00 00 01 00 02 6a a4 15 00 00 00 01 00 02 6b 03 15 00 00 00 01 00 02 6c b9 15 00 00 00 01 00 02 6d 03 15 00 00 00 01 00 02 6e cf 15 00 00 00 01 00 02 6f 03 15 00 00 00 01 00 02 70 d5 15 00 00 00 01 00 02 71 02 15 00 00 00 01 00 02 72 10 15 00 00 00 01 00 02 73 02 15 00 00 00 01 00 02 74 12 15 00 00 00 01 00 02 75 02 15 00 00 00 01 00 02 76 12 15 00 00 00 01 00 02 77 02 15 00 00 00 01 00 02 78 12 15 00 00 00 01 00 02 79 02 15 00 00 00 01 00 02 7a 14 15 00 00 00 01 00 02 7b 02 15 00 00 00 01 00 02 7c 1a 15 00 00 00 01 00 02 7d 02 15 00 00 00 01 00 02 7e 1e 15 00 00 00 01 00 02 7f 02 15 00 00 00 01 00 02 80 20 15 00 00 00 01 00 02 81 02 15 00 00 00 01 00 02 82 22 15 00 00 00 01 00 02 83 02 15 00 00 00 01 00 02 84 2b 15 00 00 00 01 00 02 85 02 15 00 00 00 01 00 02 86 33 15 00 00 00 01 00 02 87 02 15 00 00 00 01 00 02 88 43 15 00 00 00 01 00 02 89 02 15 00 00 00 01 00 02 8a 52 15 00 00 00 01 00 02 8b 02 15 00 00 00 01 00 02 8c 71 15 00 00 00 01 00 02 8d 02 15 00 00 00 01 00 02 8e 95 15 00 00 00 01 00 02 8f 02 15 00 00 00 01 00 02 90 97 15 00 00 00 01 00 02 91 02 15 00 00 00 01 00 02 92 be 15 00 00 00 01 00 02 93 02 15 00 00 00 01 00 02 94 f6 15 00 00 00 01 00 02 95 03 15 00 00 00 01 00 02 96 1d 15 00 00 00 01 00 02 97 03 15 00 00 00 01 00 02 98 4b 15 00 00 00 01 00 02 99 03 15 00 00 00 01 00 02 9a 62 15 00 00 00 01 00 02 9b 03 15 00 00 00 01 00 02 9c 81 15 00 00 00 01 00 02 9d 03 15 00 00 00 01 00 02 9e 89 15 00 00 00 01 00 02 9f 03 15 00 00 00 01 00 02 a0 93 15 00 00 00 01 00 02 a2 03 15 00 00 00 01 00 02 a3 9e 15 00 00 00 01 00 02 a4 03 15 00 00 00 01 00 02 a5 a6 15 00 00 00 01 00 02 a6 03 15 00 00 00 01 00 02 a7 b3 15 00 00 00 01 00 02 a9 03 15 00 00 00 01 00 02 aa be 15 00 00 00 01 00 02 ab 03 15 00 00 00 01 00 02 ac c3 15 00 00 00 01 00 02 ad 03 15 00 00 00 01 00 02 ae d5 15 00 00 00 01 00 02 af 02 15 00 00 00 01 00 02 b0 03 15 00 00 00 01 00 02 b1 02 15 00 00 00 01 00 02 b2 04 15 00 00 00 01 00 02 b3 02 15 00 00 00 01 00 02 b4 05 15 00 00 00 01 00 02 b5 02 15 00 00 00 01 00 02 b6 06 15 00 00 00 01 00 02 b7 02 15 00 00 00 01 00 02 b8 08 15 00 00 00 01 00 02 b9 02 15 00 00 00 01 00 02 ba 0e 15 00 00 00 01 00 02 bb 02 15 00 00 00 01 00 02 bc 13 15 00 00 00 01 00 02 bd 02 15 00 00 00 01 00 02 be 15 15 00 00 00 01 00 02 bf 02 15 00 00 00 01 00 02 c0 18 15 00 00 00 01 00 02 c1 02 15 00 00 00 01 00 02 c2 24 15 00 00 00 01 00 02 c3 02 15 00 00 00 01 00 02 c4 2e 15 00 00 00 01 00 02 c5 02 15 00 00 00 01 00 02 c6 42 15 00 00 00 01 00 02 c7 02 15 00 00 00 01 00 02 c8 55 15 00 00 00 01 00 02 c9 02 15 00 00 00 01 00 02 ca 7a 15 00 00 00 01 00 02 cb 02 15 00 00 00 01 00 02 cc 9e 15 00 00 00 01 00 02 cd 02 15 00 00 00 01 00 02 ce 9f 15 00 00 00 01 00 02 cf 02 15 00 00 00 01 00 02 d0 c7 15 00 00 00 01 00 02 d1 02 15 00 00 00 01 00 02 d2 f3 15 00 00 00 01 00 02 d3 03 15 00 00 00 01 00 02 d4 10 15 00 00 00 01 00 02 d5 03 15 00 00 00 01 00 02 d6 35 15 00 00 00 01 00 02 d7 03 15 00 00 00 01 00 02 d8 53 15 00 00 00 01 00 02 d9 03 15 00 00 00 01 00 02 da 76 15 00 00 00 01 00 02 db 03 15 00 00 00 01 00 02 dc 80 15 00 00 00 01 00 02 dd 03 15 00 00 00 01 00 02 de 8b 15 00 00 00 01 00 02 df 03 15 00 00 00 01 00 02 e0 98 15 00 00 00 01 00 02 e1 03 15 00 00 00 01 00 02 e2 a1 15 00 00 00 01 00 02 e3 03 15 00 00 00 01 00 02 e4 af 15 00 00 00 01 00 02 e5 03 15 00 00 00 01 00 02 e6 bc 15 00 00 00 01 00 02 e7 03 15 00 00 00 01 00 02 e8 c2 15 00 00 00 01 00 02 e9 03 15 00 00 00 01 00 02 ea d5 15 01 00 00 01 00 02 ff 10];
        qcom,mdss-dsi-dispparam-papermode6-command-state = "dsi_hs_mode";
        qcom,mdss-dsi-dispparam-papermode7-command = [15 01 00 00 01 00 02 ff 20 15 00 00 00 01 00 02 fb 01 15 00 00 00 01 00 02 75 00 15 00 00 00 01 00 02 76 14 15 00 00 00 01 00 02 77 00 15 00 00 00 01 00 02 78 2f 15 00 00 00 01 00 02 79 00 15 00 00 00 01 00 02 7a 59 15 00 00 00 01 00 02 7b 00 15 00 00 00 01 00 02 7c 7b 15 00 00 00 01 00 02 7d 00 15 00 00 00 01 00 02 7e 9a 15 00 00 00 01 00 02 7f 00 15 00 00 00 01 00 02 80 b2 15 00 00 00 01 00 02 81 00 15 00 00 00 01 00 02 82 c9 15 00 00 00 01 00 02 83 00 15 00 00 00 01 00 02 84 dd 15 00 00 00 01 00 02 85 00 15 00 00 00 01 00 02 86 ef 15 00 00 00 01 00 02 87 01 15 00 00 00 01 00 02 88 29 15 00 00 00 01 00 02 89 01 15 00 00 00 01 00 02 8a 57 15 00 00 00 01 00 02 8b 01 15 00 00 00 01 00 02 8c 9a 15 00 00 00 01 00 02 8d 01 15 00 00 00 01 00 02 8e cc 15 00 00 00 01 00 02 8f 02 15 00 00 00 01 00 02 90 17 15 00 00 00 01 00 02 91 02 15 00 00 00 01 00 02 92 4e 15 00 00 00 01 00 02 93 02 15 00 00 00 01 00 02 94 50 15 00 00 00 01 00 02 95 02 15 00 00 00 01 00 02 96 84 15 00 00 00 01 00 02 97 02 15 00 00 00 01 00 02 98 c4 15 00 00 00 01 00 02 99 02 15 00 00 00 01 00 02 9a ed 15 00 00 00 01 00 02 9b 03 15 00 00 00 01 00 02 9c 21 15 00 00 00 01 00 02 9d 03 15 00 00 00 01 00 02 9e 3d 15 00 00 00 01 00 02 9f 03 15 00 00 00 01 00 02 a0 62 15 00 00 00 01 00 02 a2 03 15 00 00 00 01 00 02 a3 6d 15 00 00 00 01 00 02 a4 03 15 00 00 00 01 00 02 a5 78 15 00 00 00 01 00 02 a6 03 15 00 00 00 01 00 02 a7 86 15 00 00 00 01 00 02 a9 03 15 00 00 00 01 00 02 aa 96 15 00 00 00 01 00 02 ab 03 15 00 00 00 01 00 02 ac a7 15 00 00 00 01 00 02 ad 03 15 00 00 00 01 00 02 ae bc 15 00 00 00 01 00 02 af 03 15 00 00 00 01 00 02 b0 d0 15 00 00 00 01 00 02 b1 03 15 00 00 00 01 00 02 b2 d5 15 00 00 00 01 00 02 b3 00 15 00 00 00 01 00 02 b4 3b 15 00 00 00 01 00 02 b5 00 15 00 00 00 01 00 02 b6 55 15 00 00 00 01 00 02 b7 00 15 00 00 00 01 00 02 b8 7e 15 00 00 00 01 00 02 b9 00 15 00 00 00 01 00 02 ba a0 15 00 00 00 01 00 02 bb 00 15 00 00 00 01 00 02 bc bd 15 00 00 00 01 00 02 bd 00 15 00 00 00 01 00 02 be d5 15 00 00 00 01 00 02 bf 00 15 00 00 00 01 00 02 c0 ec 15 00 00 00 01 00 02 c1 00 15 00 00 00 01 00 02 c2 fe 15 00 00 00 01 00 02 c3 01 15 00 00 00 01 00 02 c4 10 15 00 00 00 01 00 02 c5 01 15 00 00 00 01 00 02 c6 48 15 00 00 00 01 00 02 c7 01 15 00 00 00 01 00 02 c8 72 15 00 00 00 01 00 02 c9 01 15 00 00 00 01 00 02 ca af 15 00 00 00 01 00 02 cb 01 15 00 00 00 01 00 02 cc dd 15 00 00 00 01 00 02 cd 02 15 00 00 00 01 00 02 ce 20 15 00 00 00 01 00 02 cf 02 15 00 00 00 01 00 02 d0 57 15 00 00 00 01 00 02 d1 02 15 00 00 00 01 00 02 d2 59 15 00 00 00 01 00 02 d3 02 15 00 00 00 01 00 02 d4 8d 15 00 00 00 01 00 02 d5 02 15 00 00 00 01 00 02 d6 c1 15 00 00 00 01 00 02 d7 02 15 00 00 00 01 00 02 d8 e1 15 00 00 00 01 00 02 d9 03 15 00 00 00 01 00 02 da 0c 15 00 00 00 01 00 02 db 03 15 00 00 00 01 00 02 dc 2e 15 00 00 00 01 00 02 dd 03 15 00 00 00 01 00 02 de 57 15 00 00 00 01 00 02 df 03 15 00 00 00 01 00 02 e0 64 15 00 00 00 01 00 02 e1 03 15 00 00 00 01 00 02 e2 71 15 00 00 00 01 00 02 e3 03 15 00 00 00 01 00 02 e4 7f 15 00 00 00 01 00 02 e5 03 15 00 00 00 01 00 02 e6 91 15 00 00 00 01 00 02 e7 03 15 00 00 00 01 00 02 e8 a4 15 00 00 00 01 00 02 e9 03 15 00 00 00 01 00 02 ea b9 15 00 00 00 01 00 02 eb 03 15 00 00 00 01 00 02 ec cf 15 00 00 00 01 00 02 ed 03 15 00 00 00 01 00 02 ee d5 15 00 00 00 01 00 02 ef 00 15 00 00 00 01 00 02 f0 14 15 00 00 00 01 00 02 f1 00 15 00 00 00 01 00 02 f2 2f 15 00 00 00 01 00 02 f3 00 15 00 00 00 01 00 02 f4 59 15 00 00 00 01 00 02 f5 00 15 00 00 00 01 00 02 f6 7b 15 00 00 00 01 00 02 f7 00 15 00 00 00 01 00 02 f8 9a 15 00 00 00 01 00 02 f9 00 15 00 00 00 01 00 02 fa b2 15 01 00 00 01 00 02 ff 21 15 00 00 00 01 00 02 fb 01 15 00 00 00 01 00 02 00 00 15 00 00 00 01 00 02 01 c9 15 00 00 00 01 00 02 02 00 15 00 00 00 01 00 02 03 dd 15 00 00 00 01 00 02 04 00 15 00 00 00 01 00 02 05 ef 15 00 00 00 01 00 02 06 01 15 00 00 00 01 00 02 07 29 15 00 00 00 01 00 02 08 01 15 00 00 00 01 00 02 09 57 15 00 00 00 01 00 02 0a 01 15 00 00 00 01 00 02 0b 9a 15 00 00 00 01 00 02 0c 01 15 00 00 00 01 00 02 0d cc 15 00 00 00 01 00 02 0e 02 15 00 00 00 01 00 02 0f 17 15 00 00 00 01 00 02 10 02 15 00 00 00 01 00 02 11 4e 15 00 00 00 01 00 02 12 02 15 00 00 00 01 00 02 13 50 15 00 00 00 01 00 02 14 02 15 00 00 00 01 00 02 15 84 15 00 00 00 01 00 02 16 02 15 00 00 00 01 00 02 17 c4 15 00 00 00 01 00 02 18 02 15 00 00 00 01 00 02 19 ed 15 00 00 00 01 00 02 1a 03 15 00 00 00 01 00 02 1b 21 15 00 00 00 01 00 02 1c 03 15 00 00 00 01 00 02 1d 3d 15 00 00 00 01 00 02 1e 03 15 00 00 00 01 00 02 1f 62 15 00 00 00 01 00 02 20 03 15 00 00 00 01 00 02 21 6d 15 00 00 00 01 00 02 22 03 15 00 00 00 01 00 02 23 78 15 00 00 00 01 00 02 24 03 15 00 00 00 01 00 02 25 86 15 00 00 00 01 00 02 26 03 15 00 00 00 01 00 02 27 96 15 00 00 00 01 00 02 28 03 15 00 00 00 01 00 02 29 a7 15 00 00 00 01 00 02 2a 03 15 00 00 00 01 00 02 2b bc 15 00 00 00 01 00 02 2d 03 15 00 00 00 01 00 02 2f d0 15 00 00 00 01 00 02 30 03 15 00 00 00 01 00 02 31 d5 15 00 00 00 01 00 02 32 00 15 00 00 00 01 00 02 33 3b 15 00 00 00 01 00 02 34 00 15 00 00 00 01 00 02 35 55 15 00 00 00 01 00 02 36 00 15 00 00 00 01 00 02 37 7e 15 00 00 00 01 00 02 38 00 15 00 00 00 01 00 02 39 a0 15 00 00 00 01 00 02 3a 00 15 00 00 00 01 00 02 3b bd 15 00 00 00 01 00 02 3d 00 15 00 00 00 01 00 02 3f d5 15 00 00 00 01 00 02 40 00 15 00 00 00 01 00 02 41 ec 15 00 00 00 01 00 02 42 00 15 00 00 00 01 00 02 43 fe 15 00 00 00 01 00 02 44 01 15 00 00 00 01 00 02 45 10 15 00 00 00 01 00 02 46 01 15 00 00 00 01 00 02 47 48 15 00 00 00 01 00 02 48 01 15 00 00 00 01 00 02 49 72 15 00 00 00 01 00 02 4a 01 15 00 00 00 01 00 02 4b af 15 00 00 00 01 00 02 4c 01 15 00 00 00 01 00 02 4d dd 15 00 00 00 01 00 02 4e 02 15 00 00 00 01 00 02 4f 20 15 00 00 00 01 00 02 50 02 15 00 00 00 01 00 02 51 57 15 00 00 00 01 00 02 52 02 15 00 00 00 01 00 02 53 59 15 00 00 00 01 00 02 54 02 15 00 00 00 01 00 02 55 8d 15 00 00 00 01 00 02 56 02 15 00 00 00 01 00 02 58 c1 15 00 00 00 01 00 02 59 02 15 00 00 00 01 00 02 5a e1 15 00 00 00 01 00 02 5b 03 15 00 00 00 01 00 02 5c 0c 15 00 00 00 01 00 02 5d 03 15 00 00 00 01 00 02 5e 2e 15 00 00 00 01 00 02 5f 03 15 00 00 00 01 00 02 60 57 15 00 00 00 01 00 02 61 03 15 00 00 00 01 00 02 62 64 15 00 00 00 01 00 02 63 03 15 00 00 00 01 00 02 64 71 15 00 00 00 01 00 02 65 03 15 00 00 00 01 00 02 66 7f 15 00 00 00 01 00 02 67 03 15 00 00 00 01 00 02 68 91 15 00 00 00 01 00 02 69 03 15 00 00 00 01 00 02 6a a4 15 00 00 00 01 00 02 6b 03 15 00 00 00 01 00 02 6c b9 15 00 00 00 01 00 02 6d 03 15 00 00 00 01 00 02 6e cf 15 00 00 00 01 00 02 6f 03 15 00 00 00 01 00 02 70 d5 15 00 00 00 01 00 02 71 02 15 00 00 00 01 00 02 72 29 15 00 00 00 01 00 02 73 02 15 00 00 00 01 00 02 74 28 15 00 00 00 01 00 02 75 02 15 00 00 00 01 00 02 76 28 15 00 00 00 01 00 02 77 02 15 00 00 00 01 00 02 78 2a 15 00 00 00 01 00 02 79 02 15 00 00 00 01 00 02 7a 2f 15 00 00 00 01 00 02 7b 02 15 00 00 00 01 00 02 7c 32 15 00 00 00 01 00 02 7d 02 15 00 00 00 01 00 02 7e 34 15 00 00 00 01 00 02 7f 02 15 00 00 00 01 00 02 80 36 15 00 00 00 01 00 02 81 02 15 00 00 00 01 00 02 82 37 15 00 00 00 01 00 02 83 02 15 00 00 00 01 00 02 84 3f 15 00 00 00 01 00 02 85 02 15 00 00 00 01 00 02 86 46 15 00 00 00 01 00 02 87 02 15 00 00 00 01 00 02 88 54 15 00 00 00 01 00 02 89 02 15 00 00 00 01 00 02 8a 62 15 00 00 00 01 00 02 8b 02 15 00 00 00 01 00 02 8c 7e 15 00 00 00 01 00 02 8d 02 15 00 00 00 01 00 02 8e a0 15 00 00 00 01 00 02 8f 02 15 00 00 00 01 00 02 90 a2 15 00 00 00 01 00 02 91 02 15 00 00 00 01 00 02 92 c9 15 00 00 00 01 00 02 93 03 15 00 00 00 01 00 02 94 00 15 00 00 00 01 00 02 95 03 15 00 00 00 01 00 02 96 25 15 00 00 00 01 00 02 97 03 15 00 00 00 01 00 02 98 53 15 00 00 00 01 00 02 99 03 15 00 00 00 01 00 02 9a 69 15 00 00 00 01 00 02 9b 03 15 00 00 00 01 00 02 9c 86 15 00 00 00 01 00 02 9d 03 15 00 00 00 01 00 02 9e 8f 15 00 00 00 01 00 02 9f 03 15 00 00 00 01 00 02 a0 96 15 00 00 00 01 00 02 a2 03 15 00 00 00 01 00 02 a3 a1 15 00 00 00 01 00 02 a4 03 15 00 00 00 01 00 02 a5 aa 15 00 00 00 01 00 02 a6 03 15 00 00 00 01 00 02 a7 b4 15 00 00 00 01 00 02 a9 03 15 00 00 00 01 00 02 aa bf 15 00 00 00 01 00 02 ab 03 15 00 00 00 01 00 02 ac c3 15 00 00 00 01 00 02 ad 03 15 00 00 00 01 00 02 ae d5 15 00 00 00 01 00 02 af 02 15 00 00 00 01 00 02 b0 1b 15 00 00 00 01 00 02 b1 02 15 00 00 00 01 00 02 b2 1b 15 00 00 00 01 00 02 b3 02 15 00 00 00 01 00 02 b4 1c 15 00 00 00 01 00 02 b5 02 15 00 00 00 01 00 02 b6 1e 15 00 00 00 01 00 02 b7 02 15 00 00 00 01 00 02 b8 23 15 00 00 00 01 00 02 b9 02 15 00 00 00 01 00 02 ba 27 15 00 00 00 01 00 02 bb 02 15 00 00 00 01 00 02 bc 29 15 00 00 00 01 00 02 bd 02 15 00 00 00 01 00 02 be 2c 15 00 00 00 01 00 02 bf 02 15 00 00 00 01 00 02 c0 2e 15 00 00 00 01 00 02 c1 02 15 00 00 00 01 00 02 c2 37 15 00 00 00 01 00 02 c3 02 15 00 00 00 01 00 02 c4 41 15 00 00 00 01 00 02 c5 02 15 00 00 00 01 00 02 c6 53 15 00 00 00 01 00 02 c7 02 15 00 00 00 01 00 02 c8 65 15 00 00 00 01 00 02 c9 02 15 00 00 00 01 00 02 ca 87 15 00 00 00 01 00 02 cb 02 15 00 00 00 01 00 02 cc a9 15 00 00 00 01 00 02 cd 02 15 00 00 00 01 00 02 ce aa 15 00 00 00 01 00 02 cf 02 15 00 00 00 01 00 02 d0 d2 15 00 00 00 01 00 02 d1 02 15 00 00 00 01 00 02 d2 fd 15 00 00 00 01 00 02 d3 03 15 00 00 00 01 00 02 d4 19 15 00 00 00 01 00 02 d5 03 15 00 00 00 01 00 02 d6 3d 15 00 00 00 01 00 02 d7 03 15 00 00 00 01 00 02 d8 59 15 00 00 00 01 00 02 d9 03 15 00 00 00 01 00 02 da 7b 15 00 00 00 01 00 02 db 03 15 00 00 00 01 00 02 dc 86 15 00 00 00 01 00 02 dd 03 15 00 00 00 01 00 02 de 8f 15 00 00 00 01 00 02 df 03 15 00 00 00 01 00 02 e0 9b 15 00 00 00 01 00 02 e1 03 15 00 00 00 01 00 02 e2 a6 15 00 00 00 01 00 02 e3 03 15 00 00 00 01 00 02 e4 b0 15 00 00 00 01 00 02 e5 03 15 00 00 00 01 00 02 e6 bd 15 00 00 00 01 00 02 e7 03 15 00 00 00 01 00 02 e8 c3 15 00 00 00 01 00 02 e9 03 15 00 00 00 01 00 02 ea d5 15 01 00 00 01 00 02 ff 10];
        qcom,mdss-dsi-dispparam-papermode7-command-state = "dsi_hs_mode";
	};
};
