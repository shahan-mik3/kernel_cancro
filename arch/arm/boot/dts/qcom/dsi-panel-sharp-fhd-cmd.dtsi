/* Copyright (c) 2012-2013, The Linux Foundation. All rights reserved.
 *
 * This program is free software; you can redistribute it and/or modify
 * it under the terms of the GNU General Public License version 2 and
 * only version 2 as published by the Free Software Foundation.
 *
 * This program is distributed in the hope that it will be useful,
 * but WITHOUT ANY WARRANTY; without even the implied warranty of
 * MERCHANTABILITY or FITNESS FOR A PARTICULAR PURPOSE.  See the
 * GNU General Public License for more details.
 */

/*---------------------------------------------------------------------------
 * This file is autogenerated file using gcdb parser. Please do not edit it.
 * Update input XML file to add a new entry or update variable in this file
 * VERSION = "1.0"
 *---------------------------------------------------------------------------*/
&soc {
	dsi_sharp_fhd_cmd: qcom,mdss_dsi_sharp_fhd_cmd {
		compatible = "qcom,mdss-dsi-panel";
		status = "okay";
		qcom,mdss-dsi-panel-name = "sharp fhd cmd mode dsi panel";
		qcom,mdss-dsi-panel-id = <3>;
		qcom,mdss-dsi-panel-controller = <&mdss_dsi0>;
		qcom,mdss-dsi-panel-type = "dsi_cmd_mode";
		qcom,mdss-dsi-panel-destination = "display_1";
		qcom,mdss-dsi-panel-framerate = <60>;
		qcom,mdss-dsi-virtual-channel-id = <0>;
		qcom,mdss-dsi-stream = <0>;
		qcom,mdss-dsi-panel-width = <1080>;
		qcom,mdss-dsi-panel-height = <1920>;
		qcom,mdss-dsi-h-front-porch = <80>;
		qcom,mdss-dsi-h-back-porch = <40>;
		qcom,mdss-dsi-h-pulse-width = <10>;
		qcom,mdss-dsi-h-sync-skew = <0>;
		qcom,mdss-dsi-v-back-porch = <4>;
		qcom,mdss-dsi-v-front-porch = <4>;
		qcom,mdss-dsi-v-pulse-width = <2>;
		qcom,mdss-dsi-h-left-border = <0>;
		qcom,mdss-dsi-h-right-border = <0>;
		qcom,mdss-dsi-v-top-border = <0>;
		qcom,mdss-dsi-v-bottom-border = <0>;
		qcom,mdss-dsi-bpp = <24>;
		qcom,mdss-dsi-color-order = <0>;
		qcom,mdss-dsi-underflow-color = <0xff>;
		qcom,mdss-dsi-border-color = <0>;
		qcom,mdss-dsi-on-command = [
			15 01 00 00 01 00 02 FF 10
			15 01 00 00 01 00 02 BB 10
			15 01 00 00 01 00 02 B0 03

			15 00 00 00 01 00 02 FF 24
			15 00 00 00 01 00 02 C4 69
			15 00 00 00 01 00 02 C9 00
			15 01 00 00 01 00 02 FB 01

			15 01 00 00 01 00 02 FF 22
			15 01 00 00 01 00 02 FB 01
			15 01 00 00 01 00 02 00 28
			15 01 00 00 01 00 02 01 2C
			15 01 00 00 01 00 02 02 30
			15 01 00 00 01 00 02 03 34
			15 01 00 00 01 00 02 04 38
			15 01 00 00 01 00 02 05 3C
			15 01 00 00 01 00 02 06 40
			15 01 00 00 01 00 02 07 48
			15 01 00 00 01 00 02 08 4C
			15 01 00 00 01 00 02 09 50
			15 01 00 00 01 00 02 0A 58
			15 01 00 00 01 00 02 0B 60
			15 01 00 00 01 00 02 0C 60
			15 01 00 00 01 00 02 0D 58
			15 01 00 00 01 00 02 0E 50
			15 01 00 00 01 00 02 0F 48
			15 01 00 00 01 00 02 10 38
			15 01 00 00 01 00 02 11 28
			15 01 00 00 01 00 02 12 28
			15 01 00 00 01 00 02 13 28
			15 01 00 00 01 00 02 1B 00
			15 01 00 00 01 00 02 1C 00
			15 01 00 00 01 00 02 1D 00
			15 01 00 00 01 00 02 1E 00
			15 01 00 00 01 00 02 1F 00
			15 01 00 00 01 00 02 20 00
			15 01 00 00 01 00 02 21 00
			15 01 00 00 01 00 02 22 00
			15 01 00 00 01 00 02 23 00
			15 01 00 00 01 00 02 24 00
			15 01 00 00 01 00 02 25 00
			15 01 00 00 01 00 02 26 00
			15 01 00 00 01 00 02 27 00
			15 01 00 00 01 00 02 28 00
			15 01 00 00 01 00 02 29 00
			15 01 00 00 01 00 02 2A 00
			15 01 00 00 01 00 02 2B 00
			15 01 00 00 01 00 02 2F 00
			15 01 00 00 01 00 02 30 00
			15 01 00 00 01 00 02 31 00
			15 01 00 00 01 00 02 32 80
			15 01 00 00 01 00 02 33 80
			15 01 00 00 01 00 02 34 80
			15 01 00 00 01 00 02 35 82
			15 01 00 00 01 00 02 36 84
			15 01 00 00 01 00 02 37 86
			15 01 00 00 01 00 02 38 88
			15 01 00 00 01 00 02 39 8A
			15 01 00 00 01 00 02 3A 8C
			15 01 00 00 01 00 02 3B 8E
			15 01 00 00 01 00 02 3F 90
			15 01 00 00 01 00 02 40 92
			15 01 00 00 01 00 02 41 94
			15 01 00 00 01 00 02 42 94
			15 01 00 00 01 00 02 43 92
			15 01 00 00 01 00 02 44 90
			15 01 00 00 01 00 02 45 8E
			15 01 00 00 01 00 02 46 8C
			15 01 00 00 01 00 02 47 8A
			15 01 00 00 01 00 02 48 88
			15 01 00 00 01 00 02 49 86
			15 01 00 00 01 00 02 4A 84
			15 01 00 00 01 00 02 4B 82
			15 01 00 00 01 00 02 4C 80
			15 01 00 00 01 00 02 4D 08
			15 01 00 00 01 00 02 1A 00
			15 01 00 00 01 00 02 53 01
			15 01 00 00 01 00 02 54 01
			15 01 00 00 01 00 02 56 00
			15 01 00 00 01 00 02 64 2F
			15 01 00 00 01 00 02 68 00

			15 01 00 00 01 00 02 FF 10
			15 01 00 00 01 00 02 35 00
			05 01 00 00 78 00 02 11 00
			15 01 00 00 01 00 02 51 ff
			15 01 00 00 01 00 02 53 2c
			15 01 00 00 01 00 02 55 80
			15 01 00 00 01 00 02 FF F0
			15 01 00 00 01 00 02 92 01
			15 01 00 00 01 00 02 13 01
			15 01 00 00 01 00 02 FF 10
			05 01 00 00 28 00 02 29 00
			];
		qcom,mdss-dsi-off-command = [
			15 01 00 00 00 00 02 FF 10
			39 01 00 00 11 00 02 28 00
			39 01 00 00 44 00 02 10 00
			];
		qcom,mdss-dsi-on-command-state = "dsi_lp_mode";
		qcom,mdss-dsi-off-command-state = "dsi_hs_mode";
		qcom,mdss-dsi-h-sync-pulse = <0>;
		qcom,mdss-dsi-traffic-mode = <1>;
		qcom,mdss-dsi-lane-map = <0>;
		qcom,mdss-dsi-bllp-eof-power-mode;
		qcom,mdss-dsi-bllp-power-mode;
		qcom,mdss-dsi-lane-0-state;
		qcom,mdss-dsi-lane-1-state;
		qcom,mdss-dsi-lane-2-state;
		qcom,mdss-dsi-lane-3-state;
		qcom,mdss-dsi-te-pin-select = <1>;
		qcom,mdss-dsi-te-v-sync-rd-ptr-irq-line = <0x2c>;
		qcom,mdss-dsi-te-v-sync-continues-lines = <0x3c>;
		qcom,mdss-dsi-te-dcs-command = <1>;
		qcom,mdss-dsi-te-check-enable;
		qcom,mdss-dsi-te-using-te-pin;
		qcom,mdss-dsi-panel-timings = [e3 50 36 00 a9 a3 3a 50 3d 03 04 00];
		qcom,mdss-dsi-t-clk-post = <0x20>;
		qcom,mdss-dsi-t-clk-pre = <0x36>;
		qcom,mdss-dsi-bl-min-level = <8>;
		qcom,mdss-dsi-bl-max-level = <4095>;
		qcom,mdss-dsi-dma-trigger = <0x04>;
		qcom,mdss-dsi-mdp-trigger = <0x0>;
		qcom,mdss-dsi-bl-pmic-control-type = "bl_ctrl_wled";
		qcom,mdss-dsi-reset-sequence = <1 20>, <0 20>, <1 20>;
		qcom,mdss-pan-physical-width-dimension = <61>;
		qcom,mdss-pan-physical-height-dimension = <109>;
        qcom,dispparam-enabled;
        qcom,mdss-dsi-dispparam-cabcon-command = [15 00 00 00 01 00 02 ff 10 15 01 00 00 10 00 02 55 82];
        qcom,mdss-dsi-dispparam-cabcguion-command = [15 00 00 00 01 00 02 ff 10 15 01 00 00 10 00 02 55 81];
        qcom,mdss-dsi-dispparam-cabcstillon-command = [15 00 00 00 01 00 02 ff 10 15 01 00 00 10 00 02 55 82];
        qcom,mdss-dsi-dispparam-cabcmovieon-command = [15 00 00 00 01 00 02 ff 10 15 01 00 00 10 00 02 55 83];
        qcom,mdss-dsi-dispparam-cabcon-command-state = "dsi_hs_mode";
        qcom,mdss-dsi-dispparam-cabcoff-command = [15 00 00 00 01 00 02 ff 10 15 01 00 00 10 00 02 55 80];
        qcom,mdss-dsi-dispparam-cabcoff-command-state = "dsi_hs_mode";
        qcom,mdss-dsi-dispparam-gammareload-command = [15 00 00 00 01 00 02 ff 20 15 00 00 00 01 00 02 fb 00 15 00 00 00 01 00 02 ff 21 15 00 00 00 01 00 02 fb 00 15 00 00 00 01 00 02 ff 10 05 01 00 00 10 00 02 11 00];
        qcom,mdss-dsi-dispparam-gammareload-command-state = "dsi_hs_mode";
        qcom,mdss-dsi-dispparam-warm-command = [15 00 00 00 01 00 02 ff 20 15 00 00 00 01 00 02 75 00 15 00 00 00 01 00 02 76 9c 15 00 00 00 01 00 02 77 00 15 00 00 00 01 00 02 78 a9 15 00 00 00 01 00 02 79 00 15 00 00 00 01 00 02 7a c4 15 00 00 00 01 00 02 7b 00 15 00 00 00 01 00 02 7c d8 15 00 00 00 01 00 02 7d 00 15 00 00 00 01 00 02 7e eb 15 00 00 00 01 00 02 7f 00 15 00 00 00 01 00 02 80 fb 15 00 00 00 01 00 02 81 01 15 00 00 00 01 00 02 82 09 15 00 00 00 01 00 02 83 01 15 00 00 00 01 00 02 84 15 15 00 00 00 01 00 02 85 01 15 00 00 00 01 00 02 86 21 15 00 00 00 01 00 02 87 01 15 00 00 00 01 00 02 88 4b 15 00 00 00 01 00 02 89 01 15 00 00 00 01 00 02 8a 6d 15 00 00 00 01 00 02 8b 01 15 00 00 00 01 00 02 8c a6 15 00 00 00 01 00 02 8d 01 15 00 00 00 01 00 02 8e d5 15 00 00 00 01 00 02 8f 02 15 00 00 00 01 00 02 90 1c 15 00 00 00 01 00 02 91 02 15 00 00 00 01 00 02 92 4f 15 00 00 00 01 00 02 93 02 15 00 00 00 01 00 02 94 50 15 00 00 00 01 00 02 95 02 15 00 00 00 01 00 02 96 7f 15 00 00 00 01 00 02 97 02 15 00 00 00 01 00 02 98 b4 15 00 00 00 01 00 02 99 02 15 00 00 00 01 00 02 9a d5 15 00 00 00 01 00 02 9b 03 15 00 00 00 01 00 02 9c 08 15 00 00 00 01 00 02 9d 03 15 00 00 00 01 00 02 9e 27 15 00 00 00 01 00 02 9f 03 15 00 00 00 01 00 02 a0 50 15 00 00 00 01 00 02 a2 03 15 00 00 00 01 00 02 a3 5c 15 00 00 00 01 00 02 a4 03 15 00 00 00 01 00 02 a5 69 15 00 00 00 01 00 02 a6 03 15 00 00 00 01 00 02 a7 77 15 00 00 00 01 00 02 a9 03 15 00 00 00 01 00 02 aa 88 15 00 00 00 01 00 02 ab 03 15 00 00 00 01 00 02 ac 99 15 00 00 00 01 00 02 ad 03 15 00 00 00 01 00 02 ae af 15 00 00 00 01 00 02 af 03 15 00 00 00 01 00 02 b0 c2 15 00 00 00 01 00 02 b1 03 15 00 00 00 01 00 02 b2 c6 15 00 00 00 01 00 02 b3 00 15 00 00 00 01 00 02 b4 df 15 00 00 00 01 00 02 b5 00 15 00 00 00 01 00 02 b6 ec 15 00 00 00 01 00 02 b7 01 15 00 00 00 01 00 02 b8 05 15 00 00 00 01 00 02 b9 01 15 00 00 00 01 00 02 ba 17 15 00 00 00 01 00 02 bb 01 15 00 00 00 01 00 02 bc 28 15 00 00 00 01 00 02 bd 01 15 00 00 00 01 00 02 be 36 15 00 00 00 01 00 02 bf 01 15 00 00 00 01 00 02 c0 42 15 00 00 00 01 00 02 c1 01 15 00 00 00 01 00 02 c2 4d 15 00 00 00 01 00 02 c3 01 15 00 00 00 01 00 02 c4 58 15 00 00 00 01 00 02 c5 01 15 00 00 00 01 00 02 c6 7a 15 00 00 00 01 00 02 c7 01 15 00 00 00 01 00 02 c8 96 15 00 00 00 01 00 02 c9 01 15 00 00 00 01 00 02 ca c1 15 00 00 00 01 00 02 cb 01 15 00 00 00 01 00 02 cc e2 15 00 00 00 01 00 02 cd 02 15 00 00 00 01 00 02 ce 17 15 00 00 00 01 00 02 cf 02 15 00 00 00 01 00 02 d0 4a 15 00 00 00 01 00 02 d1 02 15 00 00 00 01 00 02 d2 4b 15 00 00 00 01 00 02 d3 02 15 00 00 00 01 00 02 d4 7a 15 00 00 00 01 00 02 d5 02 15 00 00 00 01 00 02 d6 b1 15 00 00 00 01 00 02 d7 02 15 00 00 00 01 00 02 d8 d4 15 00 00 00 01 00 02 d9 03 15 00 00 00 01 00 02 da 03 15 00 00 00 01 00 02 db 03 15 00 00 00 01 00 02 dc 23 15 00 00 00 01 00 02 dd 03 15 00 00 00 01 00 02 de 4d 15 00 00 00 01 00 02 df 03 15 00 00 00 01 00 02 e0 5a 15 00 00 00 01 00 02 e1 03 15 00 00 00 01 00 02 e2 68 15 00 00 00 01 00 02 e3 03 15 00 00 00 01 00 02 e4 76 15 00 00 00 01 00 02 e5 03 15 00 00 00 01 00 02 e6 87 15 00 00 00 01 00 02 e7 03 15 00 00 00 01 00 02 e8 98 15 00 00 00 01 00 02 e9 03 15 00 00 00 01 00 02 ea ae 15 00 00 00 01 00 02 eb 03 15 00 00 00 01 00 02 ec c1 15 00 00 00 01 00 02 ed 03 15 00 00 00 01 00 02 ee c6 15 00 00 00 01 00 02 ef 00 15 00 00 00 01 00 02 f0 37 15 00 00 00 01 00 02 f1 00 15 00 00 00 01 00 02 f2 73 15 00 00 00 01 00 02 f3 00 15 00 00 00 01 00 02 f4 9d 15 00 00 00 01 00 02 f5 00 15 00 00 00 01 00 02 f6 b9 15 00 00 00 01 00 02 f7 00 15 00 00 00 01 00 02 f8 cf 15 00 00 00 01 00 02 f9 00 15 00 00 00 01 00 02 fa e2 15 00 00 00 01 00 02 ff 21 15 00 00 00 01 00 02 00 00 15 00 00 00 01 00 02 01 f3 15 00 00 00 01 00 02 02 01 15 00 00 00 01 00 02 03 02 15 00 00 00 01 00 02 04 01 15 00 00 00 01 00 02 05 0f 15 00 00 00 01 00 02 06 01 15 00 00 00 01 00 02 07 3d 15 00 00 00 01 00 02 08 01 15 00 00 00 01 00 02 09 62 15 00 00 00 01 00 02 0a 01 15 00 00 00 01 00 02 0b 9f 15 00 00 00 01 00 02 0c 01 15 00 00 00 01 00 02 0d d0 15 00 00 00 01 00 02 0e 02 15 00 00 00 01 00 02 0f 1a 15 00 00 00 01 00 02 10 02 15 00 00 00 01 00 02 11 4d 15 00 00 00 01 00 02 12 02 15 00 00 00 01 00 02 13 4f 15 00 00 00 01 00 02 14 02 15 00 00 00 01 00 02 15 7e 15 00 00 00 01 00 02 16 02 15 00 00 00 01 00 02 17 b2 15 00 00 00 01 00 02 18 02 15 00 00 00 01 00 02 19 d5 15 00 00 00 01 00 02 1a 03 15 00 00 00 01 00 02 1b 07 15 00 00 00 01 00 02 1c 03 15 00 00 00 01 00 02 1d 2a 15 00 00 00 01 00 02 1e 03 15 00 00 00 01 00 02 1f 4f 15 00 00 00 01 00 02 20 03 15 00 00 00 01 00 02 21 59 15 00 00 00 01 00 02 22 03 15 00 00 00 01 00 02 23 66 15 00 00 00 01 00 02 24 03 15 00 00 00 01 00 02 25 74 15 00 00 00 01 00 02 26 03 15 00 00 00 01 00 02 27 85 15 00 00 00 01 00 02 28 03 15 00 00 00 01 00 02 29 95 15 00 00 00 01 00 02 2a 03 15 00 00 00 01 00 02 2b aa 15 00 00 00 01 00 02 2d 03 15 00 00 00 01 00 02 2f c1 15 00 00 00 01 00 02 30 03 15 00 00 00 01 00 02 31 c6 15 00 00 00 01 00 02 32 00 15 00 00 00 01 00 02 33 84 15 00 00 00 01 00 02 34 00 15 00 00 00 01 00 02 35 be 15 00 00 00 01 00 02 36 00 15 00 00 00 01 00 02 37 e6 15 00 00 00 01 00 02 38 01 15 00 00 00 01 00 02 39 01 15 00 00 00 01 00 02 3a 01 15 00 00 00 01 00 02 3b 15 15 00 00 00 01 00 02 3d 01 15 00 00 00 01 00 02 3f 26 15 00 00 00 01 00 02 40 01 15 00 00 00 01 00 02 41 34 15 00 00 00 01 00 02 42 01 15 00 00 00 01 00 02 43 42 15 00 00 00 01 00 02 44 01 15 00 00 00 01 00 02 45 4e 15 00 00 00 01 00 02 46 01 15 00 00 00 01 00 02 47 74 15 00 00 00 01 00 02 48 01 15 00 00 00 01 00 02 49 91 15 00 00 00 01 00 02 4a 01 15 00 00 00 01 00 02 4b be 15 00 00 00 01 00 02 4c 01 15 00 00 00 01 00 02 4d df 15 00 00 00 01 00 02 4e 02 15 00 00 00 01 00 02 4f 15 15 00 00 00 01 00 02 50 02 15 00 00 00 01 00 02 51 48 15 00 00 00 01 00 02 52 02 15 00 00 00 01 00 02 53 4a 15 00 00 00 01 00 02 54 02 15 00 00 00 01 00 02 55 79 15 00 00 00 01 00 02 56 02 15 00 00 00 01 00 02 58 af 15 00 00 00 01 00 02 59 02 15 00 00 00 01 00 02 5a d4 15 00 00 00 01 00 02 5b 03 15 00 00 00 01 00 02 5c 02 15 00 00 00 01 00 02 5d 03 15 00 00 00 01 00 02 5e 26 15 00 00 00 01 00 02 5f 03 15 00 00 00 01 00 02 60 4c 15 00 00 00 01 00 02 61 03 15 00 00 00 01 00 02 62 57 15 00 00 00 01 00 02 63 03 15 00 00 00 01 00 02 64 65 15 00 00 00 01 00 02 65 03 15 00 00 00 01 00 02 66 73 15 00 00 00 01 00 02 67 03 15 00 00 00 01 00 02 68 84 15 00 00 00 01 00 02 69 03 15 00 00 00 01 00 02 6a 94 15 00 00 00 01 00 02 6b 03 15 00 00 00 01 00 02 6c a9 15 00 00 00 01 00 02 6d 03 15 00 00 00 01 00 02 6e c0 15 00 00 00 01 00 02 6f 03 15 00 00 00 01 00 02 70 c6 15 00 00 00 01 00 02 71 01 15 00 00 00 01 00 02 72 82 15 00 00 00 01 00 02 73 01 15 00 00 00 01 00 02 74 84 15 00 00 00 01 00 02 75 01 15 00 00 00 01 00 02 76 8a 15 00 00 00 01 00 02 77 01 15 00 00 00 01 00 02 78 90 15 00 00 00 01 00 02 79 01 15 00 00 00 01 00 02 7a 94 15 00 00 00 01 00 02 7b 01 15 00 00 00 01 00 02 7c 9a 15 00 00 00 01 00 02 7d 01 15 00 00 00 01 00 02 7e a0 15 00 00 00 01 00 02 7f 01 15 00 00 00 01 00 02 80 a6 15 00 00 00 01 00 02 81 01 15 00 00 00 01 00 02 82 aa 15 00 00 00 01 00 02 83 01 15 00 00 00 01 00 02 84 bd 15 00 00 00 01 00 02 85 01 15 00 00 00 01 00 02 86 d0 15 00 00 00 01 00 02 87 01 15 00 00 00 01 00 02 88 f1 15 00 00 00 01 00 02 89 02 15 00 00 00 01 00 02 8a 10 15 00 00 00 01 00 02 8b 02 15 00 00 00 01 00 02 8c 43 15 00 00 00 01 00 02 8d 02 15 00 00 00 01 00 02 8e 6b 15 00 00 00 01 00 02 8f 02 15 00 00 00 01 00 02 90 6c 15 00 00 00 01 00 02 91 02 15 00 00 00 01 00 02 92 97 15 00 00 00 01 00 02 93 02 15 00 00 00 01 00 02 94 ca 15 00 00 00 01 00 02 95 02 15 00 00 00 01 00 02 96 ec 15 00 00 00 01 00 02 97 03 15 00 00 00 01 00 02 98 23 15 00 00 00 01 00 02 99 03 15 00 00 00 01 00 02 9a 38 15 00 00 00 01 00 02 9b 03 15 00 00 00 01 00 02 9c 5e 15 00 00 00 01 00 02 9d 03 15 00 00 00 01 00 02 9e 6a 15 00 00 00 01 00 02 9f 03 15 00 00 00 01 00 02 a0 73 15 00 00 00 01 00 02 a2 03 15 00 00 00 01 00 02 a3 80 15 00 00 00 01 00 02 a4 03 15 00 00 00 01 00 02 a5 8f 15 00 00 00 01 00 02 a6 03 15 00 00 00 01 00 02 a7 9e 15 00 00 00 01 00 02 a9 03 15 00 00 00 01 00 02 aa ac 15 00 00 00 01 00 02 ab 03 15 00 00 00 01 00 02 ac b4 15 00 00 00 01 00 02 ad 03 15 00 00 00 01 00 02 ae c6 15 00 00 00 01 00 02 af 01 15 00 00 00 01 00 02 b0 b7 15 00 00 00 01 00 02 b1 01 15 00 00 00 01 00 02 b2 b9 15 00 00 00 01 00 02 b3 01 15 00 00 00 01 00 02 b4 bd 15 00 00 00 01 00 02 b5 01 15 00 00 00 01 00 02 b6 c1 15 00 00 00 01 00 02 b7 01 15 00 00 00 01 00 02 b8 c5 15 00 00 00 01 00 02 b9 01 15 00 00 00 01 00 02 ba c9 15 00 00 00 01 00 02 bb 01 15 00 00 00 01 00 02 bc cd 15 00 00 00 01 00 02 bd 01 15 00 00 00 01 00 02 be d2 15 00 00 00 01 00 02 bf 01 15 00 00 00 01 00 02 c0 d5 15 00 00 00 01 00 02 c1 01 15 00 00 00 01 00 02 c2 e2 15 00 00 00 01 00 02 c3 01 15 00 00 00 01 00 02 c4 ef 15 00 00 00 01 00 02 c5 02 15 00 00 00 01 00 02 c6 06 15 00 00 00 01 00 02 c7 02 15 00 00 00 01 00 02 c8 19 15 00 00 00 01 00 02 c9 02 15 00 00 00 01 00 02 ca 3e 15 00 00 00 01 00 02 cb 02 15 00 00 00 01 00 02 cc 66 15 00 00 00 01 00 02 cd 02 15 00 00 00 01 00 02 ce 67 15 00 00 00 01 00 02 cf 02 15 00 00 00 01 00 02 d0 92 15 00 00 00 01 00 02 d1 02 15 00 00 00 01 00 02 d2 c7 15 00 00 00 01 00 02 d3 02 15 00 00 00 01 00 02 d4 eb 15 00 00 00 01 00 02 d5 03 15 00 00 00 01 00 02 d6 1e 15 00 00 00 01 00 02 d7 03 15 00 00 00 01 00 02 d8 34 15 00 00 00 01 00 02 d9 03 15 00 00 00 01 00 02 da 5b 15 00 00 00 01 00 02 db 03 15 00 00 00 01 00 02 dc 67 15 00 00 00 01 00 02 dd 03 15 00 00 00 01 00 02 de 72 15 00 00 00 01 00 02 df 03 15 00 00 00 01 00 02 e0 7f 15 00 00 00 01 00 02 e1 03 15 00 00 00 01 00 02 e2 8e 15 00 00 00 01 00 02 e3 03 15 00 00 00 01 00 02 e4 9d 15 00 00 00 01 00 02 e5 03 15 00 00 00 01 00 02 e6 ab 15 00 00 00 01 00 02 e7 03 15 00 00 00 01 00 02 e8 b3 15 00 00 00 01 00 02 e9 03 15 00 00 00 01 00 02 ea c6 15 01 00 00 01 00 02 ff 10];
        qcom,mdss-dsi-dispparam-warm-command-state = "dsi_hs_mode";
        qcom,mdss-dsi-dispparam-default-command = [15 00 00 00 01 00 02 ff 20 15 00 00 00 01 00 02 fb 00 15 00 00 00 01 00 02 ff 21 15 00 00 00 01 00 02 fb 00 15 00 00 00 01 00 02 ff 10 05 01 00 00 10 00 02 11 00];
        qcom,mdss-dsi-dispparam-default-command-state = "dsi_hs_mode";
        qcom,mdss-dsi-dispparam-cold-command = [15 00 00 00 00 00 02 ff 20 15 00 00 00 00 00 02 75 00 15 00 00 00 00 00 02 76 f1 15 00 00 00 00 00 02 77 00 15 00 00 00 00 00 02 78 f8 15 00 00 00 00 00 02 79 01 15 00 00 00 00 00 02 7a 06 15 00 00 00 00 00 02 7b 01 15 00 00 00 00 00 02 7c 13 15 00 00 00 00 00 02 7d 01 15 00 00 00 00 00 02 7e 1f 15 00 00 00 00 00 02 7f 01 15 00 00 00 00 00 02 80 2a 15 00 00 00 00 00 02 81 01 15 00 00 00 00 00 02 82 35 15 00 00 00 00 00 02 83 01 15 00 00 00 00 00 02 84 3e 15 00 00 00 00 00 02 85 01 15 00 00 00 00 00 02 86 48 15 00 00 00 00 00 02 87 01 15 00 00 00 00 00 02 88 69 15 00 00 00 00 00 02 89 01 15 00 00 00 00 00 02 8a 87 15 00 00 00 00 00 02 8b 01 15 00 00 00 00 00 02 8c b8 15 00 00 00 00 00 02 8d 01 15 00 00 00 00 00 02 8e e3 15 00 00 00 00 00 02 8f 02 15 00 00 00 00 00 02 90 25 15 00 00 00 00 00 02 91 02 15 00 00 00 00 00 02 92 54 15 00 00 00 00 00 02 93 02 15 00 00 00 00 00 02 94 56 15 00 00 00 00 00 02 95 02 15 00 00 00 00 00 02 96 83 15 00 00 00 00 00 02 97 02 15 00 00 00 00 00 02 98 b8 15 00 00 00 00 00 02 99 02 15 00 00 00 00 00 02 9a da 15 00 00 00 00 00 02 9b 03 15 00 00 00 00 00 02 9c 0d 15 00 00 00 00 00 02 9d 03 15 00 00 00 00 00 02 9e 2b 15 00 00 00 00 00 02 9f 03 15 00 00 00 00 00 02 a0 53 15 00 00 00 00 00 02 a2 03 15 00 00 00 00 00 02 a3 60 15 00 00 00 00 00 02 a4 03 15 00 00 00 00 00 02 a5 6c 15 00 00 00 00 00 02 a6 03 15 00 00 00 00 00 02 a7 7a 15 00 00 00 00 00 02 a9 03 15 00 00 00 00 00 02 aa 8a 15 00 00 00 00 00 02 ab 03 15 00 00 00 00 00 02 ac 9b 15 00 00 00 00 00 02 ad 03 15 00 00 00 00 00 02 ae ae 15 00 00 00 00 00 02 af 03 15 00 00 00 00 00 02 b0 c3 15 00 00 00 00 00 02 b1 03 15 00 00 00 00 00 02 b2 c6 15 00 00 00 00 00 02 b3 01 15 00 00 00 00 00 02 b4 30 15 00 00 00 00 00 02 b5 01 15 00 00 00 00 00 02 b6 35 15 00 00 00 00 00 02 b7 01 15 00 00 00 00 00 02 b8 41 15 00 00 00 00 00 02 b9 01 15 00 00 00 00 00 02 ba 4e 15 00 00 00 00 00 02 bb 01 15 00 00 00 00 00 02 bc 58 15 00 00 00 00 00 02 bd 01 15 00 00 00 00 00 02 be 61 15 00 00 00 00 00 02 bf 01 15 00 00 00 00 00 02 c0 6a 15 00 00 00 00 00 02 c1 01 15 00 00 00 00 00 02 c2 72 15 00 00 00 00 00 02 c3 01 15 00 00 00 00 00 02 c4 7b 15 00 00 00 00 00 02 c5 01 15 00 00 00 00 00 02 c6 95 15 00 00 00 00 00 02 c7 01 15 00 00 00 00 00 02 c8 ac 15 00 00 00 00 00 02 c9 01 15 00 00 00 00 00 02 ca d1 15 00 00 00 00 00 02 cb 01 15 00 00 00 00 00 02 cc ee 15 00 00 00 00 00 02 cd 02 15 00 00 00 00 00 02 ce 20 15 00 00 00 00 00 02 cf 02 15 00 00 00 00 00 02 d0 4f 15 00 00 00 00 00 02 d1 02 15 00 00 00 00 00 02 d2 51 15 00 00 00 00 00 02 d3 02 15 00 00 00 00 00 02 d4 7e 15 00 00 00 00 00 02 d5 02 15 00 00 00 00 00 02 d6 b5 15 00 00 00 00 00 02 d7 02 15 00 00 00 00 00 02 d8 d9 15 00 00 00 00 00 02 d9 03 15 00 00 00 00 00 02 da 08 15 00 00 00 00 00 02 db 03 15 00 00 00 00 00 02 dc 27 15 00 00 00 00 00 02 dd 03 15 00 00 00 00 00 02 de 50 15 00 00 00 00 00 02 df 03 15 00 00 00 00 00 02 e0 5d 15 00 00 00 00 00 02 e1 03 15 00 00 00 00 00 02 e2 6b 15 00 00 00 00 00 02 e3 03 15 00 00 00 00 00 02 e4 79 15 00 00 00 00 00 02 e5 03 15 00 00 00 00 00 02 e6 89 15 00 00 00 00 00 02 e7 03 15 00 00 00 00 00 02 e8 9a 15 00 00 00 00 00 02 e9 03 15 00 00 00 00 00 02 ea ad 15 00 00 00 00 00 02 eb 03 15 00 00 00 00 00 02 ec c2 15 00 00 00 00 00 02 ed 03 15 00 00 00 00 00 02 ee c6 15 00 00 00 00 00 02 ef 00 15 00 00 00 00 00 02 f0 37 15 00 00 00 00 00 02 f1 00 15 00 00 00 00 00 02 f2 73 15 00 00 00 00 00 02 f3 00 15 00 00 00 00 00 02 f4 9d 15 00 00 00 00 00 02 f5 00 15 00 00 00 00 00 02 f6 b9 15 00 00 00 00 00 02 f7 00 15 00 00 00 00 00 02 f8 cf 15 00 00 00 00 00 02 f9 00 15 00 00 00 00 00 02 fa e2 15 00 00 00 00 00 02 ff 21 15 00 00 00 00 00 02 00 00 15 00 00 00 00 00 02 01 f3 15 00 00 00 00 00 02 02 01 15 00 00 00 00 00 02 03 02 15 00 00 00 00 00 02 04 01 15 00 00 00 00 00 02 05 0f 15 00 00 00 00 00 02 06 01 15 00 00 00 00 00 02 07 3d 15 00 00 00 00 00 02 08 01 15 00 00 00 00 00 02 09 62 15 00 00 00 00 00 02 0a 01 15 00 00 00 00 00 02 0b 9f 15 00 00 00 00 00 02 0c 01 15 00 00 00 00 00 02 0d d0 15 00 00 00 00 00 02 0e 02 15 00 00 00 00 00 02 0f 1a 15 00 00 00 00 00 02 10 02 15 00 00 00 00 00 02 11 4d 15 00 00 00 00 00 02 12 02 15 00 00 00 00 00 02 13 4f 15 00 00 00 00 00 02 14 02 15 00 00 00 00 00 02 15 7e 15 00 00 00 00 00 02 16 02 15 00 00 00 00 00 02 17 b2 15 00 00 00 00 00 02 18 02 15 00 00 00 00 00 02 19 d5 15 00 00 00 00 00 02 1a 03 15 00 00 00 00 00 02 1b 07 15 00 00 00 00 00 02 1c 03 15 00 00 00 00 00 02 1d 2a 15 00 00 00 00 00 02 1e 03 15 00 00 00 00 00 02 1f 4f 15 00 00 00 00 00 02 20 03 15 00 00 00 00 00 02 21 59 15 00 00 00 00 00 02 22 03 15 00 00 00 00 00 02 23 66 15 00 00 00 00 00 02 24 03 15 00 00 00 00 00 02 25 74 15 00 00 00 00 00 02 26 03 15 00 00 00 00 00 02 27 85 15 00 00 00 00 00 02 28 03 15 00 00 00 00 00 02 29 95 15 00 00 00 00 00 02 2a 03 15 00 00 00 00 00 02 2b aa 15 00 00 00 00 00 02 2d 03 15 00 00 00 00 00 02 2f c1 15 00 00 00 00 00 02 30 03 15 00 00 00 00 00 02 31 c6 15 00 00 00 00 00 02 32 00 15 00 00 00 00 00 02 33 84 15 00 00 00 00 00 02 34 00 15 00 00 00 00 00 02 35 be 15 00 00 00 00 00 02 36 00 15 00 00 00 00 00 02 37 e6 15 00 00 00 00 00 02 38 01 15 00 00 00 00 00 02 39 01 15 00 00 00 00 00 02 3a 01 15 00 00 00 00 00 02 3b 15 15 00 00 00 00 00 02 3d 01 15 00 00 00 00 00 02 3f 26 15 00 00 00 00 00 02 40 01 15 00 00 00 00 00 02 41 34 15 00 00 00 00 00 02 42 01 15 00 00 00 00 00 02 43 42 15 00 00 00 00 00 02 44 01 15 00 00 00 00 00 02 45 4e 15 00 00 00 00 00 02 46 01 15 00 00 00 00 00 02 47 74 15 00 00 00 00 00 02 48 01 15 00 00 00 00 00 02 49 91 15 00 00 00 00 00 02 4a 01 15 00 00 00 00 00 02 4b be 15 00 00 00 00 00 02 4c 01 15 00 00 00 00 00 02 4d df 15 00 00 00 00 00 02 4e 02 15 00 00 00 00 00 02 4f 15 15 00 00 00 00 00 02 50 02 15 00 00 00 00 00 02 51 48 15 00 00 00 00 00 02 52 02 15 00 00 00 00 00 02 53 4a 15 00 00 00 00 00 02 54 02 15 00 00 00 00 00 02 55 79 15 00 00 00 00 00 02 56 02 15 00 00 00 00 00 02 58 af 15 00 00 00 00 00 02 59 02 15 00 00 00 00 00 02 5a d4 15 00 00 00 00 00 02 5b 03 15 00 00 00 00 00 02 5c 02 15 00 00 00 00 00 02 5d 03 15 00 00 00 00 00 02 5e 26 15 00 00 00 00 00 02 5f 03 15 00 00 00 00 00 02 60 4c 15 00 00 00 00 00 02 61 03 15 00 00 00 00 00 02 62 57 15 00 00 00 00 00 02 63 03 15 00 00 00 00 00 02 64 65 15 00 00 00 00 00 02 65 03 15 00 00 00 00 00 02 66 73 15 00 00 00 00 00 02 67 03 15 00 00 00 00 00 02 68 84 15 00 00 00 00 00 02 69 03 15 00 00 00 00 00 02 6a 94 15 00 00 00 00 00 02 6b 03 15 00 00 00 00 00 02 6c a9 15 00 00 00 00 00 02 6d 03 15 00 00 00 00 00 02 6e c0 15 00 00 00 00 00 02 6f 03 15 00 00 00 00 00 02 70 c6 15 00 00 00 00 00 02 71 01 15 00 00 00 00 00 02 72 27 15 00 00 00 00 00 02 73 01 15 00 00 00 00 00 02 74 2c 15 00 00 00 00 00 02 75 01 15 00 00 00 00 00 02 76 35 15 00 00 00 00 00 02 77 01 15 00 00 00 00 00 02 78 40 15 00 00 00 00 00 02 79 01 15 00 00 00 00 00 02 7a 48 15 00 00 00 00 00 02 7b 01 15 00 00 00 00 00 02 7c 51 15 00 00 00 00 00 02 7d 01 15 00 00 00 00 00 02 7e 58 15 00 00 00 00 00 02 7f 01 15 00 00 00 00 00 02 80 61 15 00 00 00 00 00 02 81 01 15 00 00 00 00 00 02 82 69 15 00 00 00 00 00 02 83 01 15 00 00 00 00 00 02 84 84 15 00 00 00 00 00 02 85 01 15 00 00 00 00 00 02 86 9d 15 00 00 00 00 00 02 87 01 15 00 00 00 00 00 02 88 c9 15 00 00 00 00 00 02 89 01 15 00 00 00 00 00 02 8a f0 15 00 00 00 00 00 02 8b 02 15 00 00 00 00 00 02 8c 2e 15 00 00 00 00 00 02 8d 02 15 00 00 00 00 00 02 8e 5b 15 00 00 00 00 00 02 8f 02 15 00 00 00 00 00 02 90 5d 15 00 00 00 00 00 02 91 02 15 00 00 00 00 00 02 92 8a 15 00 00 00 00 00 02 93 02 15 00 00 00 00 00 02 94 be 15 00 00 00 00 00 02 95 02 15 00 00 00 00 00 02 96 e1 15 00 00 00 00 00 02 97 03 15 00 00 00 00 00 02 98 17 15 00 00 00 00 00 02 99 03 15 00 00 00 00 00 02 9a 2e 15 00 00 00 00 00 02 9b 03 15 00 00 00 00 00 02 9c 55 15 00 00 00 00 00 02 9d 03 15 00 00 00 00 00 02 9e 62 15 00 00 00 00 00 02 9f 03 15 00 00 00 00 00 02 a0 6d 15 00 00 00 00 00 02 a2 03 15 00 00 00 00 00 02 a3 7b 15 00 00 00 00 00 02 a4 03 15 00 00 00 00 00 02 a5 8a 15 00 00 00 00 00 02 a6 03 15 00 00 00 00 00 02 a7 9b 15 00 00 00 00 00 02 a9 03 15 00 00 00 00 00 02 aa aa 15 00 00 00 00 00 02 ab 03 15 00 00 00 00 00 02 ac bc 15 00 00 00 00 00 02 ad 03 15 00 00 00 00 00 02 ae c6 15 00 00 00 00 00 02 af 01 15 00 00 00 00 00 02 b0 62 15 00 00 00 00 00 02 b1 01 15 00 00 00 00 00 02 b2 66 15 00 00 00 00 00 02 b3 01 15 00 00 00 00 00 02 b4 6e 15 00 00 00 00 00 02 b5 01 15 00 00 00 00 00 02 b6 77 15 00 00 00 00 00 02 b7 01 15 00 00 00 00 00 02 b8 7d 15 00 00 00 00 00 02 b9 01 15 00 00 00 00 00 02 ba 85 15 00 00 00 00 00 02 bb 01 15 00 00 00 00 00 02 bc 8b 15 00 00 00 00 00 02 bd 01 15 00 00 00 00 00 02 be 92 15 00 00 00 00 00 02 bf 01 15 00 00 00 00 00 02 c0 98 15 00 00 00 00 00 02 c1 01 15 00 00 00 00 00 02 c2 ad 15 00 00 00 00 00 02 c3 01 15 00 00 00 00 00 02 c4 c0 15 00 00 00 00 00 02 c5 01 15 00 00 00 00 00 02 c6 e0 15 00 00 00 00 00 02 c7 01 15 00 00 00 00 00 02 c8 fb 15 00 00 00 00 00 02 c9 02 15 00 00 00 00 00 02 ca 29 15 00 00 00 00 00 02 cb 02 15 00 00 00 00 00 02 cc 56 15 00 00 00 00 00 02 cd 02 15 00 00 00 00 00 02 ce 58 15 00 00 00 00 00 02 cf 02 15 00 00 00 00 00 02 d0 85 15 00 00 00 00 00 02 d1 02 15 00 00 00 00 00 02 d2 bb 15 00 00 00 00 00 02 d3 02 15 00 00 00 00 00 02 d4 e0 15 00 00 00 00 00 02 d5 03 15 00 00 00 00 00 02 d6 12 15 00 00 00 00 00 02 d7 03 15 00 00 00 00 00 02 d8 2a 15 00 00 00 00 00 02 d9 03 15 00 00 00 00 00 02 da 52 15 00 00 00 00 00 02 db 03 15 00 00 00 00 00 02 dc 60 15 00 00 00 00 00 02 dd 03 15 00 00 00 00 00 02 de 6c 15 00 00 00 00 00 02 df 03 15 00 00 00 00 00 02 e0 7a 15 00 00 00 00 00 02 e1 03 15 00 00 00 00 00 02 e2 89 15 00 00 00 00 00 02 e3 03 15 00 00 00 00 00 02 e4 9a 15 00 00 00 00 00 02 e5 03 15 00 00 00 00 00 02 e6 a9 15 00 00 00 00 00 02 e7 03 15 00 00 00 00 00 02 e8 bb 15 00 00 00 00 00 02 e9 03 15 00 00 00 00 00 02 ea c6 15 01 00 00 01 00 02 ff 10];
        qcom,mdss-dsi-dispparam-cold-command-state = "dsi_hs_mode";
        qcom,mdss-dsi-dispparam-papermode-command = [15 01 00 00 78 00 02 ff 20 15 00 00 00 01 00 02 fb 01 15 00 00 00 01 00 02 75 00 15 00 00 00 01 00 02 76 f0 15 00 00 00 01 00 02 77 00 15 00 00 00 01 00 02 78 fa 15 00 00 00 01 00 02 79 01 15 00 00 00 01 00 02 7a 0c 15 00 00 00 01 00 02 7b 01 15 00 00 00 01 00 02 7c 1c 15 00 00 00 01 00 02 7d 01 15 00 00 00 01 00 02 7e 2a 15 00 00 00 01 00 02 7f 01 15 00 00 00 01 00 02 80 36 15 00 00 00 01 00 02 81 01 15 00 00 00 01 00 02 82 42 15 00 00 00 01 00 02 83 01 15 00 00 00 01 00 02 84 4d 15 00 00 00 01 00 02 85 01 15 00 00 00 01 00 02 86 57 15 00 00 00 01 00 02 87 01 15 00 00 00 01 00 02 88 79 15 00 00 00 01 00 02 89 01 15 00 00 00 01 00 02 8a 95 15 00 00 00 01 00 02 8b 01 15 00 00 00 01 00 02 8c c3 15 00 00 00 01 00 02 8d 01 15 00 00 00 01 00 02 8e e8 15 00 00 00 01 00 02 8f 02 15 00 00 00 01 00 02 90 21 15 00 00 00 01 00 02 91 02 15 00 00 00 01 00 02 92 51 15 00 00 00 01 00 02 93 02 15 00 00 00 01 00 02 94 52 15 00 00 00 01 00 02 95 02 15 00 00 00 01 00 02 96 7f 15 00 00 00 01 00 02 97 02 15 00 00 00 01 00 02 98 b2 15 00 00 00 01 00 02 99 02 15 00 00 00 01 00 02 9a d9 15 00 00 00 01 00 02 9b 03 15 00 00 00 01 00 02 9c 04 15 00 00 00 01 00 02 9d 03 15 00 00 00 01 00 02 9e 26 15 00 00 00 01 00 02 9f 03 15 00 00 00 01 00 02 a0 4e 15 00 00 00 01 00 02 a2 03 15 00 00 00 01 00 02 a3 59 15 00 00 00 01 00 02 a4 03 15 00 00 00 01 00 02 a5 65 15 00 00 00 01 00 02 a6 03 15 00 00 00 01 00 02 a7 73 15 00 00 00 01 00 02 a9 03 15 00 00 00 01 00 02 aa 81 15 00 00 00 01 00 02 ab 03 15 00 00 00 01 00 02 ac 91 15 00 00 00 01 00 02 ad 03 15 00 00 00 01 00 02 ae a2 15 00 00 00 01 00 02 af 03 15 00 00 00 01 00 02 b0 ae 15 00 00 00 01 00 02 b1 03 15 00 00 00 01 00 02 b2 fd 15 00 00 00 01 00 02 b3 00 15 00 00 00 01 00 02 b4 f0 15 00 00 00 01 00 02 b5 00 15 00 00 00 01 00 02 b6 fa 15 00 00 00 01 00 02 b7 01 15 00 00 00 01 00 02 b8 0c 15 00 00 00 01 00 02 b9 01 15 00 00 00 01 00 02 ba 1c 15 00 00 00 01 00 02 bb 01 15 00 00 00 01 00 02 bc 2a 15 00 00 00 01 00 02 bd 01 15 00 00 00 01 00 02 be 36 15 00 00 00 01 00 02 bf 01 15 00 00 00 01 00 02 c0 42 15 00 00 00 01 00 02 c1 01 15 00 00 00 01 00 02 c2 4d 15 00 00 00 01 00 02 c3 01 15 00 00 00 01 00 02 c4 57 15 00 00 00 01 00 02 c5 01 15 00 00 00 01 00 02 c6 79 15 00 00 00 01 00 02 c7 01 15 00 00 00 01 00 02 c8 95 15 00 00 00 01 00 02 c9 01 15 00 00 00 01 00 02 ca c3 15 00 00 00 01 00 02 cb 01 15 00 00 00 01 00 02 cc e8 15 00 00 00 01 00 02 cd 02 15 00 00 00 01 00 02 ce 21 15 00 00 00 01 00 02 cf 02 15 00 00 00 01 00 02 d0 51 15 00 00 00 01 00 02 d1 02 15 00 00 00 01 00 02 d2 52 15 00 00 00 01 00 02 d3 02 15 00 00 00 01 00 02 d4 7f 15 00 00 00 01 00 02 d5 02 15 00 00 00 01 00 02 d6 b2 15 00 00 00 01 00 02 d7 02 15 00 00 00 01 00 02 d8 d9 15 00 00 00 01 00 02 d9 03 15 00 00 00 01 00 02 da 04 15 00 00 00 01 00 02 db 03 15 00 00 00 01 00 02 dc 26 15 00 00 00 01 00 02 dd 03 15 00 00 00 01 00 02 de 4e 15 00 00 00 01 00 02 df 03 15 00 00 00 01 00 02 e0 59 15 00 00 00 01 00 02 e1 03 15 00 00 00 01 00 02 e2 65 15 00 00 00 01 00 02 e3 03 15 00 00 00 01 00 02 e4 73 15 00 00 00 01 00 02 e5 03 15 00 00 00 01 00 02 e6 81 15 00 00 00 01 00 02 e7 03 15 00 00 00 01 00 02 e8 91 15 00 00 00 01 00 02 e9 03 15 00 00 00 01 00 02 ea a2 15 00 00 00 01 00 02 eb 03 15 00 00 00 01 00 02 ec ae 15 00 00 00 01 00 02 ed 03 15 00 00 00 01 00 02 ee fd 15 00 00 00 01 00 02 ef 00 15 00 00 00 01 00 02 f0 bd 15 00 00 00 01 00 02 f1 00 15 00 00 00 01 00 02 f2 cc 15 00 00 00 01 00 02 f3 00 15 00 00 00 01 00 02 f4 e6 15 00 00 00 01 00 02 f5 00 15 00 00 00 01 00 02 f6 fa 15 00 00 00 01 00 02 f7 01 15 00 00 00 01 00 02 f8 0b 15 00 00 00 01 00 02 f9 01 15 00 00 00 01 00 02 fa 1b 15 00 00 00 01 00 02 ff 21 15 00 00 00 01 00 02 fb 01 15 00 00 00 01 00 02 00 01 15 00 00 00 01 00 02 01 28 15 00 00 00 01 00 02 02 01 15 00 00 00 01 00 02 03 35 15 00 00 00 01 00 02 04 01 15 00 00 00 01 00 02 05 40 15 00 00 00 01 00 02 06 01 15 00 00 00 01 00 02 07 67 15 00 00 00 01 00 02 08 01 15 00 00 00 01 00 02 09 87 15 00 00 00 01 00 02 0a 01 15 00 00 00 01 00 02 0b b9 15 00 00 00 01 00 02 0c 01 15 00 00 00 01 00 02 0d e0 15 00 00 00 01 00 02 0e 02 15 00 00 00 01 00 02 0f 1d 15 00 00 00 01 00 02 10 02 15 00 00 00 01 00 02 11 4e 15 00 00 00 01 00 02 12 02 15 00 00 00 01 00 02 13 4f 15 00 00 00 01 00 02 14 02 15 00 00 00 01 00 02 15 7d 15 00 00 00 01 00 02 16 02 15 00 00 00 01 00 02 17 b1 15 00 00 00 01 00 02 18 02 15 00 00 00 01 00 02 19 da 15 00 00 00 01 00 02 1a 03 15 00 00 00 01 00 02 1b 06 15 00 00 00 01 00 02 1c 03 15 00 00 00 01 00 02 1d 25 15 00 00 00 01 00 02 1e 03 15 00 00 00 01 00 02 1f 4d 15 00 00 00 01 00 02 20 03 15 00 00 00 01 00 02 21 59 15 00 00 00 01 00 02 22 03 15 00 00 00 01 00 02 23 68 15 00 00 00 01 00 02 24 03 15 00 00 00 01 00 02 25 7a 15 00 00 00 01 00 02 26 03 15 00 00 00 01 00 02 27 91 15 00 00 00 01 00 02 28 03 15 00 00 00 01 00 02 29 a5 15 00 00 00 01 00 02 2a 03 15 00 00 00 01 00 02 2b b1 15 00 00 00 01 00 02 2d 03 15 00 00 00 01 00 02 2f b6 15 00 00 00 01 00 02 30 03 15 00 00 00 01 00 02 31 fd 15 00 00 00 01 00 02 32 00 15 00 00 00 01 00 02 33 bd 15 00 00 00 01 00 02 34 00 15 00 00 00 01 00 02 35 cc 15 00 00 00 01 00 02 36 00 15 00 00 00 01 00 02 37 e6 15 00 00 00 01 00 02 38 00 15 00 00 00 01 00 02 39 fa 15 00 00 00 01 00 02 3a 01 15 00 00 00 01 00 02 3b 0b 15 00 00 00 01 00 02 3d 01 15 00 00 00 01 00 02 3f 1b 15 00 00 00 01 00 02 40 01 15 00 00 00 01 00 02 41 28 15 00 00 00 01 00 02 42 01 15 00 00 00 01 00 02 43 35 15 00 00 00 01 00 02 44 01 15 00 00 00 01 00 02 45 40 15 00 00 00 01 00 02 46 01 15 00 00 00 01 00 02 47 67 15 00 00 00 01 00 02 48 01 15 00 00 00 01 00 02 49 87 15 00 00 00 01 00 02 4a 01 15 00 00 00 01 00 02 4b b9 15 00 00 00 01 00 02 4c 01 15 00 00 00 01 00 02 4d e0 15 00 00 00 01 00 02 4e 02 15 00 00 00 01 00 02 4f 1d 15 00 00 00 01 00 02 50 02 15 00 00 00 01 00 02 51 4e 15 00 00 00 01 00 02 52 02 15 00 00 00 01 00 02 53 4f 15 00 00 00 01 00 02 54 02 15 00 00 00 01 00 02 55 7d 15 00 00 00 01 00 02 56 02 15 00 00 00 01 00 02 58 b1 15 00 00 00 01 00 02 59 02 15 00 00 00 01 00 02 5a da 15 00 00 00 01 00 02 5b 03 15 00 00 00 01 00 02 5c 06 15 00 00 00 01 00 02 5d 03 15 00 00 00 01 00 02 5e 25 15 00 00 00 01 00 02 5f 03 15 00 00 00 01 00 02 60 4d 15 00 00 00 01 00 02 61 03 15 00 00 00 01 00 02 62 59 15 00 00 00 01 00 02 63 03 15 00 00 00 01 00 02 64 68 15 00 00 00 01 00 02 65 03 15 00 00 00 01 00 02 66 7a 15 00 00 00 01 00 02 67 03 15 00 00 00 01 00 02 68 91 15 00 00 00 01 00 02 69 03 15 00 00 00 01 00 02 6a a5 15 00 00 00 01 00 02 6b 03 15 00 00 00 01 00 02 6c b1 15 00 00 00 01 00 02 6d 03 15 00 00 00 01 00 02 6e b6 15 00 00 00 01 00 02 6f 03 15 00 00 00 01 00 02 70 fd 15 00 00 00 01 00 02 71 02 15 00 00 00 01 00 02 72 5a 15 00 00 00 01 00 02 73 02 15 00 00 00 01 00 02 74 5b 15 00 00 00 01 00 02 75 02 15 00 00 00 01 00 02 76 5c 15 00 00 00 01 00 02 77 02 15 00 00 00 01 00 02 78 5d 15 00 00 00 01 00 02 79 02 15 00 00 00 01 00 02 7a 5f 15 00 00 00 01 00 02 7b 02 15 00 00 00 01 00 02 7c 60 15 00 00 00 01 00 02 7d 02 15 00 00 00 01 00 02 7e 61 15 00 00 00 01 00 02 7f 02 15 00 00 00 01 00 02 80 63 15 00 00 00 01 00 02 81 02 15 00 00 00 01 00 02 82 64 15 00 00 00 01 00 02 83 02 15 00 00 00 01 00 02 84 69 15 00 00 00 01 00 02 85 02 15 00 00 00 01 00 02 86 6f 15 00 00 00 01 00 02 87 02 15 00 00 00 01 00 02 88 79 15 00 00 00 01 00 02 89 02 15 00 00 00 01 00 02 8a 84 15 00 00 00 01 00 02 8b 02 15 00 00 00 01 00 02 8c 9b 15 00 00 00 01 00 02 8d 02 15 00 00 00 01 00 02 8e b6 15 00 00 00 01 00 02 8f 02 15 00 00 00 01 00 02 90 b7 15 00 00 00 01 00 02 91 02 15 00 00 00 01 00 02 92 dd 15 00 00 00 01 00 02 93 03 15 00 00 00 01 00 02 94 09 15 00 00 00 01 00 02 95 03 15 00 00 00 01 00 02 96 27 15 00 00 00 01 00 02 97 03 15 00 00 00 01 00 02 98 49 15 00 00 00 01 00 02 99 03 15 00 00 00 01 00 02 9a 5e 15 00 00 00 01 00 02 9b 03 15 00 00 00 01 00 02 9c 78 15 00 00 00 01 00 02 9d 03 15 00 00 00 01 00 02 9e 80 15 00 00 00 01 00 02 9f 03 15 00 00 00 01 00 02 a0 89 15 00 00 00 01 00 02 a2 03 15 00 00 00 01 00 02 a3 91 15 00 00 00 01 00 02 a4 03 15 00 00 00 01 00 02 a5 9a 15 00 00 00 01 00 02 a6 03 15 00 00 00 01 00 02 a7 a0 15 00 00 00 01 00 02 a9 03 15 00 00 00 01 00 02 aa a5 15 00 00 00 01 00 02 ab 03 15 00 00 00 01 00 02 ac a6 15 00 00 00 01 00 02 ad 03 15 00 00 00 01 00 02 ae fd 15 00 00 00 01 00 02 af 02 15 00 00 00 01 00 02 b0 5a 15 00 00 00 01 00 02 b1 02 15 00 00 00 01 00 02 b2 5b 15 00 00 00 01 00 02 b3 02 15 00 00 00 01 00 02 b4 5c 15 00 00 00 01 00 02 b5 02 15 00 00 00 01 00 02 b6 5d 15 00 00 00 01 00 02 b7 02 15 00 00 00 01 00 02 b8 5f 15 00 00 00 01 00 02 b9 02 15 00 00 00 01 00 02 ba 60 15 00 00 00 01 00 02 bb 02 15 00 00 00 01 00 02 bc 61 15 00 00 00 01 00 02 bd 02 15 00 00 00 01 00 02 be 63 15 00 00 00 01 00 02 bf 02 15 00 00 00 01 00 02 c0 64 15 00 00 00 01 00 02 c1 02 15 00 00 00 01 00 02 c2 69 15 00 00 00 01 00 02 c3 02 15 00 00 00 01 00 02 c4 6f 15 00 00 00 01 00 02 c5 02 15 00 00 00 01 00 02 c6 79 15 00 00 00 01 00 02 c7 02 15 00 00 00 01 00 02 c8 84 15 00 00 00 01 00 02 c9 02 15 00 00 00 01 00 02 ca 9b 15 00 00 00 01 00 02 cb 02 15 00 00 00 01 00 02 cc b6 15 00 00 00 01 00 02 cd 02 15 00 00 00 01 00 02 ce b7 15 00 00 00 01 00 02 cf 02 15 00 00 00 01 00 02 d0 dd 15 00 00 00 01 00 02 d1 03 15 00 00 00 01 00 02 d2 09 15 00 00 00 01 00 02 d3 03 15 00 00 00 01 00 02 d4 27 15 00 00 00 01 00 02 d5 03 15 00 00 00 01 00 02 d6 49 15 00 00 00 01 00 02 d7 03 15 00 00 00 01 00 02 d8 5e 15 00 00 00 01 00 02 d9 03 15 00 00 00 01 00 02 da 78 15 00 00 00 01 00 02 db 03 15 00 00 00 01 00 02 dc 80 15 00 00 00 01 00 02 dd 03 15 00 00 00 01 00 02 de 89 15 00 00 00 01 00 02 df 03 15 00 00 00 01 00 02 e0 91 15 00 00 00 01 00 02 e1 03 15 00 00 00 01 00 02 e2 9a 15 00 00 00 01 00 02 e3 03 15 00 00 00 01 00 02 e4 a0 15 00 00 00 01 00 02 e5 03 15 00 00 00 01 00 02 e6 a5 15 00 00 00 01 00 02 e7 03 15 00 00 00 01 00 02 e8 a6 15 00 00 00 01 00 02 e9 03 15 00 00 00 01 00 02 ea fd 15 00 00 00 01 00 02 fb 01 15 01 00 00 01 00 02 ff 10];
        qcom,mdss-dsi-dispparam-papermode-state = "dsi_hs_mode";
        qcom,mdss-dsi-dispparam-papermode1-command = [15 01 00 00 78 00 02 ff 20 15 00 00 00 01 00 02 fb 01 15 00 00 00 01 00 02 75 00 15 00 00 00 01 00 02 76 f0 15 00 00 00 01 00 02 77 00 15 00 00 00 01 00 02 78 fa 15 00 00 00 01 00 02 79 01 15 00 00 00 01 00 02 7a 0c 15 00 00 00 01 00 02 7b 01 15 00 00 00 01 00 02 7c 1c 15 00 00 00 01 00 02 7d 01 15 00 00 00 01 00 02 7e 2a 15 00 00 00 01 00 02 7f 01 15 00 00 00 01 00 02 80 36 15 00 00 00 01 00 02 81 01 15 00 00 00 01 00 02 82 42 15 00 00 00 01 00 02 83 01 15 00 00 00 01 00 02 84 4d 15 00 00 00 01 00 02 85 01 15 00 00 00 01 00 02 86 57 15 00 00 00 01 00 02 87 01 15 00 00 00 01 00 02 88 79 15 00 00 00 01 00 02 89 01 15 00 00 00 01 00 02 8a 95 15 00 00 00 01 00 02 8b 01 15 00 00 00 01 00 02 8c c3 15 00 00 00 01 00 02 8d 01 15 00 00 00 01 00 02 8e e8 15 00 00 00 01 00 02 8f 02 15 00 00 00 01 00 02 90 21 15 00 00 00 01 00 02 91 02 15 00 00 00 01 00 02 92 51 15 00 00 00 01 00 02 93 02 15 00 00 00 01 00 02 94 52 15 00 00 00 01 00 02 95 02 15 00 00 00 01 00 02 96 7f 15 00 00 00 01 00 02 97 02 15 00 00 00 01 00 02 98 b2 15 00 00 00 01 00 02 99 02 15 00 00 00 01 00 02 9a d9 15 00 00 00 01 00 02 9b 03 15 00 00 00 01 00 02 9c 04 15 00 00 00 01 00 02 9d 03 15 00 00 00 01 00 02 9e 26 15 00 00 00 01 00 02 9f 03 15 00 00 00 01 00 02 a0 4e 15 00 00 00 01 00 02 a2 03 15 00 00 00 01 00 02 a3 59 15 00 00 00 01 00 02 a4 03 15 00 00 00 01 00 02 a5 65 15 00 00 00 01 00 02 a6 03 15 00 00 00 01 00 02 a7 73 15 00 00 00 01 00 02 a9 03 15 00 00 00 01 00 02 aa 81 15 00 00 00 01 00 02 ab 03 15 00 00 00 01 00 02 ac 91 15 00 00 00 01 00 02 ad 03 15 00 00 00 01 00 02 ae a2 15 00 00 00 01 00 02 af 03 15 00 00 00 01 00 02 b0 ae 15 00 00 00 01 00 02 b1 03 15 00 00 00 01 00 02 b2 fd 15 00 00 00 01 00 02 b3 00 15 00 00 00 01 00 02 b4 f0 15 00 00 00 01 00 02 b5 00 15 00 00 00 01 00 02 b6 fa 15 00 00 00 01 00 02 b7 01 15 00 00 00 01 00 02 b8 0c 15 00 00 00 01 00 02 b9 01 15 00 00 00 01 00 02 ba 1c 15 00 00 00 01 00 02 bb 01 15 00 00 00 01 00 02 bc 2a 15 00 00 00 01 00 02 bd 01 15 00 00 00 01 00 02 be 36 15 00 00 00 01 00 02 bf 01 15 00 00 00 01 00 02 c0 42 15 00 00 00 01 00 02 c1 01 15 00 00 00 01 00 02 c2 4d 15 00 00 00 01 00 02 c3 01 15 00 00 00 01 00 02 c4 57 15 00 00 00 01 00 02 c5 01 15 00 00 00 01 00 02 c6 79 15 00 00 00 01 00 02 c7 01 15 00 00 00 01 00 02 c8 95 15 00 00 00 01 00 02 c9 01 15 00 00 00 01 00 02 ca c3 15 00 00 00 01 00 02 cb 01 15 00 00 00 01 00 02 cc e8 15 00 00 00 01 00 02 cd 02 15 00 00 00 01 00 02 ce 21 15 00 00 00 01 00 02 cf 02 15 00 00 00 01 00 02 d0 51 15 00 00 00 01 00 02 d1 02 15 00 00 00 01 00 02 d2 52 15 00 00 00 01 00 02 d3 02 15 00 00 00 01 00 02 d4 7f 15 00 00 00 01 00 02 d5 02 15 00 00 00 01 00 02 d6 b2 15 00 00 00 01 00 02 d7 02 15 00 00 00 01 00 02 d8 d9 15 00 00 00 01 00 02 d9 03 15 00 00 00 01 00 02 da 04 15 00 00 00 01 00 02 db 03 15 00 00 00 01 00 02 dc 26 15 00 00 00 01 00 02 dd 03 15 00 00 00 01 00 02 de 4e 15 00 00 00 01 00 02 df 03 15 00 00 00 01 00 02 e0 59 15 00 00 00 01 00 02 e1 03 15 00 00 00 01 00 02 e2 65 15 00 00 00 01 00 02 e3 03 15 00 00 00 01 00 02 e4 73 15 00 00 00 01 00 02 e5 03 15 00 00 00 01 00 02 e6 81 15 00 00 00 01 00 02 e7 03 15 00 00 00 01 00 02 e8 91 15 00 00 00 01 00 02 e9 03 15 00 00 00 01 00 02 ea a2 15 00 00 00 01 00 02 eb 03 15 00 00 00 01 00 02 ec ae 15 00 00 00 01 00 02 ed 03 15 00 00 00 01 00 02 ee fd 15 00 00 00 01 00 02 ef 00 15 00 00 00 01 00 02 f0 bd 15 00 00 00 01 00 02 f1 00 15 00 00 00 01 00 02 f2 cc 15 00 00 00 01 00 02 f3 00 15 00 00 00 01 00 02 f4 e6 15 00 00 00 01 00 02 f5 00 15 00 00 00 01 00 02 f6 fa 15 00 00 00 01 00 02 f7 01 15 00 00 00 01 00 02 f8 0b 15 00 00 00 01 00 02 f9 01 15 00 00 00 01 00 02 fa 1b 15 00 00 00 01 00 02 ff 21 15 00 00 00 01 00 02 fb 01 15 00 00 00 01 00 02 00 01 15 00 00 00 01 00 02 01 28 15 00 00 00 01 00 02 02 01 15 00 00 00 01 00 02 03 35 15 00 00 00 01 00 02 04 01 15 00 00 00 01 00 02 05 40 15 00 00 00 01 00 02 06 01 15 00 00 00 01 00 02 07 67 15 00 00 00 01 00 02 08 01 15 00 00 00 01 00 02 09 87 15 00 00 00 01 00 02 0a 01 15 00 00 00 01 00 02 0b b9 15 00 00 00 01 00 02 0c 01 15 00 00 00 01 00 02 0d e0 15 00 00 00 01 00 02 0e 02 15 00 00 00 01 00 02 0f 1d 15 00 00 00 01 00 02 10 02 15 00 00 00 01 00 02 11 4e 15 00 00 00 01 00 02 12 02 15 00 00 00 01 00 02 13 4f 15 00 00 00 01 00 02 14 02 15 00 00 00 01 00 02 15 7d 15 00 00 00 01 00 02 16 02 15 00 00 00 01 00 02 17 b1 15 00 00 00 01 00 02 18 02 15 00 00 00 01 00 02 19 da 15 00 00 00 01 00 02 1a 03 15 00 00 00 01 00 02 1b 06 15 00 00 00 01 00 02 1c 03 15 00 00 00 01 00 02 1d 25 15 00 00 00 01 00 02 1e 03 15 00 00 00 01 00 02 1f 4d 15 00 00 00 01 00 02 20 03 15 00 00 00 01 00 02 21 59 15 00 00 00 01 00 02 22 03 15 00 00 00 01 00 02 23 68 15 00 00 00 01 00 02 24 03 15 00 00 00 01 00 02 25 7a 15 00 00 00 01 00 02 26 03 15 00 00 00 01 00 02 27 91 15 00 00 00 01 00 02 28 03 15 00 00 00 01 00 02 29 a5 15 00 00 00 01 00 02 2a 03 15 00 00 00 01 00 02 2b b1 15 00 00 00 01 00 02 2d 03 15 00 00 00 01 00 02 2f b6 15 00 00 00 01 00 02 30 03 15 00 00 00 01 00 02 31 fd 15 00 00 00 01 00 02 32 00 15 00 00 00 01 00 02 33 bd 15 00 00 00 01 00 02 34 00 15 00 00 00 01 00 02 35 cc 15 00 00 00 01 00 02 36 00 15 00 00 00 01 00 02 37 e6 15 00 00 00 01 00 02 38 00 15 00 00 00 01 00 02 39 fa 15 00 00 00 01 00 02 3a 01 15 00 00 00 01 00 02 3b 0b 15 00 00 00 01 00 02 3d 01 15 00 00 00 01 00 02 3f 1b 15 00 00 00 01 00 02 40 01 15 00 00 00 01 00 02 41 28 15 00 00 00 01 00 02 42 01 15 00 00 00 01 00 02 43 35 15 00 00 00 01 00 02 44 01 15 00 00 00 01 00 02 45 40 15 00 00 00 01 00 02 46 01 15 00 00 00 01 00 02 47 67 15 00 00 00 01 00 02 48 01 15 00 00 00 01 00 02 49 87 15 00 00 00 01 00 02 4a 01 15 00 00 00 01 00 02 4b b9 15 00 00 00 01 00 02 4c 01 15 00 00 00 01 00 02 4d e0 15 00 00 00 01 00 02 4e 02 15 00 00 00 01 00 02 4f 1d 15 00 00 00 01 00 02 50 02 15 00 00 00 01 00 02 51 4e 15 00 00 00 01 00 02 52 02 15 00 00 00 01 00 02 53 4f 15 00 00 00 01 00 02 54 02 15 00 00 00 01 00 02 55 7d 15 00 00 00 01 00 02 56 02 15 00 00 00 01 00 02 58 b1 15 00 00 00 01 00 02 59 02 15 00 00 00 01 00 02 5a da 15 00 00 00 01 00 02 5b 03 15 00 00 00 01 00 02 5c 06 15 00 00 00 01 00 02 5d 03 15 00 00 00 01 00 02 5e 25 15 00 00 00 01 00 02 5f 03 15 00 00 00 01 00 02 60 4d 15 00 00 00 01 00 02 61 03 15 00 00 00 01 00 02 62 59 15 00 00 00 01 00 02 63 03 15 00 00 00 01 00 02 64 68 15 00 00 00 01 00 02 65 03 15 00 00 00 01 00 02 66 7a 15 00 00 00 01 00 02 67 03 15 00 00 00 01 00 02 68 91 15 00 00 00 01 00 02 69 03 15 00 00 00 01 00 02 6a a5 15 00 00 00 01 00 02 6b 03 15 00 00 00 01 00 02 6c b1 15 00 00 00 01 00 02 6d 03 15 00 00 00 01 00 02 6e b6 15 00 00 00 01 00 02 6f 03 15 00 00 00 01 00 02 70 fd 15 00 00 00 01 00 02 71 01 15 00 00 00 01 00 02 72 bb 15 00 00 00 01 00 02 73 01 15 00 00 00 01 00 02 74 bd 15 00 00 00 01 00 02 75 01 15 00 00 00 01 00 02 76 c1 15 00 00 00 01 00 02 77 01 15 00 00 00 01 00 02 78 c6 15 00 00 00 01 00 02 79 01 15 00 00 00 01 00 02 7a ca 15 00 00 00 01 00 02 7b 01 15 00 00 00 01 00 02 7c ce 15 00 00 00 01 00 02 7d 01 15 00 00 00 01 00 02 7e d2 15 00 00 00 01 00 02 7f 01 15 00 00 00 01 00 02 80 d6 15 00 00 00 01 00 02 81 01 15 00 00 00 01 00 02 82 d9 15 00 00 00 01 00 02 83 01 15 00 00 00 01 00 02 84 e8 15 00 00 00 01 00 02 85 01 15 00 00 00 01 00 02 86 f4 15 00 00 00 01 00 02 87 02 15 00 00 00 01 00 02 88 0d 15 00 00 00 01 00 02 89 02 15 00 00 00 01 00 02 8a 23 15 00 00 00 01 00 02 8b 02 15 00 00 00 01 00 02 8c 4b 15 00 00 00 01 00 02 8d 02 15 00 00 00 01 00 02 8e 70 15 00 00 00 01 00 02 8f 02 15 00 00 00 01 00 02 90 71 15 00 00 00 01 00 02 91 02 15 00 00 00 01 00 02 92 98 15 00 00 00 01 00 02 93 02 15 00 00 00 01 00 02 94 cb 15 00 00 00 01 00 02 95 02 15 00 00 00 01 00 02 96 ec 15 00 00 00 01 00 02 97 03 15 00 00 00 01 00 02 98 1a 15 00 00 00 01 00 02 99 03 15 00 00 00 01 00 02 9a 35 15 00 00 00 01 00 02 9b 03 15 00 00 00 01 00 02 9c 56 15 00 00 00 01 00 02 9d 03 15 00 00 00 01 00 02 9e 60 15 00 00 00 01 00 02 9f 03 15 00 00 00 01 00 02 a0 6a 15 00 00 00 01 00 02 a2 03 15 00 00 00 01 00 02 a3 76 15 00 00 00 01 00 02 a4 03 15 00 00 00 01 00 02 a5 84 15 00 00 00 01 00 02 a6 03 15 00 00 00 01 00 02 a7 93 15 00 00 00 01 00 02 a9 03 15 00 00 00 01 00 02 aa a0 15 00 00 00 01 00 02 ab 03 15 00 00 00 01 00 02 ac a6 15 00 00 00 01 00 02 ad 03 15 00 00 00 01 00 02 ae fd 15 00 00 00 01 00 02 af 01 15 00 00 00 01 00 02 b0 bb 15 00 00 00 01 00 02 b1 01 15 00 00 00 01 00 02 b2 bd 15 00 00 00 01 00 02 b3 01 15 00 00 00 01 00 02 b4 c1 15 00 00 00 01 00 02 b5 01 15 00 00 00 01 00 02 b6 c6 15 00 00 00 01 00 02 b7 01 15 00 00 00 01 00 02 b8 ca 15 00 00 00 01 00 02 b9 01 15 00 00 00 01 00 02 ba ce 15 00 00 00 01 00 02 bb 01 15 00 00 00 01 00 02 bc d2 15 00 00 00 01 00 02 bd 01 15 00 00 00 01 00 02 be d6 15 00 00 00 01 00 02 bf 01 15 00 00 00 01 00 02 c0 d9 15 00 00 00 01 00 02 c1 01 15 00 00 00 01 00 02 c2 e8 15 00 00 00 01 00 02 c3 01 15 00 00 00 01 00 02 c4 f4 15 00 00 00 01 00 02 c5 02 15 00 00 00 01 00 02 c6 0d 15 00 00 00 01 00 02 c7 02 15 00 00 00 01 00 02 c8 23 15 00 00 00 01 00 02 c9 02 15 00 00 00 01 00 02 ca 4b 15 00 00 00 01 00 02 cb 02 15 00 00 00 01 00 02 cc 70 15 00 00 00 01 00 02 cd 02 15 00 00 00 01 00 02 ce 71 15 00 00 00 01 00 02 cf 02 15 00 00 00 01 00 02 d0 98 15 00 00 00 01 00 02 d1 02 15 00 00 00 01 00 02 d2 cb 15 00 00 00 01 00 02 d3 02 15 00 00 00 01 00 02 d4 ec 15 00 00 00 01 00 02 d5 03 15 00 00 00 01 00 02 d6 1a 15 00 00 00 01 00 02 d7 03 15 00 00 00 01 00 02 d8 35 15 00 00 00 01 00 02 d9 03 15 00 00 00 01 00 02 da 56 15 00 00 00 01 00 02 db 03 15 00 00 00 01 00 02 dc 60 15 00 00 00 01 00 02 dd 03 15 00 00 00 01 00 02 de 6a 15 00 00 00 01 00 02 df 03 15 00 00 00 01 00 02 e0 76 15 00 00 00 01 00 02 e1 03 15 00 00 00 01 00 02 e2 84 15 00 00 00 01 00 02 e3 03 15 00 00 00 01 00 02 e4 93 15 00 00 00 01 00 02 e5 03 15 00 00 00 01 00 02 e6 a0 15 00 00 00 01 00 02 e7 03 15 00 00 00 01 00 02 e8 a6 15 00 00 00 01 00 02 e9 03 15 00 00 00 01 00 02 ea fd 15 00 00 00 01 00 02 fb 01 15 01 00 00 01 00 02 ff 10];
        qcom,mdss-dsi-dispparam-papermode1-state = "dsi_hs_mode";
        qcom,mdss-dsi-dispparam-papermode2-command = [15 01 00 00 78 00 02 ff 20 15 00 00 00 01 00 02 fb 01 15 00 00 00 01 00 02 75 00 15 00 00 00 01 00 02 76 f0 15 00 00 00 01 00 02 77 00 15 00 00 00 01 00 02 78 fa 15 00 00 00 01 00 02 79 01 15 00 00 00 01 00 02 7a 0c 15 00 00 00 01 00 02 7b 01 15 00 00 00 01 00 02 7c 1c 15 00 00 00 01 00 02 7d 01 15 00 00 00 01 00 02 7e 2a 15 00 00 00 01 00 02 7f 01 15 00 00 00 01 00 02 80 36 15 00 00 00 01 00 02 81 01 15 00 00 00 01 00 02 82 42 15 00 00 00 01 00 02 83 01 15 00 00 00 01 00 02 84 4d 15 00 00 00 01 00 02 85 01 15 00 00 00 01 00 02 86 57 15 00 00 00 01 00 02 87 01 15 00 00 00 01 00 02 88 79 15 00 00 00 01 00 02 89 01 15 00 00 00 01 00 02 8a 95 15 00 00 00 01 00 02 8b 01 15 00 00 00 01 00 02 8c c3 15 00 00 00 01 00 02 8d 01 15 00 00 00 01 00 02 8e e8 15 00 00 00 01 00 02 8f 02 15 00 00 00 01 00 02 90 21 15 00 00 00 01 00 02 91 02 15 00 00 00 01 00 02 92 51 15 00 00 00 01 00 02 93 02 15 00 00 00 01 00 02 94 52 15 00 00 00 01 00 02 95 02 15 00 00 00 01 00 02 96 7f 15 00 00 00 01 00 02 97 02 15 00 00 00 01 00 02 98 b2 15 00 00 00 01 00 02 99 02 15 00 00 00 01 00 02 9a d9 15 00 00 00 01 00 02 9b 03 15 00 00 00 01 00 02 9c 04 15 00 00 00 01 00 02 9d 03 15 00 00 00 01 00 02 9e 26 15 00 00 00 01 00 02 9f 03 15 00 00 00 01 00 02 a0 4e 15 00 00 00 01 00 02 a2 03 15 00 00 00 01 00 02 a3 59 15 00 00 00 01 00 02 a4 03 15 00 00 00 01 00 02 a5 65 15 00 00 00 01 00 02 a6 03 15 00 00 00 01 00 02 a7 73 15 00 00 00 01 00 02 a9 03 15 00 00 00 01 00 02 aa 81 15 00 00 00 01 00 02 ab 03 15 00 00 00 01 00 02 ac 91 15 00 00 00 01 00 02 ad 03 15 00 00 00 01 00 02 ae a2 15 00 00 00 01 00 02 af 03 15 00 00 00 01 00 02 b0 ae 15 00 00 00 01 00 02 b1 03 15 00 00 00 01 00 02 b2 fd 15 00 00 00 01 00 02 b3 00 15 00 00 00 01 00 02 b4 f0 15 00 00 00 01 00 02 b5 00 15 00 00 00 01 00 02 b6 fa 15 00 00 00 01 00 02 b7 01 15 00 00 00 01 00 02 b8 0c 15 00 00 00 01 00 02 b9 01 15 00 00 00 01 00 02 ba 1c 15 00 00 00 01 00 02 bb 01 15 00 00 00 01 00 02 bc 2a 15 00 00 00 01 00 02 bd 01 15 00 00 00 01 00 02 be 36 15 00 00 00 01 00 02 bf 01 15 00 00 00 01 00 02 c0 42 15 00 00 00 01 00 02 c1 01 15 00 00 00 01 00 02 c2 4d 15 00 00 00 01 00 02 c3 01 15 00 00 00 01 00 02 c4 57 15 00 00 00 01 00 02 c5 01 15 00 00 00 01 00 02 c6 79 15 00 00 00 01 00 02 c7 01 15 00 00 00 01 00 02 c8 95 15 00 00 00 01 00 02 c9 01 15 00 00 00 01 00 02 ca c3 15 00 00 00 01 00 02 cb 01 15 00 00 00 01 00 02 cc e8 15 00 00 00 01 00 02 cd 02 15 00 00 00 01 00 02 ce 21 15 00 00 00 01 00 02 cf 02 15 00 00 00 01 00 02 d0 51 15 00 00 00 01 00 02 d1 02 15 00 00 00 01 00 02 d2 52 15 00 00 00 01 00 02 d3 02 15 00 00 00 01 00 02 d4 7f 15 00 00 00 01 00 02 d5 02 15 00 00 00 01 00 02 d6 b2 15 00 00 00 01 00 02 d7 02 15 00 00 00 01 00 02 d8 d9 15 00 00 00 01 00 02 d9 03 15 00 00 00 01 00 02 da 04 15 00 00 00 01 00 02 db 03 15 00 00 00 01 00 02 dc 26 15 00 00 00 01 00 02 dd 03 15 00 00 00 01 00 02 de 4e 15 00 00 00 01 00 02 df 03 15 00 00 00 01 00 02 e0 59 15 00 00 00 01 00 02 e1 03 15 00 00 00 01 00 02 e2 65 15 00 00 00 01 00 02 e3 03 15 00 00 00 01 00 02 e4 73 15 00 00 00 01 00 02 e5 03 15 00 00 00 01 00 02 e6 81 15 00 00 00 01 00 02 e7 03 15 00 00 00 01 00 02 e8 91 15 00 00 00 01 00 02 e9 03 15 00 00 00 01 00 02 ea a2 15 00 00 00 01 00 02 eb 03 15 00 00 00 01 00 02 ec ae 15 00 00 00 01 00 02 ed 03 15 00 00 00 01 00 02 ee fd 15 00 00 00 01 00 02 ef 00 15 00 00 00 01 00 02 f0 bd 15 00 00 00 01 00 02 f1 00 15 00 00 00 01 00 02 f2 cc 15 00 00 00 01 00 02 f3 00 15 00 00 00 01 00 02 f4 e6 15 00 00 00 01 00 02 f5 00 15 00 00 00 01 00 02 f6 fa 15 00 00 00 01 00 02 f7 01 15 00 00 00 01 00 02 f8 0b 15 00 00 00 01 00 02 f9 01 15 00 00 00 01 00 02 fa 1b 15 00 00 00 01 00 02 ff 21 15 00 00 00 01 00 02 fb 01 15 00 00 00 01 00 02 00 01 15 00 00 00 01 00 02 01 28 15 00 00 00 01 00 02 02 01 15 00 00 00 01 00 02 03 35 15 00 00 00 01 00 02 04 01 15 00 00 00 01 00 02 05 40 15 00 00 00 01 00 02 06 01 15 00 00 00 01 00 02 07 67 15 00 00 00 01 00 02 08 01 15 00 00 00 01 00 02 09 87 15 00 00 00 01 00 02 0a 01 15 00 00 00 01 00 02 0b b9 15 00 00 00 01 00 02 0c 01 15 00 00 00 01 00 02 0d e0 15 00 00 00 01 00 02 0e 02 15 00 00 00 01 00 02 0f 1d 15 00 00 00 01 00 02 10 02 15 00 00 00 01 00 02 11 4e 15 00 00 00 01 00 02 12 02 15 00 00 00 01 00 02 13 4f 15 00 00 00 01 00 02 14 02 15 00 00 00 01 00 02 15 7d 15 00 00 00 01 00 02 16 02 15 00 00 00 01 00 02 17 b1 15 00 00 00 01 00 02 18 02 15 00 00 00 01 00 02 19 da 15 00 00 00 01 00 02 1a 03 15 00 00 00 01 00 02 1b 06 15 00 00 00 01 00 02 1c 03 15 00 00 00 01 00 02 1d 25 15 00 00 00 01 00 02 1e 03 15 00 00 00 01 00 02 1f 4d 15 00 00 00 01 00 02 20 03 15 00 00 00 01 00 02 21 59 15 00 00 00 01 00 02 22 03 15 00 00 00 01 00 02 23 68 15 00 00 00 01 00 02 24 03 15 00 00 00 01 00 02 25 7a 15 00 00 00 01 00 02 26 03 15 00 00 00 01 00 02 27 91 15 00 00 00 01 00 02 28 03 15 00 00 00 01 00 02 29 a5 15 00 00 00 01 00 02 2a 03 15 00 00 00 01 00 02 2b b1 15 00 00 00 01 00 02 2d 03 15 00 00 00 01 00 02 2f b6 15 00 00 00 01 00 02 30 03 15 00 00 00 01 00 02 31 fd 15 00 00 00 01 00 02 32 00 15 00 00 00 01 00 02 33 bd 15 00 00 00 01 00 02 34 00 15 00 00 00 01 00 02 35 cc 15 00 00 00 01 00 02 36 00 15 00 00 00 01 00 02 37 e6 15 00 00 00 01 00 02 38 00 15 00 00 00 01 00 02 39 fa 15 00 00 00 01 00 02 3a 01 15 00 00 00 01 00 02 3b 0b 15 00 00 00 01 00 02 3d 01 15 00 00 00 01 00 02 3f 1b 15 00 00 00 01 00 02 40 01 15 00 00 00 01 00 02 41 28 15 00 00 00 01 00 02 42 01 15 00 00 00 01 00 02 43 35 15 00 00 00 01 00 02 44 01 15 00 00 00 01 00 02 45 40 15 00 00 00 01 00 02 46 01 15 00 00 00 01 00 02 47 67 15 00 00 00 01 00 02 48 01 15 00 00 00 01 00 02 49 87 15 00 00 00 01 00 02 4a 01 15 00 00 00 01 00 02 4b b9 15 00 00 00 01 00 02 4c 01 15 00 00 00 01 00 02 4d e0 15 00 00 00 01 00 02 4e 02 15 00 00 00 01 00 02 4f 1d 15 00 00 00 01 00 02 50 02 15 00 00 00 01 00 02 51 4e 15 00 00 00 01 00 02 52 02 15 00 00 00 01 00 02 53 4f 15 00 00 00 01 00 02 54 02 15 00 00 00 01 00 02 55 7d 15 00 00 00 01 00 02 56 02 15 00 00 00 01 00 02 58 b1 15 00 00 00 01 00 02 59 02 15 00 00 00 01 00 02 5a da 15 00 00 00 01 00 02 5b 03 15 00 00 00 01 00 02 5c 06 15 00 00 00 01 00 02 5d 03 15 00 00 00 01 00 02 5e 25 15 00 00 00 01 00 02 5f 03 15 00 00 00 01 00 02 60 4d 15 00 00 00 01 00 02 61 03 15 00 00 00 01 00 02 62 59 15 00 00 00 01 00 02 63 03 15 00 00 00 01 00 02 64 68 15 00 00 00 01 00 02 65 03 15 00 00 00 01 00 02 66 7a 15 00 00 00 01 00 02 67 03 15 00 00 00 01 00 02 68 91 15 00 00 00 01 00 02 69 03 15 00 00 00 01 00 02 6a a5 15 00 00 00 01 00 02 6b 03 15 00 00 00 01 00 02 6c b1 15 00 00 00 01 00 02 6d 03 15 00 00 00 01 00 02 6e b6 15 00 00 00 01 00 02 6f 03 15 00 00 00 01 00 02 70 fd 15 00 00 00 01 00 02 71 01 15 00 00 00 01 00 02 72 d6 15 00 00 00 01 00 02 73 01 15 00 00 00 01 00 02 74 d8 15 00 00 00 01 00 02 75 01 15 00 00 00 01 00 02 76 db 15 00 00 00 01 00 02 77 01 15 00 00 00 01 00 02 78 df 15 00 00 00 01 00 02 79 01 15 00 00 00 01 00 02 7a e2 15 00 00 00 01 00 02 7b 01 15 00 00 00 01 00 02 7c e6 15 00 00 00 01 00 02 7d 01 15 00 00 00 01 00 02 7e e9 15 00 00 00 01 00 02 7f 01 15 00 00 00 01 00 02 80 ec 15 00 00 00 01 00 02 81 01 15 00 00 00 01 00 02 82 f0 15 00 00 00 01 00 02 83 01 15 00 00 00 01 00 02 84 fb 15 00 00 00 01 00 02 85 02 15 00 00 00 01 00 02 86 07 15 00 00 00 01 00 02 87 02 15 00 00 00 01 00 02 88 1c 15 00 00 00 01 00 02 89 02 15 00 00 00 01 00 02 8a 30 15 00 00 00 01 00 02 8b 02 15 00 00 00 01 00 02 8c 55 15 00 00 00 01 00 02 8d 02 15 00 00 00 01 00 02 8e 78 15 00 00 00 01 00 02 8f 02 15 00 00 00 01 00 02 90 79 15 00 00 00 01 00 02 91 02 15 00 00 00 01 00 02 92 9f 15 00 00 00 01 00 02 93 02 15 00 00 00 01 00 02 94 d5 15 00 00 00 01 00 02 95 02 15 00 00 00 01 00 02 96 f5 15 00 00 00 01 00 02 97 03 15 00 00 00 01 00 02 98 22 15 00 00 00 01 00 02 99 03 15 00 00 00 01 00 02 9a 3e 15 00 00 00 01 00 02 9b 03 15 00 00 00 01 00 02 9c 64 15 00 00 00 01 00 02 9d 03 15 00 00 00 01 00 02 9e 70 15 00 00 00 01 00 02 9f 03 15 00 00 00 01 00 02 a0 80 15 00 00 00 01 00 02 a2 03 15 00 00 00 01 00 02 a3 92 15 00 00 00 01 00 02 a4 03 15 00 00 00 01 00 02 a5 a2 15 00 00 00 01 00 02 a6 03 15 00 00 00 01 00 02 a7 ad 15 00 00 00 01 00 02 a9 03 15 00 00 00 01 00 02 aa b4 15 00 00 00 01 00 02 ab 03 15 00 00 00 01 00 02 ac b6 15 00 00 00 01 00 02 ad 03 15 00 00 00 01 00 02 ae fd 15 00 00 00 01 00 02 af 01 15 00 00 00 01 00 02 b0 d6 15 00 00 00 01 00 02 b1 01 15 00 00 00 01 00 02 b2 d8 15 00 00 00 01 00 02 b3 01 15 00 00 00 01 00 02 b4 db 15 00 00 00 01 00 02 b5 01 15 00 00 00 01 00 02 b6 df 15 00 00 00 01 00 02 b7 01 15 00 00 00 01 00 02 b8 e2 15 00 00 00 01 00 02 b9 01 15 00 00 00 01 00 02 ba e6 15 00 00 00 01 00 02 bb 01 15 00 00 00 01 00 02 bc e9 15 00 00 00 01 00 02 bd 01 15 00 00 00 01 00 02 be ec 15 00 00 00 01 00 02 bf 01 15 00 00 00 01 00 02 c0 f0 15 00 00 00 01 00 02 c1 01 15 00 00 00 01 00 02 c2 fb 15 00 00 00 01 00 02 c3 02 15 00 00 00 01 00 02 c4 07 15 00 00 00 01 00 02 c5 02 15 00 00 00 01 00 02 c6 1c 15 00 00 00 01 00 02 c7 02 15 00 00 00 01 00 02 c8 30 15 00 00 00 01 00 02 c9 02 15 00 00 00 01 00 02 ca 55 15 00 00 00 01 00 02 cb 02 15 00 00 00 01 00 02 cc 78 15 00 00 00 01 00 02 cd 02 15 00 00 00 01 00 02 ce 79 15 00 00 00 01 00 02 cf 02 15 00 00 00 01 00 02 d0 9f 15 00 00 00 01 00 02 d1 02 15 00 00 00 01 00 02 d2 d5 15 00 00 00 01 00 02 d3 02 15 00 00 00 01 00 02 d4 f5 15 00 00 00 01 00 02 d5 03 15 00 00 00 01 00 02 d6 22 15 00 00 00 01 00 02 d7 03 15 00 00 00 01 00 02 d8 3e 15 00 00 00 01 00 02 d9 03 15 00 00 00 01 00 02 da 64 15 00 00 00 01 00 02 db 03 15 00 00 00 01 00 02 dc 70 15 00 00 00 01 00 02 dd 03 15 00 00 00 01 00 02 de 80 15 00 00 00 01 00 02 df 03 15 00 00 00 01 00 02 e0 92 15 00 00 00 01 00 02 e1 03 15 00 00 00 01 00 02 e2 a2 15 00 00 00 01 00 02 e3 03 15 00 00 00 01 00 02 e4 ad 15 00 00 00 01 00 02 e5 03 15 00 00 00 01 00 02 e6 b4 15 00 00 00 01 00 02 e7 03 15 00 00 00 01 00 02 e8 b6 15 00 00 00 01 00 02 e9 03 15 00 00 00 01 00 02 ea fd 15 00 00 00 01 00 02 fb 01 15 01 00 00 01 00 02 ff 10];
        qcom,mdss-dsi-dispparam-papermode2-state = "dsi_hs_mode";
        qcom,mdss-dsi-dispparam-papermode3-command = [15 01 00 00 78 00 02 ff 20 15 00 00 00 01 00 02 fb 01 15 00 00 00 01 00 02 75 00 15 00 00 00 01 00 02 76 f0 15 00 00 00 01 00 02 77 00 15 00 00 00 01 00 02 78 fa 15 00 00 00 01 00 02 79 01 15 00 00 00 01 00 02 7a 0c 15 00 00 00 01 00 02 7b 01 15 00 00 00 01 00 02 7c 1c 15 00 00 00 01 00 02 7d 01 15 00 00 00 01 00 02 7e 2a 15 00 00 00 01 00 02 7f 01 15 00 00 00 01 00 02 80 36 15 00 00 00 01 00 02 81 01 15 00 00 00 01 00 02 82 42 15 00 00 00 01 00 02 83 01 15 00 00 00 01 00 02 84 4d 15 00 00 00 01 00 02 85 01 15 00 00 00 01 00 02 86 57 15 00 00 00 01 00 02 87 01 15 00 00 00 01 00 02 88 79 15 00 00 00 01 00 02 89 01 15 00 00 00 01 00 02 8a 95 15 00 00 00 01 00 02 8b 01 15 00 00 00 01 00 02 8c c3 15 00 00 00 01 00 02 8d 01 15 00 00 00 01 00 02 8e e8 15 00 00 00 01 00 02 8f 02 15 00 00 00 01 00 02 90 21 15 00 00 00 01 00 02 91 02 15 00 00 00 01 00 02 92 51 15 00 00 00 01 00 02 93 02 15 00 00 00 01 00 02 94 52 15 00 00 00 01 00 02 95 02 15 00 00 00 01 00 02 96 7f 15 00 00 00 01 00 02 97 02 15 00 00 00 01 00 02 98 b2 15 00 00 00 01 00 02 99 02 15 00 00 00 01 00 02 9a d9 15 00 00 00 01 00 02 9b 03 15 00 00 00 01 00 02 9c 04 15 00 00 00 01 00 02 9d 03 15 00 00 00 01 00 02 9e 26 15 00 00 00 01 00 02 9f 03 15 00 00 00 01 00 02 a0 4e 15 00 00 00 01 00 02 a2 03 15 00 00 00 01 00 02 a3 59 15 00 00 00 01 00 02 a4 03 15 00 00 00 01 00 02 a5 65 15 00 00 00 01 00 02 a6 03 15 00 00 00 01 00 02 a7 73 15 00 00 00 01 00 02 a9 03 15 00 00 00 01 00 02 aa 81 15 00 00 00 01 00 02 ab 03 15 00 00 00 01 00 02 ac 91 15 00 00 00 01 00 02 ad 03 15 00 00 00 01 00 02 ae a2 15 00 00 00 01 00 02 af 03 15 00 00 00 01 00 02 b0 ae 15 00 00 00 01 00 02 b1 03 15 00 00 00 01 00 02 b2 fd 15 00 00 00 01 00 02 b3 00 15 00 00 00 01 00 02 b4 f0 15 00 00 00 01 00 02 b5 00 15 00 00 00 01 00 02 b6 fa 15 00 00 00 01 00 02 b7 01 15 00 00 00 01 00 02 b8 0c 15 00 00 00 01 00 02 b9 01 15 00 00 00 01 00 02 ba 1c 15 00 00 00 01 00 02 bb 01 15 00 00 00 01 00 02 bc 2a 15 00 00 00 01 00 02 bd 01 15 00 00 00 01 00 02 be 36 15 00 00 00 01 00 02 bf 01 15 00 00 00 01 00 02 c0 42 15 00 00 00 01 00 02 c1 01 15 00 00 00 01 00 02 c2 4d 15 00 00 00 01 00 02 c3 01 15 00 00 00 01 00 02 c4 57 15 00 00 00 01 00 02 c5 01 15 00 00 00 01 00 02 c6 79 15 00 00 00 01 00 02 c7 01 15 00 00 00 01 00 02 c8 95 15 00 00 00 01 00 02 c9 01 15 00 00 00 01 00 02 ca c3 15 00 00 00 01 00 02 cb 01 15 00 00 00 01 00 02 cc e8 15 00 00 00 01 00 02 cd 02 15 00 00 00 01 00 02 ce 21 15 00 00 00 01 00 02 cf 02 15 00 00 00 01 00 02 d0 51 15 00 00 00 01 00 02 d1 02 15 00 00 00 01 00 02 d2 52 15 00 00 00 01 00 02 d3 02 15 00 00 00 01 00 02 d4 7f 15 00 00 00 01 00 02 d5 02 15 00 00 00 01 00 02 d6 b2 15 00 00 00 01 00 02 d7 02 15 00 00 00 01 00 02 d8 d9 15 00 00 00 01 00 02 d9 03 15 00 00 00 01 00 02 da 04 15 00 00 00 01 00 02 db 03 15 00 00 00 01 00 02 dc 26 15 00 00 00 01 00 02 dd 03 15 00 00 00 01 00 02 de 4e 15 00 00 00 01 00 02 df 03 15 00 00 00 01 00 02 e0 59 15 00 00 00 01 00 02 e1 03 15 00 00 00 01 00 02 e2 65 15 00 00 00 01 00 02 e3 03 15 00 00 00 01 00 02 e4 73 15 00 00 00 01 00 02 e5 03 15 00 00 00 01 00 02 e6 81 15 00 00 00 01 00 02 e7 03 15 00 00 00 01 00 02 e8 91 15 00 00 00 01 00 02 e9 03 15 00 00 00 01 00 02 ea a2 15 00 00 00 01 00 02 eb 03 15 00 00 00 01 00 02 ec ae 15 00 00 00 01 00 02 ed 03 15 00 00 00 01 00 02 ee fd 15 00 00 00 01 00 02 ef 00 15 00 00 00 01 00 02 f0 bd 15 00 00 00 01 00 02 f1 00 15 00 00 00 01 00 02 f2 cc 15 00 00 00 01 00 02 f3 00 15 00 00 00 01 00 02 f4 e6 15 00 00 00 01 00 02 f5 00 15 00 00 00 01 00 02 f6 fa 15 00 00 00 01 00 02 f7 01 15 00 00 00 01 00 02 f8 0b 15 00 00 00 01 00 02 f9 01 15 00 00 00 01 00 02 fa 1b 15 00 00 00 01 00 02 ff 21 15 00 00 00 01 00 02 fb 01 15 00 00 00 01 00 02 00 01 15 00 00 00 01 00 02 01 28 15 00 00 00 01 00 02 02 01 15 00 00 00 01 00 02 03 35 15 00 00 00 01 00 02 04 01 15 00 00 00 01 00 02 05 40 15 00 00 00 01 00 02 06 01 15 00 00 00 01 00 02 07 67 15 00 00 00 01 00 02 08 01 15 00 00 00 01 00 02 09 87 15 00 00 00 01 00 02 0a 01 15 00 00 00 01 00 02 0b b9 15 00 00 00 01 00 02 0c 01 15 00 00 00 01 00 02 0d e0 15 00 00 00 01 00 02 0e 02 15 00 00 00 01 00 02 0f 1d 15 00 00 00 01 00 02 10 02 15 00 00 00 01 00 02 11 4e 15 00 00 00 01 00 02 12 02 15 00 00 00 01 00 02 13 4f 15 00 00 00 01 00 02 14 02 15 00 00 00 01 00 02 15 7d 15 00 00 00 01 00 02 16 02 15 00 00 00 01 00 02 17 b1 15 00 00 00 01 00 02 18 02 15 00 00 00 01 00 02 19 da 15 00 00 00 01 00 02 1a 03 15 00 00 00 01 00 02 1b 06 15 00 00 00 01 00 02 1c 03 15 00 00 00 01 00 02 1d 25 15 00 00 00 01 00 02 1e 03 15 00 00 00 01 00 02 1f 4d 15 00 00 00 01 00 02 20 03 15 00 00 00 01 00 02 21 59 15 00 00 00 01 00 02 22 03 15 00 00 00 01 00 02 23 68 15 00 00 00 01 00 02 24 03 15 00 00 00 01 00 02 25 7a 15 00 00 00 01 00 02 26 03 15 00 00 00 01 00 02 27 91 15 00 00 00 01 00 02 28 03 15 00 00 00 01 00 02 29 a5 15 00 00 00 01 00 02 2a 03 15 00 00 00 01 00 02 2b b1 15 00 00 00 01 00 02 2d 03 15 00 00 00 01 00 02 2f b6 15 00 00 00 01 00 02 30 03 15 00 00 00 01 00 02 31 fd 15 00 00 00 01 00 02 32 00 15 00 00 00 01 00 02 33 bd 15 00 00 00 01 00 02 34 00 15 00 00 00 01 00 02 35 cc 15 00 00 00 01 00 02 36 00 15 00 00 00 01 00 02 37 e6 15 00 00 00 01 00 02 38 00 15 00 00 00 01 00 02 39 fa 15 00 00 00 01 00 02 3a 01 15 00 00 00 01 00 02 3b 0b 15 00 00 00 01 00 02 3d 01 15 00 00 00 01 00 02 3f 1b 15 00 00 00 01 00 02 40 01 15 00 00 00 01 00 02 41 28 15 00 00 00 01 00 02 42 01 15 00 00 00 01 00 02 43 35 15 00 00 00 01 00 02 44 01 15 00 00 00 01 00 02 45 40 15 00 00 00 01 00 02 46 01 15 00 00 00 01 00 02 47 67 15 00 00 00 01 00 02 48 01 15 00 00 00 01 00 02 49 87 15 00 00 00 01 00 02 4a 01 15 00 00 00 01 00 02 4b b9 15 00 00 00 01 00 02 4c 01 15 00 00 00 01 00 02 4d e0 15 00 00 00 01 00 02 4e 02 15 00 00 00 01 00 02 4f 1d 15 00 00 00 01 00 02 50 02 15 00 00 00 01 00 02 51 4e 15 00 00 00 01 00 02 52 02 15 00 00 00 01 00 02 53 4f 15 00 00 00 01 00 02 54 02 15 00 00 00 01 00 02 55 7d 15 00 00 00 01 00 02 56 02 15 00 00 00 01 00 02 58 b1 15 00 00 00 01 00 02 59 02 15 00 00 00 01 00 02 5a da 15 00 00 00 01 00 02 5b 03 15 00 00 00 01 00 02 5c 06 15 00 00 00 01 00 02 5d 03 15 00 00 00 01 00 02 5e 25 15 00 00 00 01 00 02 5f 03 15 00 00 00 01 00 02 60 4d 15 00 00 00 01 00 02 61 03 15 00 00 00 01 00 02 62 59 15 00 00 00 01 00 02 63 03 15 00 00 00 01 00 02 64 68 15 00 00 00 01 00 02 65 03 15 00 00 00 01 00 02 66 7a 15 00 00 00 01 00 02 67 03 15 00 00 00 01 00 02 68 91 15 00 00 00 01 00 02 69 03 15 00 00 00 01 00 02 6a a5 15 00 00 00 01 00 02 6b 03 15 00 00 00 01 00 02 6c b1 15 00 00 00 01 00 02 6d 03 15 00 00 00 01 00 02 6e b6 15 00 00 00 01 00 02 6f 03 15 00 00 00 01 00 02 70 fd 15 00 00 00 01 00 02 71 01 15 00 00 00 01 00 02 72 f2 15 00 00 00 01 00 02 73 01 15 00 00 00 01 00 02 74 f3 15 00 00 00 01 00 02 75 01 15 00 00 00 01 00 02 76 f5 15 00 00 00 01 00 02 77 01 15 00 00 00 01 00 02 78 f8 15 00 00 00 01 00 02 79 01 15 00 00 00 01 00 02 7a fb 15 00 00 00 01 00 02 7b 01 15 00 00 00 01 00 02 7c fe 15 00 00 00 01 00 02 7d 02 15 00 00 00 01 00 02 7e 01 15 00 00 00 01 00 02 7f 02 15 00 00 00 01 00 02 80 03 15 00 00 00 01 00 02 81 02 15 00 00 00 01 00 02 82 06 15 00 00 00 01 00 02 83 02 15 00 00 00 01 00 02 84 10 15 00 00 00 01 00 02 85 02 15 00 00 00 01 00 02 86 1a 15 00 00 00 01 00 02 87 02 15 00 00 00 01 00 02 88 2d 15 00 00 00 01 00 02 89 02 15 00 00 00 01 00 02 8a 3e 15 00 00 00 01 00 02 8b 02 15 00 00 00 01 00 02 8c 5f 15 00 00 00 01 00 02 8d 02 15 00 00 00 01 00 02 8e 80 15 00 00 00 01 00 02 8f 02 15 00 00 00 01 00 02 90 81 15 00 00 00 01 00 02 91 02 15 00 00 00 01 00 02 92 a5 15 00 00 00 01 00 02 93 02 15 00 00 00 01 00 02 94 db 15 00 00 00 01 00 02 95 02 15 00 00 00 01 00 02 96 f6 15 00 00 00 01 00 02 97 03 15 00 00 00 01 00 02 98 27 15 00 00 00 01 00 02 99 03 15 00 00 00 01 00 02 9a 44 15 00 00 00 01 00 02 9b 03 15 00 00 00 01 00 02 9c 65 15 00 00 00 01 00 02 9d 03 15 00 00 00 01 00 02 9e 6f 15 00 00 00 01 00 02 9f 03 15 00 00 00 01 00 02 a0 79 15 00 00 00 01 00 02 a2 03 15 00 00 00 01 00 02 a3 84 15 00 00 00 01 00 02 a4 03 15 00 00 00 01 00 02 a5 90 15 00 00 00 01 00 02 a6 03 15 00 00 00 01 00 02 a7 9c 15 00 00 00 01 00 02 a9 03 15 00 00 00 01 00 02 aa a8 15 00 00 00 01 00 02 ab 03 15 00 00 00 01 00 02 ac af 15 00 00 00 01 00 02 ad 03 15 00 00 00 01 00 02 ae fd 15 00 00 00 01 00 02 af 01 15 00 00 00 01 00 02 b0 f2 15 00 00 00 01 00 02 b1 01 15 00 00 00 01 00 02 b2 f3 15 00 00 00 01 00 02 b3 01 15 00 00 00 01 00 02 b4 f5 15 00 00 00 01 00 02 b5 01 15 00 00 00 01 00 02 b6 f8 15 00 00 00 01 00 02 b7 01 15 00 00 00 01 00 02 b8 fb 15 00 00 00 01 00 02 b9 01 15 00 00 00 01 00 02 ba fe 15 00 00 00 01 00 02 bb 02 15 00 00 00 01 00 02 bc 01 15 00 00 00 01 00 02 bd 02 15 00 00 00 01 00 02 be 03 15 00 00 00 01 00 02 bf 02 15 00 00 00 01 00 02 c0 06 15 00 00 00 01 00 02 c1 02 15 00 00 00 01 00 02 c2 10 15 00 00 00 01 00 02 c3 02 15 00 00 00 01 00 02 c4 1a 15 00 00 00 01 00 02 c5 02 15 00 00 00 01 00 02 c6 2d 15 00 00 00 01 00 02 c7 02 15 00 00 00 01 00 02 c8 3e 15 00 00 00 01 00 02 c9 02 15 00 00 00 01 00 02 ca 5f 15 00 00 00 01 00 02 cb 02 15 00 00 00 01 00 02 cc 80 15 00 00 00 01 00 02 cd 02 15 00 00 00 01 00 02 ce 81 15 00 00 00 01 00 02 cf 02 15 00 00 00 01 00 02 d0 a5 15 00 00 00 01 00 02 d1 02 15 00 00 00 01 00 02 d2 db 15 00 00 00 01 00 02 d3 02 15 00 00 00 01 00 02 d4 f6 15 00 00 00 01 00 02 d5 03 15 00 00 00 01 00 02 d6 27 15 00 00 00 01 00 02 d7 03 15 00 00 00 01 00 02 d8 44 15 00 00 00 01 00 02 d9 03 15 00 00 00 01 00 02 da 65 15 00 00 00 01 00 02 db 03 15 00 00 00 01 00 02 dc 6f 15 00 00 00 01 00 02 dd 03 15 00 00 00 01 00 02 de 79 15 00 00 00 01 00 02 df 03 15 00 00 00 01 00 02 e0 84 15 00 00 00 01 00 02 e1 03 15 00 00 00 01 00 02 e2 90 15 00 00 00 01 00 02 e3 03 15 00 00 00 01 00 02 e4 9c 15 00 00 00 01 00 02 e5 03 15 00 00 00 01 00 02 e6 a8 15 00 00 00 01 00 02 e7 03 15 00 00 00 01 00 02 e8 af 15 00 00 00 01 00 02 e9 03 15 00 00 00 01 00 02 ea fd 15 00 00 00 01 00 02 fb 01 15 01 00 00 01 00 02 ff 10];
        qcom,mdss-dsi-dispparam-papermode3-state = "dsi_hs_mode";
        qcom,mdss-dsi-dispparam-papermode4-command = [15 01 00 00 78 00 02 ff 20 15 00 00 00 01 00 02 fb 01 15 00 00 00 01 00 02 75 00 15 00 00 00 01 00 02 76 f0 15 00 00 00 01 00 02 77 00 15 00 00 00 01 00 02 78 fa 15 00 00 00 01 00 02 79 01 15 00 00 00 01 00 02 7a 0c 15 00 00 00 01 00 02 7b 01 15 00 00 00 01 00 02 7c 1c 15 00 00 00 01 00 02 7d 01 15 00 00 00 01 00 02 7e 2a 15 00 00 00 01 00 02 7f 01 15 00 00 00 01 00 02 80 36 15 00 00 00 01 00 02 81 01 15 00 00 00 01 00 02 82 42 15 00 00 00 01 00 02 83 01 15 00 00 00 01 00 02 84 4d 15 00 00 00 01 00 02 85 01 15 00 00 00 01 00 02 86 57 15 00 00 00 01 00 02 87 01 15 00 00 00 01 00 02 88 79 15 00 00 00 01 00 02 89 01 15 00 00 00 01 00 02 8a 95 15 00 00 00 01 00 02 8b 01 15 00 00 00 01 00 02 8c c3 15 00 00 00 01 00 02 8d 01 15 00 00 00 01 00 02 8e e8 15 00 00 00 01 00 02 8f 02 15 00 00 00 01 00 02 90 21 15 00 00 00 01 00 02 91 02 15 00 00 00 01 00 02 92 51 15 00 00 00 01 00 02 93 02 15 00 00 00 01 00 02 94 52 15 00 00 00 01 00 02 95 02 15 00 00 00 01 00 02 96 7f 15 00 00 00 01 00 02 97 02 15 00 00 00 01 00 02 98 b2 15 00 00 00 01 00 02 99 02 15 00 00 00 01 00 02 9a d9 15 00 00 00 01 00 02 9b 03 15 00 00 00 01 00 02 9c 04 15 00 00 00 01 00 02 9d 03 15 00 00 00 01 00 02 9e 26 15 00 00 00 01 00 02 9f 03 15 00 00 00 01 00 02 a0 4e 15 00 00 00 01 00 02 a2 03 15 00 00 00 01 00 02 a3 59 15 00 00 00 01 00 02 a4 03 15 00 00 00 01 00 02 a5 65 15 00 00 00 01 00 02 a6 03 15 00 00 00 01 00 02 a7 73 15 00 00 00 01 00 02 a9 03 15 00 00 00 01 00 02 aa 81 15 00 00 00 01 00 02 ab 03 15 00 00 00 01 00 02 ac 91 15 00 00 00 01 00 02 ad 03 15 00 00 00 01 00 02 ae a2 15 00 00 00 01 00 02 af 03 15 00 00 00 01 00 02 b0 ae 15 00 00 00 01 00 02 b1 03 15 00 00 00 01 00 02 b2 fd 15 00 00 00 01 00 02 b3 00 15 00 00 00 01 00 02 b4 f0 15 00 00 00 01 00 02 b5 00 15 00 00 00 01 00 02 b6 fa 15 00 00 00 01 00 02 b7 01 15 00 00 00 01 00 02 b8 0c 15 00 00 00 01 00 02 b9 01 15 00 00 00 01 00 02 ba 1c 15 00 00 00 01 00 02 bb 01 15 00 00 00 01 00 02 bc 2a 15 00 00 00 01 00 02 bd 01 15 00 00 00 01 00 02 be 36 15 00 00 00 01 00 02 bf 01 15 00 00 00 01 00 02 c0 42 15 00 00 00 01 00 02 c1 01 15 00 00 00 01 00 02 c2 4d 15 00 00 00 01 00 02 c3 01 15 00 00 00 01 00 02 c4 57 15 00 00 00 01 00 02 c5 01 15 00 00 00 01 00 02 c6 79 15 00 00 00 01 00 02 c7 01 15 00 00 00 01 00 02 c8 95 15 00 00 00 01 00 02 c9 01 15 00 00 00 01 00 02 ca c3 15 00 00 00 01 00 02 cb 01 15 00 00 00 01 00 02 cc e8 15 00 00 00 01 00 02 cd 02 15 00 00 00 01 00 02 ce 21 15 00 00 00 01 00 02 cf 02 15 00 00 00 01 00 02 d0 51 15 00 00 00 01 00 02 d1 02 15 00 00 00 01 00 02 d2 52 15 00 00 00 01 00 02 d3 02 15 00 00 00 01 00 02 d4 7f 15 00 00 00 01 00 02 d5 02 15 00 00 00 01 00 02 d6 b2 15 00 00 00 01 00 02 d7 02 15 00 00 00 01 00 02 d8 d9 15 00 00 00 01 00 02 d9 03 15 00 00 00 01 00 02 da 04 15 00 00 00 01 00 02 db 03 15 00 00 00 01 00 02 dc 26 15 00 00 00 01 00 02 dd 03 15 00 00 00 01 00 02 de 4e 15 00 00 00 01 00 02 df 03 15 00 00 00 01 00 02 e0 59 15 00 00 00 01 00 02 e1 03 15 00 00 00 01 00 02 e2 65 15 00 00 00 01 00 02 e3 03 15 00 00 00 01 00 02 e4 73 15 00 00 00 01 00 02 e5 03 15 00 00 00 01 00 02 e6 81 15 00 00 00 01 00 02 e7 03 15 00 00 00 01 00 02 e8 91 15 00 00 00 01 00 02 e9 03 15 00 00 00 01 00 02 ea a2 15 00 00 00 01 00 02 eb 03 15 00 00 00 01 00 02 ec ae 15 00 00 00 01 00 02 ed 03 15 00 00 00 01 00 02 ee fd 15 00 00 00 01 00 02 ef 00 15 00 00 00 01 00 02 f0 bd 15 00 00 00 01 00 02 f1 00 15 00 00 00 01 00 02 f2 cc 15 00 00 00 01 00 02 f3 00 15 00 00 00 01 00 02 f4 e6 15 00 00 00 01 00 02 f5 00 15 00 00 00 01 00 02 f6 fa 15 00 00 00 01 00 02 f7 01 15 00 00 00 01 00 02 f8 0b 15 00 00 00 01 00 02 f9 01 15 00 00 00 01 00 02 fa 1b 15 00 00 00 01 00 02 ff 21 15 00 00 00 01 00 02 fb 01 15 00 00 00 01 00 02 00 01 15 00 00 00 01 00 02 01 28 15 00 00 00 01 00 02 02 01 15 00 00 00 01 00 02 03 35 15 00 00 00 01 00 02 04 01 15 00 00 00 01 00 02 05 40 15 00 00 00 01 00 02 06 01 15 00 00 00 01 00 02 07 67 15 00 00 00 01 00 02 08 01 15 00 00 00 01 00 02 09 87 15 00 00 00 01 00 02 0a 01 15 00 00 00 01 00 02 0b b9 15 00 00 00 01 00 02 0c 01 15 00 00 00 01 00 02 0d e0 15 00 00 00 01 00 02 0e 02 15 00 00 00 01 00 02 0f 1d 15 00 00 00 01 00 02 10 02 15 00 00 00 01 00 02 11 4e 15 00 00 00 01 00 02 12 02 15 00 00 00 01 00 02 13 4f 15 00 00 00 01 00 02 14 02 15 00 00 00 01 00 02 15 7d 15 00 00 00 01 00 02 16 02 15 00 00 00 01 00 02 17 b1 15 00 00 00 01 00 02 18 02 15 00 00 00 01 00 02 19 da 15 00 00 00 01 00 02 1a 03 15 00 00 00 01 00 02 1b 06 15 00 00 00 01 00 02 1c 03 15 00 00 00 01 00 02 1d 25 15 00 00 00 01 00 02 1e 03 15 00 00 00 01 00 02 1f 4d 15 00 00 00 01 00 02 20 03 15 00 00 00 01 00 02 21 59 15 00 00 00 01 00 02 22 03 15 00 00 00 01 00 02 23 68 15 00 00 00 01 00 02 24 03 15 00 00 00 01 00 02 25 7a 15 00 00 00 01 00 02 26 03 15 00 00 00 01 00 02 27 91 15 00 00 00 01 00 02 28 03 15 00 00 00 01 00 02 29 a5 15 00 00 00 01 00 02 2a 03 15 00 00 00 01 00 02 2b b1 15 00 00 00 01 00 02 2d 03 15 00 00 00 01 00 02 2f b6 15 00 00 00 01 00 02 30 03 15 00 00 00 01 00 02 31 fd 15 00 00 00 01 00 02 32 00 15 00 00 00 01 00 02 33 bd 15 00 00 00 01 00 02 34 00 15 00 00 00 01 00 02 35 cc 15 00 00 00 01 00 02 36 00 15 00 00 00 01 00 02 37 e6 15 00 00 00 01 00 02 38 00 15 00 00 00 01 00 02 39 fa 15 00 00 00 01 00 02 3a 01 15 00 00 00 01 00 02 3b 0b 15 00 00 00 01 00 02 3d 01 15 00 00 00 01 00 02 3f 1b 15 00 00 00 01 00 02 40 01 15 00 00 00 01 00 02 41 28 15 00 00 00 01 00 02 42 01 15 00 00 00 01 00 02 43 35 15 00 00 00 01 00 02 44 01 15 00 00 00 01 00 02 45 40 15 00 00 00 01 00 02 46 01 15 00 00 00 01 00 02 47 67 15 00 00 00 01 00 02 48 01 15 00 00 00 01 00 02 49 87 15 00 00 00 01 00 02 4a 01 15 00 00 00 01 00 02 4b b9 15 00 00 00 01 00 02 4c 01 15 00 00 00 01 00 02 4d e0 15 00 00 00 01 00 02 4e 02 15 00 00 00 01 00 02 4f 1d 15 00 00 00 01 00 02 50 02 15 00 00 00 01 00 02 51 4e 15 00 00 00 01 00 02 52 02 15 00 00 00 01 00 02 53 4f 15 00 00 00 01 00 02 54 02 15 00 00 00 01 00 02 55 7d 15 00 00 00 01 00 02 56 02 15 00 00 00 01 00 02 58 b1 15 00 00 00 01 00 02 59 02 15 00 00 00 01 00 02 5a da 15 00 00 00 01 00 02 5b 03 15 00 00 00 01 00 02 5c 06 15 00 00 00 01 00 02 5d 03 15 00 00 00 01 00 02 5e 25 15 00 00 00 01 00 02 5f 03 15 00 00 00 01 00 02 60 4d 15 00 00 00 01 00 02 61 03 15 00 00 00 01 00 02 62 59 15 00 00 00 01 00 02 63 03 15 00 00 00 01 00 02 64 68 15 00 00 00 01 00 02 65 03 15 00 00 00 01 00 02 66 7a 15 00 00 00 01 00 02 67 03 15 00 00 00 01 00 02 68 91 15 00 00 00 01 00 02 69 03 15 00 00 00 01 00 02 6a a5 15 00 00 00 01 00 02 6b 03 15 00 00 00 01 00 02 6c b1 15 00 00 00 01 00 02 6d 03 15 00 00 00 01 00 02 6e b6 15 00 00 00 01 00 02 6f 03 15 00 00 00 01 00 02 70 fd 15 00 00 00 01 00 02 71 02 15 00 00 00 01 00 02 72 0c 15 00 00 00 01 00 02 73 02 15 00 00 00 01 00 02 74 0d 15 00 00 00 01 00 02 75 02 15 00 00 00 01 00 02 76 10 15 00 00 00 01 00 02 77 02 15 00 00 00 01 00 02 78 12 15 00 00 00 01 00 02 79 02 15 00 00 00 01 00 02 7a 14 15 00 00 00 01 00 02 7b 02 15 00 00 00 01 00 02 7c 16 15 00 00 00 01 00 02 7d 02 15 00 00 00 01 00 02 7e 19 15 00 00 00 01 00 02 7f 02 15 00 00 00 01 00 02 80 1b 15 00 00 00 01 00 02 81 02 15 00 00 00 01 00 02 82 1d 15 00 00 00 01 00 02 83 02 15 00 00 00 01 00 02 84 26 15 00 00 00 01 00 02 85 02 15 00 00 00 01 00 02 86 2e 15 00 00 00 01 00 02 87 02 15 00 00 00 01 00 02 88 3f 15 00 00 00 01 00 02 89 02 15 00 00 00 01 00 02 8a 4e 15 00 00 00 01 00 02 8b 02 15 00 00 00 01 00 02 8c 6d 15 00 00 00 01 00 02 8d 02 15 00 00 00 01 00 02 8e 8c 15 00 00 00 01 00 02 8f 02 15 00 00 00 01 00 02 90 8d 15 00 00 00 01 00 02 91 02 15 00 00 00 01 00 02 92 b0 15 00 00 00 01 00 02 93 02 15 00 00 00 01 00 02 94 e4 15 00 00 00 01 00 02 95 03 15 00 00 00 01 00 02 96 03 15 00 00 00 01 00 02 97 03 15 00 00 00 01 00 02 98 2d 15 00 00 00 01 00 02 99 03 15 00 00 00 01 00 02 9a 45 15 00 00 00 01 00 02 9b 03 15 00 00 00 01 00 02 9c 63 15 00 00 00 01 00 02 9d 03 15 00 00 00 01 00 02 9e 6c 15 00 00 00 01 00 02 9f 03 15 00 00 00 01 00 02 a0 76 15 00 00 00 01 00 02 a2 03 15 00 00 00 01 00 02 a3 81 15 00 00 00 01 00 02 a4 03 15 00 00 00 01 00 02 a5 8d 15 00 00 00 01 00 02 a6 03 15 00 00 00 01 00 02 a7 99 15 00 00 00 01 00 02 a9 03 15 00 00 00 01 00 02 aa a2 15 00 00 00 01 00 02 ab 03 15 00 00 00 01 00 02 ac a6 15 00 00 00 01 00 02 ad 03 15 00 00 00 01 00 02 ae fd 15 00 00 00 01 00 02 af 02 15 00 00 00 01 00 02 b0 0c 15 00 00 00 01 00 02 b1 02 15 00 00 00 01 00 02 b2 0d 15 00 00 00 01 00 02 b3 02 15 00 00 00 01 00 02 b4 10 15 00 00 00 01 00 02 b5 02 15 00 00 00 01 00 02 b6 12 15 00 00 00 01 00 02 b7 02 15 00 00 00 01 00 02 b8 14 15 00 00 00 01 00 02 b9 02 15 00 00 00 01 00 02 ba 16 15 00 00 00 01 00 02 bb 02 15 00 00 00 01 00 02 bc 19 15 00 00 00 01 00 02 bd 02 15 00 00 00 01 00 02 be 1b 15 00 00 00 01 00 02 bf 02 15 00 00 00 01 00 02 c0 1d 15 00 00 00 01 00 02 c1 02 15 00 00 00 01 00 02 c2 26 15 00 00 00 01 00 02 c3 02 15 00 00 00 01 00 02 c4 2e 15 00 00 00 01 00 02 c5 02 15 00 00 00 01 00 02 c6 3f 15 00 00 00 01 00 02 c7 02 15 00 00 00 01 00 02 c8 4e 15 00 00 00 01 00 02 c9 02 15 00 00 00 01 00 02 ca 6d 15 00 00 00 01 00 02 cb 02 15 00 00 00 01 00 02 cc 8c 15 00 00 00 01 00 02 cd 02 15 00 00 00 01 00 02 ce 8d 15 00 00 00 01 00 02 cf 02 15 00 00 00 01 00 02 d0 b0 15 00 00 00 01 00 02 d1 02 15 00 00 00 01 00 02 d2 e4 15 00 00 00 01 00 02 d3 03 15 00 00 00 01 00 02 d4 03 15 00 00 00 01 00 02 d5 03 15 00 00 00 01 00 02 d6 2d 15 00 00 00 01 00 02 d7 03 15 00 00 00 01 00 02 d8 45 15 00 00 00 01 00 02 d9 03 15 00 00 00 01 00 02 da 63 15 00 00 00 01 00 02 db 03 15 00 00 00 01 00 02 dc 6c 15 00 00 00 01 00 02 dd 03 15 00 00 00 01 00 02 de 76 15 00 00 00 01 00 02 df 03 15 00 00 00 01 00 02 e0 81 15 00 00 00 01 00 02 e1 03 15 00 00 00 01 00 02 e2 8d 15 00 00 00 01 00 02 e3 03 15 00 00 00 01 00 02 e4 99 15 00 00 00 01 00 02 e5 03 15 00 00 00 01 00 02 e6 a2 15 00 00 00 01 00 02 e7 03 15 00 00 00 01 00 02 e8 a6 15 00 00 00 01 00 02 e9 03 15 00 00 00 01 00 02 ea fd 15 00 00 00 01 00 02 fb 01 15 01 00 00 01 00 02 ff 10];
        qcom,mdss-dsi-dispparam-papermode4-state = "dsi_hs_mode";
        qcom,mdss-dsi-dispparam-papermode5-command = [15 01 00 00 78 00 02 ff 20 15 00 00 00 01 00 02 fb 01 15 00 00 00 01 00 02 75 00 15 00 00 00 01 00 02 76 f0 15 00 00 00 01 00 02 77 00 15 00 00 00 01 00 02 78 fa 15 00 00 00 01 00 02 79 01 15 00 00 00 01 00 02 7a 0c 15 00 00 00 01 00 02 7b 01 15 00 00 00 01 00 02 7c 1c 15 00 00 00 01 00 02 7d 01 15 00 00 00 01 00 02 7e 2a 15 00 00 00 01 00 02 7f 01 15 00 00 00 01 00 02 80 36 15 00 00 00 01 00 02 81 01 15 00 00 00 01 00 02 82 42 15 00 00 00 01 00 02 83 01 15 00 00 00 01 00 02 84 4d 15 00 00 00 01 00 02 85 01 15 00 00 00 01 00 02 86 57 15 00 00 00 01 00 02 87 01 15 00 00 00 01 00 02 88 79 15 00 00 00 01 00 02 89 01 15 00 00 00 01 00 02 8a 95 15 00 00 00 01 00 02 8b 01 15 00 00 00 01 00 02 8c c3 15 00 00 00 01 00 02 8d 01 15 00 00 00 01 00 02 8e e8 15 00 00 00 01 00 02 8f 02 15 00 00 00 01 00 02 90 21 15 00 00 00 01 00 02 91 02 15 00 00 00 01 00 02 92 51 15 00 00 00 01 00 02 93 02 15 00 00 00 01 00 02 94 52 15 00 00 00 01 00 02 95 02 15 00 00 00 01 00 02 96 7f 15 00 00 00 01 00 02 97 02 15 00 00 00 01 00 02 98 b2 15 00 00 00 01 00 02 99 02 15 00 00 00 01 00 02 9a d9 15 00 00 00 01 00 02 9b 03 15 00 00 00 01 00 02 9c 04 15 00 00 00 01 00 02 9d 03 15 00 00 00 01 00 02 9e 26 15 00 00 00 01 00 02 9f 03 15 00 00 00 01 00 02 a0 4e 15 00 00 00 01 00 02 a2 03 15 00 00 00 01 00 02 a3 59 15 00 00 00 01 00 02 a4 03 15 00 00 00 01 00 02 a5 65 15 00 00 00 01 00 02 a6 03 15 00 00 00 01 00 02 a7 73 15 00 00 00 01 00 02 a9 03 15 00 00 00 01 00 02 aa 81 15 00 00 00 01 00 02 ab 03 15 00 00 00 01 00 02 ac 91 15 00 00 00 01 00 02 ad 03 15 00 00 00 01 00 02 ae a2 15 00 00 00 01 00 02 af 03 15 00 00 00 01 00 02 b0 ae 15 00 00 00 01 00 02 b1 03 15 00 00 00 01 00 02 b2 fd 15 00 00 00 01 00 02 b3 00 15 00 00 00 01 00 02 b4 f0 15 00 00 00 01 00 02 b5 00 15 00 00 00 01 00 02 b6 fa 15 00 00 00 01 00 02 b7 01 15 00 00 00 01 00 02 b8 0c 15 00 00 00 01 00 02 b9 01 15 00 00 00 01 00 02 ba 1c 15 00 00 00 01 00 02 bb 01 15 00 00 00 01 00 02 bc 2a 15 00 00 00 01 00 02 bd 01 15 00 00 00 01 00 02 be 36 15 00 00 00 01 00 02 bf 01 15 00 00 00 01 00 02 c0 42 15 00 00 00 01 00 02 c1 01 15 00 00 00 01 00 02 c2 4d 15 00 00 00 01 00 02 c3 01 15 00 00 00 01 00 02 c4 57 15 00 00 00 01 00 02 c5 01 15 00 00 00 01 00 02 c6 79 15 00 00 00 01 00 02 c7 01 15 00 00 00 01 00 02 c8 95 15 00 00 00 01 00 02 c9 01 15 00 00 00 01 00 02 ca c3 15 00 00 00 01 00 02 cb 01 15 00 00 00 01 00 02 cc e8 15 00 00 00 01 00 02 cd 02 15 00 00 00 01 00 02 ce 21 15 00 00 00 01 00 02 cf 02 15 00 00 00 01 00 02 d0 51 15 00 00 00 01 00 02 d1 02 15 00 00 00 01 00 02 d2 52 15 00 00 00 01 00 02 d3 02 15 00 00 00 01 00 02 d4 7f 15 00 00 00 01 00 02 d5 02 15 00 00 00 01 00 02 d6 b2 15 00 00 00 01 00 02 d7 02 15 00 00 00 01 00 02 d8 d9 15 00 00 00 01 00 02 d9 03 15 00 00 00 01 00 02 da 04 15 00 00 00 01 00 02 db 03 15 00 00 00 01 00 02 dc 26 15 00 00 00 01 00 02 dd 03 15 00 00 00 01 00 02 de 4e 15 00 00 00 01 00 02 df 03 15 00 00 00 01 00 02 e0 59 15 00 00 00 01 00 02 e1 03 15 00 00 00 01 00 02 e2 65 15 00 00 00 01 00 02 e3 03 15 00 00 00 01 00 02 e4 73 15 00 00 00 01 00 02 e5 03 15 00 00 00 01 00 02 e6 81 15 00 00 00 01 00 02 e7 03 15 00 00 00 01 00 02 e8 91 15 00 00 00 01 00 02 e9 03 15 00 00 00 01 00 02 ea a2 15 00 00 00 01 00 02 eb 03 15 00 00 00 01 00 02 ec ae 15 00 00 00 01 00 02 ed 03 15 00 00 00 01 00 02 ee fd 15 00 00 00 01 00 02 ef 00 15 00 00 00 01 00 02 f0 bd 15 00 00 00 01 00 02 f1 00 15 00 00 00 01 00 02 f2 cc 15 00 00 00 01 00 02 f3 00 15 00 00 00 01 00 02 f4 e6 15 00 00 00 01 00 02 f5 00 15 00 00 00 01 00 02 f6 fa 15 00 00 00 01 00 02 f7 01 15 00 00 00 01 00 02 f8 0b 15 00 00 00 01 00 02 f9 01 15 00 00 00 01 00 02 fa 1b 15 00 00 00 01 00 02 ff 21 15 00 00 00 01 00 02 fb 01 15 00 00 00 01 00 02 00 01 15 00 00 00 01 00 02 01 28 15 00 00 00 01 00 02 02 01 15 00 00 00 01 00 02 03 35 15 00 00 00 01 00 02 04 01 15 00 00 00 01 00 02 05 40 15 00 00 00 01 00 02 06 01 15 00 00 00 01 00 02 07 67 15 00 00 00 01 00 02 08 01 15 00 00 00 01 00 02 09 87 15 00 00 00 01 00 02 0a 01 15 00 00 00 01 00 02 0b b9 15 00 00 00 01 00 02 0c 01 15 00 00 00 01 00 02 0d e0 15 00 00 00 01 00 02 0e 02 15 00 00 00 01 00 02 0f 1d 15 00 00 00 01 00 02 10 02 15 00 00 00 01 00 02 11 4e 15 00 00 00 01 00 02 12 02 15 00 00 00 01 00 02 13 4f 15 00 00 00 01 00 02 14 02 15 00 00 00 01 00 02 15 7d 15 00 00 00 01 00 02 16 02 15 00 00 00 01 00 02 17 b1 15 00 00 00 01 00 02 18 02 15 00 00 00 01 00 02 19 da 15 00 00 00 01 00 02 1a 03 15 00 00 00 01 00 02 1b 06 15 00 00 00 01 00 02 1c 03 15 00 00 00 01 00 02 1d 25 15 00 00 00 01 00 02 1e 03 15 00 00 00 01 00 02 1f 4d 15 00 00 00 01 00 02 20 03 15 00 00 00 01 00 02 21 59 15 00 00 00 01 00 02 22 03 15 00 00 00 01 00 02 23 68 15 00 00 00 01 00 02 24 03 15 00 00 00 01 00 02 25 7a 15 00 00 00 01 00 02 26 03 15 00 00 00 01 00 02 27 91 15 00 00 00 01 00 02 28 03 15 00 00 00 01 00 02 29 a5 15 00 00 00 01 00 02 2a 03 15 00 00 00 01 00 02 2b b1 15 00 00 00 01 00 02 2d 03 15 00 00 00 01 00 02 2f b6 15 00 00 00 01 00 02 30 03 15 00 00 00 01 00 02 31 fd 15 00 00 00 01 00 02 32 00 15 00 00 00 01 00 02 33 bd 15 00 00 00 01 00 02 34 00 15 00 00 00 01 00 02 35 cc 15 00 00 00 01 00 02 36 00 15 00 00 00 01 00 02 37 e6 15 00 00 00 01 00 02 38 00 15 00 00 00 01 00 02 39 fa 15 00 00 00 01 00 02 3a 01 15 00 00 00 01 00 02 3b 0b 15 00 00 00 01 00 02 3d 01 15 00 00 00 01 00 02 3f 1b 15 00 00 00 01 00 02 40 01 15 00 00 00 01 00 02 41 28 15 00 00 00 01 00 02 42 01 15 00 00 00 01 00 02 43 35 15 00 00 00 01 00 02 44 01 15 00 00 00 01 00 02 45 40 15 00 00 00 01 00 02 46 01 15 00 00 00 01 00 02 47 67 15 00 00 00 01 00 02 48 01 15 00 00 00 01 00 02 49 87 15 00 00 00 01 00 02 4a 01 15 00 00 00 01 00 02 4b b9 15 00 00 00 01 00 02 4c 01 15 00 00 00 01 00 02 4d e0 15 00 00 00 01 00 02 4e 02 15 00 00 00 01 00 02 4f 1d 15 00 00 00 01 00 02 50 02 15 00 00 00 01 00 02 51 4e 15 00 00 00 01 00 02 52 02 15 00 00 00 01 00 02 53 4f 15 00 00 00 01 00 02 54 02 15 00 00 00 01 00 02 55 7d 15 00 00 00 01 00 02 56 02 15 00 00 00 01 00 02 58 b1 15 00 00 00 01 00 02 59 02 15 00 00 00 01 00 02 5a da 15 00 00 00 01 00 02 5b 03 15 00 00 00 01 00 02 5c 06 15 00 00 00 01 00 02 5d 03 15 00 00 00 01 00 02 5e 25 15 00 00 00 01 00 02 5f 03 15 00 00 00 01 00 02 60 4d 15 00 00 00 01 00 02 61 03 15 00 00 00 01 00 02 62 59 15 00 00 00 01 00 02 63 03 15 00 00 00 01 00 02 64 68 15 00 00 00 01 00 02 65 03 15 00 00 00 01 00 02 66 7a 15 00 00 00 01 00 02 67 03 15 00 00 00 01 00 02 68 91 15 00 00 00 01 00 02 69 03 15 00 00 00 01 00 02 6a a5 15 00 00 00 01 00 02 6b 03 15 00 00 00 01 00 02 6c b1 15 00 00 00 01 00 02 6d 03 15 00 00 00 01 00 02 6e b6 15 00 00 00 01 00 02 6f 03 15 00 00 00 01 00 02 70 fd 15 00 00 00 01 00 02 71 02 15 00 00 00 01 00 02 72 1d 15 00 00 00 01 00 02 73 02 15 00 00 00 01 00 02 74 1e 15 00 00 00 01 00 02 75 02 15 00 00 00 01 00 02 76 20 15 00 00 00 01 00 02 77 02 15 00 00 00 01 00 02 78 22 15 00 00 00 01 00 02 79 02 15 00 00 00 01 00 02 7a 24 15 00 00 00 01 00 02 7b 02 15 00 00 00 01 00 02 7c 26 15 00 00 00 01 00 02 7d 02 15 00 00 00 01 00 02 7e 28 15 00 00 00 01 00 02 7f 02 15 00 00 00 01 00 02 80 2a 15 00 00 00 01 00 02 81 02 15 00 00 00 01 00 02 82 2c 15 00 00 00 01 00 02 83 02 15 00 00 00 01 00 02 84 34 15 00 00 00 01 00 02 85 02 15 00 00 00 01 00 02 86 3b 15 00 00 00 01 00 02 87 02 15 00 00 00 01 00 02 88 4a 15 00 00 00 01 00 02 89 02 15 00 00 00 01 00 02 8a 59 15 00 00 00 01 00 02 8b 02 15 00 00 00 01 00 02 8c 75 15 00 00 00 01 00 02 8d 02 15 00 00 00 01 00 02 8e 92 15 00 00 00 01 00 02 8f 02 15 00 00 00 01 00 02 90 93 15 00 00 00 01 00 02 91 02 15 00 00 00 01 00 02 92 b7 15 00 00 00 01 00 02 93 02 15 00 00 00 01 00 02 94 e8 15 00 00 00 01 00 02 95 03 15 00 00 00 01 00 02 96 08 15 00 00 00 01 00 02 97 03 15 00 00 00 01 00 02 98 35 15 00 00 00 01 00 02 99 03 15 00 00 00 01 00 02 9a 50 15 00 00 00 01 00 02 9b 03 15 00 00 00 01 00 02 9c 6f 15 00 00 00 01 00 02 9d 03 15 00 00 00 01 00 02 9e 77 15 00 00 00 01 00 02 9f 03 15 00 00 00 01 00 02 a0 81 15 00 00 00 01 00 02 a2 03 15 00 00 00 01 00 02 a3 8b 15 00 00 00 01 00 02 a4 03 15 00 00 00 01 00 02 a5 95 15 00 00 00 01 00 02 a6 03 15 00 00 00 01 00 02 a7 a0 15 00 00 00 01 00 02 a9 03 15 00 00 00 01 00 02 aa aa 15 00 00 00 01 00 02 ab 03 15 00 00 00 01 00 02 ac af 15 00 00 00 01 00 02 ad 03 15 00 00 00 01 00 02 ae fd 15 00 00 00 01 00 02 af 02 15 00 00 00 01 00 02 b0 1d 15 00 00 00 01 00 02 b1 02 15 00 00 00 01 00 02 b2 1e 15 00 00 00 01 00 02 b3 02 15 00 00 00 01 00 02 b4 20 15 00 00 00 01 00 02 b5 02 15 00 00 00 01 00 02 b6 22 15 00 00 00 01 00 02 b7 02 15 00 00 00 01 00 02 b8 24 15 00 00 00 01 00 02 b9 02 15 00 00 00 01 00 02 ba 26 15 00 00 00 01 00 02 bb 02 15 00 00 00 01 00 02 bc 28 15 00 00 00 01 00 02 bd 02 15 00 00 00 01 00 02 be 2a 15 00 00 00 01 00 02 bf 02 15 00 00 00 01 00 02 c0 2c 15 00 00 00 01 00 02 c1 02 15 00 00 00 01 00 02 c2 34 15 00 00 00 01 00 02 c3 02 15 00 00 00 01 00 02 c4 3b 15 00 00 00 01 00 02 c5 02 15 00 00 00 01 00 02 c6 4a 15 00 00 00 01 00 02 c7 02 15 00 00 00 01 00 02 c8 59 15 00 00 00 01 00 02 c9 02 15 00 00 00 01 00 02 ca 75 15 00 00 00 01 00 02 cb 02 15 00 00 00 01 00 02 cc 92 15 00 00 00 01 00 02 cd 02 15 00 00 00 01 00 02 ce 93 15 00 00 00 01 00 02 cf 02 15 00 00 00 01 00 02 d0 b7 15 00 00 00 01 00 02 d1 02 15 00 00 00 01 00 02 d2 e8 15 00 00 00 01 00 02 d3 03 15 00 00 00 01 00 02 d4 08 15 00 00 00 01 00 02 d5 03 15 00 00 00 01 00 02 d6 35 15 00 00 00 01 00 02 d7 03 15 00 00 00 01 00 02 d8 50 15 00 00 00 01 00 02 d9 03 15 00 00 00 01 00 02 da 6f 15 00 00 00 01 00 02 db 03 15 00 00 00 01 00 02 dc 77 15 00 00 00 01 00 02 dd 03 15 00 00 00 01 00 02 de 81 15 00 00 00 01 00 02 df 03 15 00 00 00 01 00 02 e0 8b 15 00 00 00 01 00 02 e1 03 15 00 00 00 01 00 02 e2 95 15 00 00 00 01 00 02 e3 03 15 00 00 00 01 00 02 e4 a0 15 00 00 00 01 00 02 e5 03 15 00 00 00 01 00 02 e6 aa 15 00 00 00 01 00 02 e7 03 15 00 00 00 01 00 02 e8 af 15 00 00 00 01 00 02 e9 03 15 00 00 00 01 00 02 ea fd 15 00 00 00 01 00 02 fb 01 15 01 00 00 01 00 02 ff 10];
        qcom,mdss-dsi-dispparam-papermode5-state = "dsi_hs_mode";
        qcom,mdss-dsi-dispparam-papermode6-command = [15 01 00 00 78 00 02 ff 20 15 00 00 00 01 00 02 fb 01 15 00 00 00 01 00 02 75 00 15 00 00 00 01 00 02 76 f0 15 00 00 00 01 00 02 77 00 15 00 00 00 01 00 02 78 fa 15 00 00 00 01 00 02 79 01 15 00 00 00 01 00 02 7a 0c 15 00 00 00 01 00 02 7b 01 15 00 00 00 01 00 02 7c 1c 15 00 00 00 01 00 02 7d 01 15 00 00 00 01 00 02 7e 2a 15 00 00 00 01 00 02 7f 01 15 00 00 00 01 00 02 80 36 15 00 00 00 01 00 02 81 01 15 00 00 00 01 00 02 82 42 15 00 00 00 01 00 02 83 01 15 00 00 00 01 00 02 84 4d 15 00 00 00 01 00 02 85 01 15 00 00 00 01 00 02 86 57 15 00 00 00 01 00 02 87 01 15 00 00 00 01 00 02 88 79 15 00 00 00 01 00 02 89 01 15 00 00 00 01 00 02 8a 95 15 00 00 00 01 00 02 8b 01 15 00 00 00 01 00 02 8c c3 15 00 00 00 01 00 02 8d 01 15 00 00 00 01 00 02 8e e8 15 00 00 00 01 00 02 8f 02 15 00 00 00 01 00 02 90 21 15 00 00 00 01 00 02 91 02 15 00 00 00 01 00 02 92 51 15 00 00 00 01 00 02 93 02 15 00 00 00 01 00 02 94 52 15 00 00 00 01 00 02 95 02 15 00 00 00 01 00 02 96 7f 15 00 00 00 01 00 02 97 02 15 00 00 00 01 00 02 98 b2 15 00 00 00 01 00 02 99 02 15 00 00 00 01 00 02 9a d9 15 00 00 00 01 00 02 9b 03 15 00 00 00 01 00 02 9c 04 15 00 00 00 01 00 02 9d 03 15 00 00 00 01 00 02 9e 26 15 00 00 00 01 00 02 9f 03 15 00 00 00 01 00 02 a0 4e 15 00 00 00 01 00 02 a2 03 15 00 00 00 01 00 02 a3 59 15 00 00 00 01 00 02 a4 03 15 00 00 00 01 00 02 a5 65 15 00 00 00 01 00 02 a6 03 15 00 00 00 01 00 02 a7 73 15 00 00 00 01 00 02 a9 03 15 00 00 00 01 00 02 aa 81 15 00 00 00 01 00 02 ab 03 15 00 00 00 01 00 02 ac 91 15 00 00 00 01 00 02 ad 03 15 00 00 00 01 00 02 ae a2 15 00 00 00 01 00 02 af 03 15 00 00 00 01 00 02 b0 ae 15 00 00 00 01 00 02 b1 03 15 00 00 00 01 00 02 b2 fd 15 00 00 00 01 00 02 b3 00 15 00 00 00 01 00 02 b4 f0 15 00 00 00 01 00 02 b5 00 15 00 00 00 01 00 02 b6 fa 15 00 00 00 01 00 02 b7 01 15 00 00 00 01 00 02 b8 0c 15 00 00 00 01 00 02 b9 01 15 00 00 00 01 00 02 ba 1c 15 00 00 00 01 00 02 bb 01 15 00 00 00 01 00 02 bc 2a 15 00 00 00 01 00 02 bd 01 15 00 00 00 01 00 02 be 36 15 00 00 00 01 00 02 bf 01 15 00 00 00 01 00 02 c0 42 15 00 00 00 01 00 02 c1 01 15 00 00 00 01 00 02 c2 4d 15 00 00 00 01 00 02 c3 01 15 00 00 00 01 00 02 c4 57 15 00 00 00 01 00 02 c5 01 15 00 00 00 01 00 02 c6 79 15 00 00 00 01 00 02 c7 01 15 00 00 00 01 00 02 c8 95 15 00 00 00 01 00 02 c9 01 15 00 00 00 01 00 02 ca c3 15 00 00 00 01 00 02 cb 01 15 00 00 00 01 00 02 cc e8 15 00 00 00 01 00 02 cd 02 15 00 00 00 01 00 02 ce 21 15 00 00 00 01 00 02 cf 02 15 00 00 00 01 00 02 d0 51 15 00 00 00 01 00 02 d1 02 15 00 00 00 01 00 02 d2 52 15 00 00 00 01 00 02 d3 02 15 00 00 00 01 00 02 d4 7f 15 00 00 00 01 00 02 d5 02 15 00 00 00 01 00 02 d6 b2 15 00 00 00 01 00 02 d7 02 15 00 00 00 01 00 02 d8 d9 15 00 00 00 01 00 02 d9 03 15 00 00 00 01 00 02 da 04 15 00 00 00 01 00 02 db 03 15 00 00 00 01 00 02 dc 26 15 00 00 00 01 00 02 dd 03 15 00 00 00 01 00 02 de 4e 15 00 00 00 01 00 02 df 03 15 00 00 00 01 00 02 e0 59 15 00 00 00 01 00 02 e1 03 15 00 00 00 01 00 02 e2 65 15 00 00 00 01 00 02 e3 03 15 00 00 00 01 00 02 e4 73 15 00 00 00 01 00 02 e5 03 15 00 00 00 01 00 02 e6 81 15 00 00 00 01 00 02 e7 03 15 00 00 00 01 00 02 e8 91 15 00 00 00 01 00 02 e9 03 15 00 00 00 01 00 02 ea a2 15 00 00 00 01 00 02 eb 03 15 00 00 00 01 00 02 ec ae 15 00 00 00 01 00 02 ed 03 15 00 00 00 01 00 02 ee fd 15 00 00 00 01 00 02 ef 00 15 00 00 00 01 00 02 f0 bd 15 00 00 00 01 00 02 f1 00 15 00 00 00 01 00 02 f2 cc 15 00 00 00 01 00 02 f3 00 15 00 00 00 01 00 02 f4 e6 15 00 00 00 01 00 02 f5 00 15 00 00 00 01 00 02 f6 fa 15 00 00 00 01 00 02 f7 01 15 00 00 00 01 00 02 f8 0b 15 00 00 00 01 00 02 f9 01 15 00 00 00 01 00 02 fa 1b 15 00 00 00 01 00 02 ff 21 15 00 00 00 01 00 02 fb 01 15 00 00 00 01 00 02 00 01 15 00 00 00 01 00 02 01 28 15 00 00 00 01 00 02 02 01 15 00 00 00 01 00 02 03 35 15 00 00 00 01 00 02 04 01 15 00 00 00 01 00 02 05 40 15 00 00 00 01 00 02 06 01 15 00 00 00 01 00 02 07 67 15 00 00 00 01 00 02 08 01 15 00 00 00 01 00 02 09 87 15 00 00 00 01 00 02 0a 01 15 00 00 00 01 00 02 0b b9 15 00 00 00 01 00 02 0c 01 15 00 00 00 01 00 02 0d e0 15 00 00 00 01 00 02 0e 02 15 00 00 00 01 00 02 0f 1d 15 00 00 00 01 00 02 10 02 15 00 00 00 01 00 02 11 4e 15 00 00 00 01 00 02 12 02 15 00 00 00 01 00 02 13 4f 15 00 00 00 01 00 02 14 02 15 00 00 00 01 00 02 15 7d 15 00 00 00 01 00 02 16 02 15 00 00 00 01 00 02 17 b1 15 00 00 00 01 00 02 18 02 15 00 00 00 01 00 02 19 da 15 00 00 00 01 00 02 1a 03 15 00 00 00 01 00 02 1b 06 15 00 00 00 01 00 02 1c 03 15 00 00 00 01 00 02 1d 25 15 00 00 00 01 00 02 1e 03 15 00 00 00 01 00 02 1f 4d 15 00 00 00 01 00 02 20 03 15 00 00 00 01 00 02 21 59 15 00 00 00 01 00 02 22 03 15 00 00 00 01 00 02 23 68 15 00 00 00 01 00 02 24 03 15 00 00 00 01 00 02 25 7a 15 00 00 00 01 00 02 26 03 15 00 00 00 01 00 02 27 91 15 00 00 00 01 00 02 28 03 15 00 00 00 01 00 02 29 a5 15 00 00 00 01 00 02 2a 03 15 00 00 00 01 00 02 2b b1 15 00 00 00 01 00 02 2d 03 15 00 00 00 01 00 02 2f b6 15 00 00 00 01 00 02 30 03 15 00 00 00 01 00 02 31 fd 15 00 00 00 01 00 02 32 00 15 00 00 00 01 00 02 33 bd 15 00 00 00 01 00 02 34 00 15 00 00 00 01 00 02 35 cc 15 00 00 00 01 00 02 36 00 15 00 00 00 01 00 02 37 e6 15 00 00 00 01 00 02 38 00 15 00 00 00 01 00 02 39 fa 15 00 00 00 01 00 02 3a 01 15 00 00 00 01 00 02 3b 0b 15 00 00 00 01 00 02 3d 01 15 00 00 00 01 00 02 3f 1b 15 00 00 00 01 00 02 40 01 15 00 00 00 01 00 02 41 28 15 00 00 00 01 00 02 42 01 15 00 00 00 01 00 02 43 35 15 00 00 00 01 00 02 44 01 15 00 00 00 01 00 02 45 40 15 00 00 00 01 00 02 46 01 15 00 00 00 01 00 02 47 67 15 00 00 00 01 00 02 48 01 15 00 00 00 01 00 02 49 87 15 00 00 00 01 00 02 4a 01 15 00 00 00 01 00 02 4b b9 15 00 00 00 01 00 02 4c 01 15 00 00 00 01 00 02 4d e0 15 00 00 00 01 00 02 4e 02 15 00 00 00 01 00 02 4f 1d 15 00 00 00 01 00 02 50 02 15 00 00 00 01 00 02 51 4e 15 00 00 00 01 00 02 52 02 15 00 00 00 01 00 02 53 4f 15 00 00 00 01 00 02 54 02 15 00 00 00 01 00 02 55 7d 15 00 00 00 01 00 02 56 02 15 00 00 00 01 00 02 58 b1 15 00 00 00 01 00 02 59 02 15 00 00 00 01 00 02 5a da 15 00 00 00 01 00 02 5b 03 15 00 00 00 01 00 02 5c 06 15 00 00 00 01 00 02 5d 03 15 00 00 00 01 00 02 5e 25 15 00 00 00 01 00 02 5f 03 15 00 00 00 01 00 02 60 4d 15 00 00 00 01 00 02 61 03 15 00 00 00 01 00 02 62 59 15 00 00 00 01 00 02 63 03 15 00 00 00 01 00 02 64 68 15 00 00 00 01 00 02 65 03 15 00 00 00 01 00 02 66 7a 15 00 00 00 01 00 02 67 03 15 00 00 00 01 00 02 68 91 15 00 00 00 01 00 02 69 03 15 00 00 00 01 00 02 6a a5 15 00 00 00 01 00 02 6b 03 15 00 00 00 01 00 02 6c b1 15 00 00 00 01 00 02 6d 03 15 00 00 00 01 00 02 6e b6 15 00 00 00 01 00 02 6f 03 15 00 00 00 01 00 02 70 fd 15 00 00 00 01 00 02 71 02 15 00 00 00 01 00 02 72 35 15 00 00 00 01 00 02 73 02 15 00 00 00 01 00 02 74 36 15 00 00 00 01 00 02 75 02 15 00 00 00 01 00 02 76 38 15 00 00 00 01 00 02 77 02 15 00 00 00 01 00 02 78 39 15 00 00 00 01 00 02 79 02 15 00 00 00 01 00 02 7a 3b 15 00 00 00 01 00 02 7b 02 15 00 00 00 01 00 02 7c 3d 15 00 00 00 01 00 02 7d 02 15 00 00 00 01 00 02 7e 3e 15 00 00 00 01 00 02 7f 02 15 00 00 00 01 00 02 80 40 15 00 00 00 01 00 02 81 02 15 00 00 00 01 00 02 82 42 15 00 00 00 01 00 02 83 02 15 00 00 00 01 00 02 84 48 15 00 00 00 01 00 02 85 02 15 00 00 00 01 00 02 86 4f 15 00 00 00 01 00 02 87 02 15 00 00 00 01 00 02 88 5c 15 00 00 00 01 00 02 89 02 15 00 00 00 01 00 02 8a 69 15 00 00 00 01 00 02 8b 02 15 00 00 00 01 00 02 8c 82 15 00 00 00 01 00 02 8d 02 15 00 00 00 01 00 02 8e 9e 15 00 00 00 01 00 02 8f 02 15 00 00 00 01 00 02 90 9f 15 00 00 00 01 00 02 91 02 15 00 00 00 01 00 02 92 c4 15 00 00 00 01 00 02 93 02 15 00 00 00 01 00 02 94 ef 15 00 00 00 01 00 02 95 03 15 00 00 00 01 00 02 96 14 15 00 00 00 01 00 02 97 03 15 00 00 00 01 00 02 98 3f 15 00 00 00 01 00 02 99 03 15 00 00 00 01 00 02 9a 58 15 00 00 00 01 00 02 9b 03 15 00 00 00 01 00 02 9c 75 15 00 00 00 01 00 02 9d 03 15 00 00 00 01 00 02 9e 7d 15 00 00 00 01 00 02 9f 03 15 00 00 00 01 00 02 a0 86 15 00 00 00 01 00 02 a2 03 15 00 00 00 01 00 02 a3 8f 15 00 00 00 01 00 02 a4 03 15 00 00 00 01 00 02 a5 99 15 00 00 00 01 00 02 a6 03 15 00 00 00 01 00 02 a7 a3 15 00 00 00 01 00 02 a9 03 15 00 00 00 01 00 02 aa ab 15 00 00 00 01 00 02 ab 03 15 00 00 00 01 00 02 ac af 15 00 00 00 01 00 02 ad 03 15 00 00 00 01 00 02 ae fd 15 00 00 00 01 00 02 af 02 15 00 00 00 01 00 02 b0 35 15 00 00 00 01 00 02 b1 02 15 00 00 00 01 00 02 b2 36 15 00 00 00 01 00 02 b3 02 15 00 00 00 01 00 02 b4 38 15 00 00 00 01 00 02 b5 02 15 00 00 00 01 00 02 b6 39 15 00 00 00 01 00 02 b7 02 15 00 00 00 01 00 02 b8 3b 15 00 00 00 01 00 02 b9 02 15 00 00 00 01 00 02 ba 3d 15 00 00 00 01 00 02 bb 02 15 00 00 00 01 00 02 bc 3e 15 00 00 00 01 00 02 bd 02 15 00 00 00 01 00 02 be 40 15 00 00 00 01 00 02 bf 02 15 00 00 00 01 00 02 c0 42 15 00 00 00 01 00 02 c1 02 15 00 00 00 01 00 02 c2 48 15 00 00 00 01 00 02 c3 02 15 00 00 00 01 00 02 c4 4f 15 00 00 00 01 00 02 c5 02 15 00 00 00 01 00 02 c6 5c 15 00 00 00 01 00 02 c7 02 15 00 00 00 01 00 02 c8 69 15 00 00 00 01 00 02 c9 02 15 00 00 00 01 00 02 ca 82 15 00 00 00 01 00 02 cb 02 15 00 00 00 01 00 02 cc 9e 15 00 00 00 01 00 02 cd 02 15 00 00 00 01 00 02 ce 9f 15 00 00 00 01 00 02 cf 02 15 00 00 00 01 00 02 d0 c4 15 00 00 00 01 00 02 d1 02 15 00 00 00 01 00 02 d2 ef 15 00 00 00 01 00 02 d3 03 15 00 00 00 01 00 02 d4 14 15 00 00 00 01 00 02 d5 03 15 00 00 00 01 00 02 d6 3f 15 00 00 00 01 00 02 d7 03 15 00 00 00 01 00 02 d8 58 15 00 00 00 01 00 02 d9 03 15 00 00 00 01 00 02 da 75 15 00 00 00 01 00 02 db 03 15 00 00 00 01 00 02 dc 7d 15 00 00 00 01 00 02 dd 03 15 00 00 00 01 00 02 de 86 15 00 00 00 01 00 02 df 03 15 00 00 00 01 00 02 e0 8f 15 00 00 00 01 00 02 e1 03 15 00 00 00 01 00 02 e2 99 15 00 00 00 01 00 02 e3 03 15 00 00 00 01 00 02 e4 a3 15 00 00 00 01 00 02 e5 03 15 00 00 00 01 00 02 e6 ab 15 00 00 00 01 00 02 e7 03 15 00 00 00 01 00 02 e8 af 15 00 00 00 01 00 02 e9 03 15 00 00 00 01 00 02 ea fd 15 00 00 00 01 00 02 fb 01 15 01 00 00 01 00 02 ff 10];
        qcom,mdss-dsi-dispparam-papermode6-state = "dsi_hs_mode";
        qcom,mdss-dsi-dispparam-papermode7-command = [15 01 00 00 78 00 02 ff 20 15 00 00 00 01 00 02 fb 01 15 00 00 00 01 00 02 75 00 15 00 00 00 01 00 02 76 f0 15 00 00 00 01 00 02 77 00 15 00 00 00 01 00 02 78 fa 15 00 00 00 01 00 02 79 01 15 00 00 00 01 00 02 7a 0c 15 00 00 00 01 00 02 7b 01 15 00 00 00 01 00 02 7c 1c 15 00 00 00 01 00 02 7d 01 15 00 00 00 01 00 02 7e 2a 15 00 00 00 01 00 02 7f 01 15 00 00 00 01 00 02 80 36 15 00 00 00 01 00 02 81 01 15 00 00 00 01 00 02 82 42 15 00 00 00 01 00 02 83 01 15 00 00 00 01 00 02 84 4d 15 00 00 00 01 00 02 85 01 15 00 00 00 01 00 02 86 57 15 00 00 00 01 00 02 87 01 15 00 00 00 01 00 02 88 79 15 00 00 00 01 00 02 89 01 15 00 00 00 01 00 02 8a 95 15 00 00 00 01 00 02 8b 01 15 00 00 00 01 00 02 8c c3 15 00 00 00 01 00 02 8d 01 15 00 00 00 01 00 02 8e e8 15 00 00 00 01 00 02 8f 02 15 00 00 00 01 00 02 90 21 15 00 00 00 01 00 02 91 02 15 00 00 00 01 00 02 92 51 15 00 00 00 01 00 02 93 02 15 00 00 00 01 00 02 94 52 15 00 00 00 01 00 02 95 02 15 00 00 00 01 00 02 96 7f 15 00 00 00 01 00 02 97 02 15 00 00 00 01 00 02 98 b2 15 00 00 00 01 00 02 99 02 15 00 00 00 01 00 02 9a d9 15 00 00 00 01 00 02 9b 03 15 00 00 00 01 00 02 9c 04 15 00 00 00 01 00 02 9d 03 15 00 00 00 01 00 02 9e 26 15 00 00 00 01 00 02 9f 03 15 00 00 00 01 00 02 a0 4e 15 00 00 00 01 00 02 a2 03 15 00 00 00 01 00 02 a3 59 15 00 00 00 01 00 02 a4 03 15 00 00 00 01 00 02 a5 65 15 00 00 00 01 00 02 a6 03 15 00 00 00 01 00 02 a7 73 15 00 00 00 01 00 02 a9 03 15 00 00 00 01 00 02 aa 81 15 00 00 00 01 00 02 ab 03 15 00 00 00 01 00 02 ac 91 15 00 00 00 01 00 02 ad 03 15 00 00 00 01 00 02 ae a2 15 00 00 00 01 00 02 af 03 15 00 00 00 01 00 02 b0 ae 15 00 00 00 01 00 02 b1 03 15 00 00 00 01 00 02 b2 fd 15 00 00 00 01 00 02 b3 00 15 00 00 00 01 00 02 b4 f0 15 00 00 00 01 00 02 b5 00 15 00 00 00 01 00 02 b6 fa 15 00 00 00 01 00 02 b7 01 15 00 00 00 01 00 02 b8 0c 15 00 00 00 01 00 02 b9 01 15 00 00 00 01 00 02 ba 1c 15 00 00 00 01 00 02 bb 01 15 00 00 00 01 00 02 bc 2a 15 00 00 00 01 00 02 bd 01 15 00 00 00 01 00 02 be 36 15 00 00 00 01 00 02 bf 01 15 00 00 00 01 00 02 c0 42 15 00 00 00 01 00 02 c1 01 15 00 00 00 01 00 02 c2 4d 15 00 00 00 01 00 02 c3 01 15 00 00 00 01 00 02 c4 57 15 00 00 00 01 00 02 c5 01 15 00 00 00 01 00 02 c6 79 15 00 00 00 01 00 02 c7 01 15 00 00 00 01 00 02 c8 95 15 00 00 00 01 00 02 c9 01 15 00 00 00 01 00 02 ca c3 15 00 00 00 01 00 02 cb 01 15 00 00 00 01 00 02 cc e8 15 00 00 00 01 00 02 cd 02 15 00 00 00 01 00 02 ce 21 15 00 00 00 01 00 02 cf 02 15 00 00 00 01 00 02 d0 51 15 00 00 00 01 00 02 d1 02 15 00 00 00 01 00 02 d2 52 15 00 00 00 01 00 02 d3 02 15 00 00 00 01 00 02 d4 7f 15 00 00 00 01 00 02 d5 02 15 00 00 00 01 00 02 d6 b2 15 00 00 00 01 00 02 d7 02 15 00 00 00 01 00 02 d8 d9 15 00 00 00 01 00 02 d9 03 15 00 00 00 01 00 02 da 04 15 00 00 00 01 00 02 db 03 15 00 00 00 01 00 02 dc 26 15 00 00 00 01 00 02 dd 03 15 00 00 00 01 00 02 de 4e 15 00 00 00 01 00 02 df 03 15 00 00 00 01 00 02 e0 59 15 00 00 00 01 00 02 e1 03 15 00 00 00 01 00 02 e2 65 15 00 00 00 01 00 02 e3 03 15 00 00 00 01 00 02 e4 73 15 00 00 00 01 00 02 e5 03 15 00 00 00 01 00 02 e6 81 15 00 00 00 01 00 02 e7 03 15 00 00 00 01 00 02 e8 91 15 00 00 00 01 00 02 e9 03 15 00 00 00 01 00 02 ea a2 15 00 00 00 01 00 02 eb 03 15 00 00 00 01 00 02 ec ae 15 00 00 00 01 00 02 ed 03 15 00 00 00 01 00 02 ee fd 15 00 00 00 01 00 02 ef 00 15 00 00 00 01 00 02 f0 bd 15 00 00 00 01 00 02 f1 00 15 00 00 00 01 00 02 f2 cc 15 00 00 00 01 00 02 f3 00 15 00 00 00 01 00 02 f4 e6 15 00 00 00 01 00 02 f5 00 15 00 00 00 01 00 02 f6 fa 15 00 00 00 01 00 02 f7 01 15 00 00 00 01 00 02 f8 0b 15 00 00 00 01 00 02 f9 01 15 00 00 00 01 00 02 fa 1b 15 00 00 00 01 00 02 ff 21 15 00 00 00 01 00 02 fb 01 15 00 00 00 01 00 02 00 01 15 00 00 00 01 00 02 01 28 15 00 00 00 01 00 02 02 01 15 00 00 00 01 00 02 03 35 15 00 00 00 01 00 02 04 01 15 00 00 00 01 00 02 05 40 15 00 00 00 01 00 02 06 01 15 00 00 00 01 00 02 07 67 15 00 00 00 01 00 02 08 01 15 00 00 00 01 00 02 09 87 15 00 00 00 01 00 02 0a 01 15 00 00 00 01 00 02 0b b9 15 00 00 00 01 00 02 0c 01 15 00 00 00 01 00 02 0d e0 15 00 00 00 01 00 02 0e 02 15 00 00 00 01 00 02 0f 1d 15 00 00 00 01 00 02 10 02 15 00 00 00 01 00 02 11 4e 15 00 00 00 01 00 02 12 02 15 00 00 00 01 00 02 13 4f 15 00 00 00 01 00 02 14 02 15 00 00 00 01 00 02 15 7d 15 00 00 00 01 00 02 16 02 15 00 00 00 01 00 02 17 b1 15 00 00 00 01 00 02 18 02 15 00 00 00 01 00 02 19 da 15 00 00 00 01 00 02 1a 03 15 00 00 00 01 00 02 1b 06 15 00 00 00 01 00 02 1c 03 15 00 00 00 01 00 02 1d 25 15 00 00 00 01 00 02 1e 03 15 00 00 00 01 00 02 1f 4d 15 00 00 00 01 00 02 20 03 15 00 00 00 01 00 02 21 59 15 00 00 00 01 00 02 22 03 15 00 00 00 01 00 02 23 68 15 00 00 00 01 00 02 24 03 15 00 00 00 01 00 02 25 7a 15 00 00 00 01 00 02 26 03 15 00 00 00 01 00 02 27 91 15 00 00 00 01 00 02 28 03 15 00 00 00 01 00 02 29 a5 15 00 00 00 01 00 02 2a 03 15 00 00 00 01 00 02 2b b1 15 00 00 00 01 00 02 2d 03 15 00 00 00 01 00 02 2f b6 15 00 00 00 01 00 02 30 03 15 00 00 00 01 00 02 31 fd 15 00 00 00 01 00 02 32 00 15 00 00 00 01 00 02 33 bd 15 00 00 00 01 00 02 34 00 15 00 00 00 01 00 02 35 cc 15 00 00 00 01 00 02 36 00 15 00 00 00 01 00 02 37 e6 15 00 00 00 01 00 02 38 00 15 00 00 00 01 00 02 39 fa 15 00 00 00 01 00 02 3a 01 15 00 00 00 01 00 02 3b 0b 15 00 00 00 01 00 02 3d 01 15 00 00 00 01 00 02 3f 1b 15 00 00 00 01 00 02 40 01 15 00 00 00 01 00 02 41 28 15 00 00 00 01 00 02 42 01 15 00 00 00 01 00 02 43 35 15 00 00 00 01 00 02 44 01 15 00 00 00 01 00 02 45 40 15 00 00 00 01 00 02 46 01 15 00 00 00 01 00 02 47 67 15 00 00 00 01 00 02 48 01 15 00 00 00 01 00 02 49 87 15 00 00 00 01 00 02 4a 01 15 00 00 00 01 00 02 4b b9 15 00 00 00 01 00 02 4c 01 15 00 00 00 01 00 02 4d e0 15 00 00 00 01 00 02 4e 02 15 00 00 00 01 00 02 4f 1d 15 00 00 00 01 00 02 50 02 15 00 00 00 01 00 02 51 4e 15 00 00 00 01 00 02 52 02 15 00 00 00 01 00 02 53 4f 15 00 00 00 01 00 02 54 02 15 00 00 00 01 00 02 55 7d 15 00 00 00 01 00 02 56 02 15 00 00 00 01 00 02 58 b1 15 00 00 00 01 00 02 59 02 15 00 00 00 01 00 02 5a da 15 00 00 00 01 00 02 5b 03 15 00 00 00 01 00 02 5c 06 15 00 00 00 01 00 02 5d 03 15 00 00 00 01 00 02 5e 25 15 00 00 00 01 00 02 5f 03 15 00 00 00 01 00 02 60 4d 15 00 00 00 01 00 02 61 03 15 00 00 00 01 00 02 62 59 15 00 00 00 01 00 02 63 03 15 00 00 00 01 00 02 64 68 15 00 00 00 01 00 02 65 03 15 00 00 00 01 00 02 66 7a 15 00 00 00 01 00 02 67 03 15 00 00 00 01 00 02 68 91 15 00 00 00 01 00 02 69 03 15 00 00 00 01 00 02 6a a5 15 00 00 00 01 00 02 6b 03 15 00 00 00 01 00 02 6c b1 15 00 00 00 01 00 02 6d 03 15 00 00 00 01 00 02 6e b6 15 00 00 00 01 00 02 6f 03 15 00 00 00 01 00 02 70 fd 15 00 00 00 01 00 02 71 02 15 00 00 00 01 00 02 72 46 15 00 00 00 01 00 02 73 02 15 00 00 00 01 00 02 74 47 15 00 00 00 01 00 02 75 02 15 00 00 00 01 00 02 76 48 15 00 00 00 01 00 02 77 02 15 00 00 00 01 00 02 78 4a 15 00 00 00 01 00 02 79 02 15 00 00 00 01 00 02 7a 4b 15 00 00 00 01 00 02 7b 02 15 00 00 00 01 00 02 7c 4d 15 00 00 00 01 00 02 7d 02 15 00 00 00 01 00 02 7e 4e 15 00 00 00 01 00 02 7f 02 15 00 00 00 01 00 02 80 50 15 00 00 00 01 00 02 81 02 15 00 00 00 01 00 02 82 51 15 00 00 00 01 00 02 83 02 15 00 00 00 01 00 02 84 57 15 00 00 00 01 00 02 85 02 15 00 00 00 01 00 02 86 5d 15 00 00 00 01 00 02 87 02 15 00 00 00 01 00 02 88 69 15 00 00 00 01 00 02 89 02 15 00 00 00 01 00 02 8a 75 15 00 00 00 01 00 02 8b 02 15 00 00 00 01 00 02 8c 8d 15 00 00 00 01 00 02 8d 02 15 00 00 00 01 00 02 8e a8 15 00 00 00 01 00 02 8f 02 15 00 00 00 01 00 02 90 a9 15 00 00 00 01 00 02 91 02 15 00 00 00 01 00 02 92 d0 15 00 00 00 01 00 02 93 02 15 00 00 00 01 00 02 94 fa 15 00 00 00 01 00 02 95 03 15 00 00 00 01 00 02 96 1d 15 00 00 00 01 00 02 97 03 15 00 00 00 01 00 02 98 46 15 00 00 00 01 00 02 99 03 15 00 00 00 01 00 02 9a 5e 15 00 00 00 01 00 02 9b 03 15 00 00 00 01 00 02 9c 7a 15 00 00 00 01 00 02 9d 03 15 00 00 00 01 00 02 9e 82 15 00 00 00 01 00 02 9f 03 15 00 00 00 01 00 02 a0 8a 15 00 00 00 01 00 02 a2 03 15 00 00 00 01 00 02 a3 93 15 00 00 00 01 00 02 a4 03 15 00 00 00 01 00 02 a5 9c 15 00 00 00 01 00 02 a6 03 15 00 00 00 01 00 02 a7 a5 15 00 00 00 01 00 02 a9 03 15 00 00 00 01 00 02 aa ac 15 00 00 00 01 00 02 ab 03 15 00 00 00 01 00 02 ac af 15 00 00 00 01 00 02 ad 03 15 00 00 00 01 00 02 ae fd 15 00 00 00 01 00 02 af 02 15 00 00 00 01 00 02 b0 46 15 00 00 00 01 00 02 b1 02 15 00 00 00 01 00 02 b2 47 15 00 00 00 01 00 02 b3 02 15 00 00 00 01 00 02 b4 48 15 00 00 00 01 00 02 b5 02 15 00 00 00 01 00 02 b6 4a 15 00 00 00 01 00 02 b7 02 15 00 00 00 01 00 02 b8 4b 15 00 00 00 01 00 02 b9 02 15 00 00 00 01 00 02 ba 4d 15 00 00 00 01 00 02 bb 02 15 00 00 00 01 00 02 bc 4e 15 00 00 00 01 00 02 bd 02 15 00 00 00 01 00 02 be 50 15 00 00 00 01 00 02 bf 02 15 00 00 00 01 00 02 c0 51 15 00 00 00 01 00 02 c1 02 15 00 00 00 01 00 02 c2 57 15 00 00 00 01 00 02 c3 02 15 00 00 00 01 00 02 c4 5d 15 00 00 00 01 00 02 c5 02 15 00 00 00 01 00 02 c6 69 15 00 00 00 01 00 02 c7 02 15 00 00 00 01 00 02 c8 75 15 00 00 00 01 00 02 c9 02 15 00 00 00 01 00 02 ca 8d 15 00 00 00 01 00 02 cb 02 15 00 00 00 01 00 02 cc a8 15 00 00 00 01 00 02 cd 02 15 00 00 00 01 00 02 ce a9 15 00 00 00 01 00 02 cf 02 15 00 00 00 01 00 02 d0 d0 15 00 00 00 01 00 02 d1 02 15 00 00 00 01 00 02 d2 fa 15 00 00 00 01 00 02 d3 03 15 00 00 00 01 00 02 d4 1d 15 00 00 00 01 00 02 d5 03 15 00 00 00 01 00 02 d6 46 15 00 00 00 01 00 02 d7 03 15 00 00 00 01 00 02 d8 5e 15 00 00 00 01 00 02 d9 03 15 00 00 00 01 00 02 da 7a 15 00 00 00 01 00 02 db 03 15 00 00 00 01 00 02 dc 82 15 00 00 00 01 00 02 dd 03 15 00 00 00 01 00 02 de 8a 15 00 00 00 01 00 02 df 03 15 00 00 00 01 00 02 e0 93 15 00 00 00 01 00 02 e1 03 15 00 00 00 01 00 02 e2 9c 15 00 00 00 01 00 02 e3 03 15 00 00 00 01 00 02 e4 a5 15 00 00 00 01 00 02 e5 03 15 00 00 00 01 00 02 e6 ac 15 00 00 00 01 00 02 e7 03 15 00 00 00 01 00 02 e8 af 15 00 00 00 01 00 02 e9 03 15 00 00 00 01 00 02 ea fd 15 00 00 00 01 00 02 fb 01 15 01 00 00 01 00 02 ff 10];
        qcom,mdss-dsi-dispparam-papermode7-state = "dsi_hs_mode";
        qcom,mdss-dsi-dispparam-scon-command = [15 01 00 00 01 00 02 ff 22 15 01 00 00 01 00 02 fb 01 15 01 00 00 01 00 02 68 00 15 01 00 00 01 00 02 56 77 15 01 00 00 01 00 02 58 0e 15 01 00 00 01 00 02 59 12 15 01 00 00 01 00 02 5a 0c 15 01 00 00 01 00 02 5b 14 15 01 00 00 01 00 02 5c 0a 15 01 00 00 01 00 02 5d 16 15 01 00 00 01 00 02 5e 08 15 01 00 00 01 00 02 5f 18 15 01 00 00 01 00 02 60 06 15 01 00 00 01 00 02 61 1a 15 01 00 00 01 00 02 62 04 15 01 00 00 01 00 02 63 1c 15 01 00 00 01 00 02 64 20 15 01 00 00 01 00 02 ff 10];
        qcom,mdss-dsi-dispparam-sreon-command = [15 01 00 00 01 00 02 ff 22 15 01 00 00 01 00 02 fb 01 15 01 00 00 01 00 02 68 00 15 01 00 00 01 00 02 56 77 15 01 00 00 01 00 02 58 12 15 01 00 00 01 00 02 59 0e 15 01 00 00 01 00 02 5a 14 15 01 00 00 01 00 02 5b 0e 15 01 00 00 01 00 02 5c 16 15 01 00 00 01 00 02 5d 0e 15 01 00 00 01 00 02 5e 18 15 01 00 00 01 00 02 5f 0e 15 01 00 00 01 00 02 60 1a 15 01 00 00 01 00 02 61 0e 15 01 00 00 01 00 02 62 1c 15 01 00 00 01 00 02 63 0e 15 01 00 00 01 00 02 64 2f 15 01 00 00 01 00 02 ff 10];
        qcom,mdss-dsi-dispparam-sreoff-command = <0x15010000 0x10002ff 0x22150100 0x10002 0xfb011501 0x100 0x2560015 0x1000001 0x2ff10>;
        qcom,mdss-dsi-dispparam-vividweak-command = <0x15010000 0x100002ff 0x22150100 0x100002 0xfb011501 0x1000 0x2000015 0x1000010 0x20104 0x15010000 0x10000202 0x8150100 0x100002 0x30c1501 0x1000 0x2041015 0x1000010 0x20514 0x15010000 0x10000206 0x18150100 0x100002 0x7201501 0x1000 0x2082415 0x1000010 0x20928 0x15010000 0x1000020a 0x30150100 0x100002 0xb381501 0x1000 0x20c3815 0x1000010 0x20d30 0x15010000 0x1000020e 0x28150100 0x100002 0xf201501 0x1000 0x2101015 0x1000010 0x21100 0x15010000 0x10000212 0x150100 0x100002 0x13001501 0x1000 0x2141015 0x1000010 0x21518 0x15010000 0x10000216 0x20150100 0x100002 0x17281501 0x1000 0x2183015 0x1000010 0x21938 0x15010000 0x1000021a 0x77150100 0x100002 0x53001501 0x1000 0x2680015 0x1000010 0x2ff10>;
        qcom,mdss-dsi-dispparam-vividstrong-command = [15 01 00 00 01 00 02 ff 22 15 01 00 00 01 00 02 fb 01 15 01 00 00 01 00 02 00 28 15 01 00 00 01 00 02 01 2c 15 01 00 00 01 00 02 02 30 15 01 00 00 01 00 02 03 34 15 01 00 00 01 00 02 04 38 15 01 00 00 01 00 02 05 3c 15 01 00 00 01 00 02 06 40 15 01 00 00 01 00 02 07 48 15 01 00 00 01 00 02 08 4c 15 01 00 00 01 00 02 09 50 15 01 00 00 01 00 02 0a 58 15 01 00 00 01 00 02 0b 60 15 01 00 00 01 00 02 0c 60 15 01 00 00 01 00 02 0d 58 15 01 00 00 01 00 02 0e 50 15 01 00 00 01 00 02 0f 48 15 01 00 00 01 00 02 10 38 15 01 00 00 01 00 02 11 28 15 01 00 00 01 00 02 12 28 15 01 00 00 01 00 02 13 28 15 01 00 00 01 00 02 32 00 15 01 00 00 01 00 02 33 00 15 01 00 00 01 00 02 34 00 15 01 00 00 01 00 02 35 02 15 01 00 00 01 00 02 36 04 15 01 00 00 01 00 02 37 06 15 01 00 00 01 00 02 38 08 15 01 00 00 01 00 02 39 0a 15 01 00 00 01 00 02 3a 0c 15 01 00 00 01 00 02 3b 0e 15 01 00 00 01 00 02 3f 10 15 01 00 00 01 00 02 40 12 15 01 00 00 01 00 02 41 14 15 01 00 00 01 00 02 42 14 15 01 00 00 01 00 02 43 12 15 01 00 00 01 00 02 44 10 15 01 00 00 01 00 02 45 0e 15 01 00 00 01 00 02 46 0c 15 01 00 00 01 00 02 47 0a 15 01 00 00 01 00 02 48 08 15 01 00 00 01 00 02 49 06 15 01 00 00 01 00 02 4a 04 15 01 00 00 01 00 02 4b 02 15 01 00 00 01 00 02 4c 00 15 01 00 00 01 00 02 4d 08 15 01 00 00 01 00 02 4e 08 15 01 00 00 01 00 02 4f 08 15 01 00 00 01 00 02 50 08 15 01 00 00 01 00 02 51 08 15 01 00 00 01 00 02 52 08 15 01 00 00 01 00 02 1a 00 15 01 00 00 01 00 02 53 00 15 01 00 00 01 00 02 56 00 15 01 00 00 01 00 02 58 12 15 01 00 00 01 00 02 59 0e 15 01 00 00 01 00 02 5a 14 15 01 00 00 01 00 02 5b 0e 15 01 00 00 01 00 02 5c 16 15 01 00 00 01 00 02 5d 0e 15 01 00 00 01 00 02 5e 18 15 01 00 00 01 00 02 5f 0e 15 01 00 00 01 00 02 60 1a 15 01 00 00 01 00 02 61 0e 15 01 00 00 01 00 02 62 1c 15 01 00 00 01 00 02 63 0e 15 01 00 00 01 00 02 64 2f 15 01 00 00 01 00 02 68 00 15 01 00 00 01 00 02 ff 10 15 01 00 00 01 00 02 55 80];
        qcom,mdss-dsi-dispparam-vividoff-command = [15 01 00 00 10 00 02 ff 22 15 01 00 00 10 00 02 fb 01 15 01 00 00 10 00 02 1a 00 15 01 00 00 10 00 02 53 00 15 01 00 00 10 00 02 68 00 15 01 00 00 10 00 02 ff 10];
        qcom,mdss-dsi-dispparam-smartweak-command = [15 00 00 00 01 00 02 ff 22 15 00 00 00 01 00 02 fb 01 15 00 00 00 01 00 02 00 28 15 00 00 00 01 00 02 01 2c 15 00 00 00 01 00 02 02 30 15 00 00 00 01 00 02 03 34 15 00 00 00 01 00 02 04 38 15 00 00 00 01 00 02 05 3c 15 00 00 00 01 00 02 06 40 15 00 00 00 01 00 02 07 48 15 00 00 00 01 00 02 08 4c 15 00 00 00 01 00 02 09 50 15 00 00 00 01 00 02 0a 58 15 00 00 00 01 00 02 0b 60 15 00 00 00 01 00 02 0c 60 15 00 00 00 01 00 02 0d 58 15 00 00 00 01 00 02 0e 50 15 00 00 00 01 00 02 0f 48 15 00 00 00 01 00 02 10 38 15 00 00 00 01 00 02 11 28 15 00 00 00 01 00 02 12 28 15 00 00 00 01 00 02 13 28 15 00 00 00 01 00 02 32 00 15 00 00 00 01 00 02 33 00 15 00 00 00 01 00 02 34 00 15 00 00 00 01 00 02 35 02 15 00 00 00 01 00 02 36 04 15 00 00 00 01 00 02 37 06 15 00 00 00 01 00 02 38 08 15 00 00 00 01 00 02 39 0a 15 00 00 00 01 00 02 3a 0c 15 00 00 00 01 00 02 3b 0e 15 00 00 00 01 00 02 3f 10 15 00 00 00 01 00 02 40 12 15 00 00 00 01 00 02 41 14 15 00 00 00 01 00 02 42 14 15 00 00 00 01 00 02 43 12 15 00 00 00 01 00 02 44 10 15 00 00 00 01 00 02 45 0e 15 00 00 00 01 00 02 46 0c 15 00 00 00 01 00 02 47 0a 15 00 00 00 01 00 02 48 08 15 00 00 00 01 00 02 49 06 15 00 00 00 01 00 02 4a 04 15 00 00 00 01 00 02 4b 02 15 00 00 00 01 00 02 4c 00 15 00 00 00 01 00 02 4d 00 15 00 00 00 01 00 02 4e 08 15 00 00 00 01 00 02 4f 10 15 00 00 00 01 00 02 50 18 15 00 00 00 01 00 02 51 20 15 00 00 00 01 00 02 52 28 15 00 00 00 01 00 02 1a 00 15 00 00 00 01 00 02 53 77 15 00 00 00 01 00 02 56 00 15 00 00 00 01 00 02 68 00 15 01 00 00 01 00 02 ff 10];
        qcom,mdss-dsi-dispparam-smartstrong-command = [15 00 00 00 01 00 02 ff 22 15 00 00 00 01 00 02 fb 01 15 00 00 00 01 00 02 00 28 15 00 00 00 01 00 02 01 2c 15 00 00 00 01 00 02 02 30 15 00 00 00 01 00 02 03 34 15 00 00 00 01 00 02 04 38 15 00 00 00 01 00 02 05 3c 15 00 00 00 01 00 02 06 40 15 00 00 00 01 00 02 07 48 15 00 00 00 01 00 02 08 4c 15 00 00 00 01 00 02 09 50 15 00 00 00 01 00 02 0a 58 15 00 00 00 01 00 02 0b 60 15 00 00 00 01 00 02 0c 60 15 00 00 00 01 00 02 0d 58 15 00 00 00 01 00 02 0e 50 15 00 00 00 01 00 02 0f 48 15 00 00 00 01 00 02 10 38 15 00 00 00 01 00 02 11 28 15 00 00 00 01 00 02 12 28 15 00 00 00 01 00 02 13 28 15 00 00 00 01 00 02 32 00 15 00 00 00 01 00 02 33 00 15 00 00 00 01 00 02 34 00 15 00 00 00 01 00 02 35 03 15 00 00 00 01 00 02 36 06 15 00 00 00 01 00 02 37 09 15 00 00 00 01 00 02 38 0c 15 00 00 00 01 00 02 39 0f 15 00 00 00 01 00 02 3a 12 15 00 00 00 01 00 02 3b 15 15 00 00 00 01 00 02 3f 18 15 00 00 00 01 00 02 40 1b 15 00 00 00 01 00 02 41 1e 15 00 00 00 01 00 02 42 1e 15 00 00 00 01 00 02 43 1b 15 00 00 00 01 00 02 44 18 15 00 00 00 01 00 02 45 15 15 00 00 00 01 00 02 46 12 15 00 00 00 01 00 02 47 0f 15 00 00 00 01 00 02 48 0c 15 00 00 00 01 00 02 49 09 15 00 00 00 01 00 02 4a 06 15 00 00 00 01 00 02 4b 03 15 00 00 00 01 00 02 4c 00 15 00 00 00 01 00 02 4d 00 15 00 00 00 01 00 02 4e 08 15 00 00 00 01 00 02 4f 10 15 00 00 00 01 00 02 50 18 15 00 00 00 01 00 02 51 20 15 00 00 00 01 00 02 52 28 15 00 00 00 01 00 02 1a 00 15 00 00 00 01 00 02 53 77 15 00 00 00 01 00 02 56 00 15 00 00 00 01 00 02 68 00 15 01 00 00 01 00 02 ff 10];
        qcom,mdss-dsi-dispparam-smartoff-command = [15 01 00 00 01 00 02 ff 22 15 01 00 00 01 00 02 53 77 15 01 00 00 01 00 02 ff 10];
        qcom,mdss-dsi-dispparam-level0-command = [15 01 00 00 10 00 02 ff 22 15 01 00 00 10 00 02 56 00 15 01 00 00 10 00 02 ff 10];
        qcom,mdss-dsi-dispparam-level1-command = [15 01 00 00 10 00 02 ff 22 15 01 00 00 10 00 02 58 12 15 01 00 00 10 00 02 59 0e 15 01 00 00 10 00 02 56 01 15 01 00 00 10 00 02 ff 10];
        qcom,mdss-dsi-dispparam-level2-command = [15 01 00 00 10 00 02 ff 22 15 01 00 00 10 00 02 58 14 15 01 00 00 10 00 02 59 0e 15 01 00 00 10 00 02 56 01 15 01 00 00 10 00 02 ff 10];
        qcom,mdss-dsi-dispparam-level3-command = [15 01 00 00 10 00 02 ff 22 15 01 00 00 10 00 02 58 16 15 01 00 00 10 00 02 59 0e 15 01 00 00 10 00 02 56 01 15 01 00 00 10 00 02 ff 10];
        qcom,mdss-dsi-dispparam-level4-command = [15 01 00 00 10 00 02 ff 22 15 01 00 00 10 00 02 58 18 15 01 00 00 10 00 02 59 0e 15 01 00 00 10 00 02 56 01 15 01 00 00 10 00 02 ff 10];
        qcom,mdss-dsi-dispparam-level5-command = [15 01 00 00 10 00 02 ff 22 15 01 00 00 10 00 02 58 1a 15 01 00 00 10 00 02 59 0e 15 01 00 00 10 00 02 56 01 15 01 00 00 10 00 02 ff 10];
        qcom,mdss-dsi-dispparam-level6-command = [15 01 00 00 10 00 02 ff 22 15 01 00 00 10 00 02 58 1c 15 01 00 00 10 00 02 59 0e 15 01 00 00 10 00 02 56 01 15 01 00 00 10 00 02 ff 10];
        qcom,mdss-dsi-dispparam-idleon-command = [15 01 00 00 10 00 02 ff 10 15 01 00 00 10 00 02 39 00];
        qcom,mdss-dsi-dispparam-idleoff-command = [15 01 00 00 10 00 02 ff 10 15 01 00 00 10 00 02 38 00];
        qcom,mdss-dsi-dispparam-test-command = [15 01 00 00 10 00 02 ff 20];
        qcom,mdss-dsi-dispparam-test-command-state = "dsi_hs_mode";
	};
};
